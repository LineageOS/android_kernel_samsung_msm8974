## drivers/staging/iio/imu/inv_sensors/Kconfig
```kconfig
#
# inv-mpu-iio driver for Invensense MPU devices and combos
#

config INV_SENSORS_IIO
	tristate "Invensense MPU devices"
	depends on I2C && SYSFS && IIO && IIO_KFIFO_BUF && IIO_TRIGGER && !INV_MPU
	default n
	help
	  This driver supports the Invensense MPU devices.
	  This includes MPU6050/MPU3050/MPU9150/ITG3500/MPU6500/MPU9250.
	  This driver can be built as a module. The module will be called
	  inv-mpu-iio.

config INV_SENSORS_MPU65XX	  
	tristate "Invensense MPU 65XX driver"
	depends on I2C && SYSFS && IIO && IIO_KFIFO_BUF && IIO_TRIGGER && !INV_MPU
	default n
	help
	  This driver supports the Invensense MPU-65XX .

config INV_SENSORS_DMP
	tristate "Invensense MPU DMP driver"
	depends on I2C && SYSFS && IIO && IIO_KFIFO_BUF && IIO_TRIGGER && !INV_MPU
	default n
	help
	  This driver supports the Invensense DMP .

config INV_SENSORS_DMP_K520S
	tristate "Invensense MPU DMP K520S driver"
	depends on I2C && SYSFS && IIO && IIO_KFIFO_BUF && IIO_TRIGGER && !INV_MPU
	default n
	help
	  This driver supports the Invensense DMP .


config INV_SENSORS_DBG
	tristate "Invensense MPU Debug"
	depends on I2C && SYSFS && IIO && IIO_KFIFO_BUF && IIO_TRIGGER && !INV_MPU
	default n
	help
	  This driver supports debug information.
	  
config INV_SENSORS_DTS_SUPPORT
	tristate "Invensense DTS support"
	depends on I2C && SYSFS && IIO && IIO_KFIFO_BUF && IIO_TRIGGER && !INV_MPU
	default n
	help
	  This driver supports debug information.
```

## drivers/staging/iio/imu/mpu_primary/Kconfig
```kconfig
#
# inv-mpu-iio driver for Invensense MPU devices and combos
#

config INV_MPU_IIO_PRIMARY
	tristate "Invensense MPU devices"
	depends on I2C && SYSFS && IIO && IIO_KFIFO_BUF && IIO_TRIGGER && !INV_MPU
	default n
	help
	  This driver supports the Invensense MPU devices.
	  This includes MPU6050/MPU3050/MPU9150/ITG3500/MPU6500/MPU9250.
	  This driver can be built as a module. The module will be called
	  inv-mpu-iio.
```

## drivers/staging/iio/light/Kconfig
```kconfig
#
# Light sensors
#
menu "Light sensors"

config SENSORS_GP2A_IIO
	tristate "Sharp Light Sensor"
	depends on I2C && GPIOLIB
	default n
	help
	  If you say yes here you get support for the sharp sensor.
	  This driver provides ambient light.
config SENSORS_GP2A_IIO_PROX
	tristate "Sharp Proximity Sensor"
	depends on SENSORS_GP2A_IIO
	default n
	help
	  If you say yes here you get support for the sharp sensor.
	  This driver provides distacne.

	  To compile this driver as a module, choose M here: the
	  module will be called gp2a030a.
config SENSORS_ISL29018
        tristate "ISL 29018 light and proximity sensor"
        depends on I2C
        default n
        help
         If you say yes here you get support for ambient light sensing and
         proximity infrared sensing from Intersil ISL29018.
         This driver will provide the measurements of ambient light intensity
         in lux, proximity infrared sensing and normal infrared sensing.
         Data from sensor is accessible via sysfs.

config SENSORS_TSL2563
	tristate "TAOS TSL2560, TSL2561, TSL2562 and TSL2563 ambient light sensors"
	depends on I2C
	help
	 If you say yes here you get support for the Taos TSL2560,
	 TSL2561, TSL2562 and TSL2563 ambient light sensors.

	 This driver can also be built as a module.  If so, the module
	 will be called tsl2563.

config TSL2583
	tristate "TAOS TSL2580, TSL2581 and TSL2583 light-to-digital converters"
	depends on I2C
	help
	 Provides support for the TAOS tsl2580, tsl2581 and tsl2583 devices.
	 Access ALS data via iio, sysfs.

endmenu
```

## drivers/usb/notify/Kconfig
```kconfig
#
# USB Host notify configuration
#

config USB_HOST_NOTIFY
	boolean "USB Host notify Driver"
	depends on USB
	help
	  Android framework needs uevents for usb host operation.
	  Host notify Driver serves uevent format
	  that is used by usb host or otg.

config USB_DEBUG_DETEAILED_LOG
	boolean "USB detailed log for debugging"
	depends on USB
	help
	  Add detailed log for debugging.
```

## drivers/video/msm/mdss/Kconfig
```kconfig
config FB_MSM_MDSS_WRITEBACK
	bool "MDSS Writeback Panel"
	---help---
	The MDSS Writeback Panel provides support for routing the output of
	MDSS frame buffer driver and MDP processing to memory.

config FB_MSM_MDSS_HDMI_PANEL
	depends on FB_MSM_MDSS
	bool "MDSS HDMI Tx Panel"
	default n
	---help---
	The MDSS HDMI Panel provides support for transmitting TMDS signals of
	MDSS frame buffer data to connected hdmi compliant TVs, monitors etc.

config FB_MSM_MDSS_HDMI_MHL_SII8334
	depends on FB_MSM_MDSS_HDMI_PANEL
	bool 'MHL SII8334 support '
	default n
	---help---
	  Support the HDMI to MHL conversion.
	  MHL (Mobile High-Definition Link) technology
	  uses USB connector to output HDMI content

config FB_MSM_MDSS_SHARP_HD_PANEL
        bool "MDSS SHARP HD Panel"
        default n
        ---help---
        The MDSS SHARP LCD Panel support

config BACKLIGHT_KTD2801
	bool "Backlight IC KTD2801"
	default n

config MDNIE_VIDEO_ENHANCED
bool "MDNIE VIDEO ENHANCED"
	default n

config FB_MSM_MDSS_DSI_CTRL_STATUS
	tristate "DSI controller status check feature"
	---help---
	  Check DSI controller status periodically (default period is 5
	  seconds) by sending Bus-Turn-Around (BTA) command. If DSI controller
	  fails to acknowledge the BTA command, it sends PANEL_ALIVE=0 status
	  to HAL layer to reset the controller.

config FB_MSM_MDSS_MDP3
	depends on FB_MSM_MDSS
	bool "MDP3 display controller"
	---help---
	The MDP3 provides support for an older version display controller
	included in latest display sub-system, known as MDSS.

config FB_MSM_MDSS_KCAL_CTRL
	depends on FB_MSM_MDSS
	bool "MDSS color control"
	default y
	---help---
	  Enable sysfs for post-processing control of mdss-mdp5 display
	  controllers in MDSS.

config FB_MSM_MDSS_DBG_SEQ_TICK
	bool "SEQ tick dbg support"
	default n

config FB_MSM_MDSS_DSI_DBG
	bool "DSI dbg support"
	default n

config SAMSUNG_CMC624
	bool "Support for integrated LCD controller in msm89XX"
	depends on FB && ARCH_MSM
	default n

config FB_EBOOK_PANEL_SCENARIO
	bool "Samsung EBOOK PANEL SCENARIO"
	depends on FB_MSM
	depends on SAMSUNG_CMC624
	default n

config FB_MSM_MIPI_DSI_NOVATEK_NT35596
	bool
	select FB_MSM_MIPI_DSI
	default n

config FB_MSM_MIPI_NOVATEK_VIDEO_HD_PT
	bool
	select FB_MSM_MIPI_DSI_NOVATEK_NT35596
	default n

config FB_MSM_MIPI_NOVATEK_VIDEO_HD_PT_PANEL
	bool "MIPI NOVATEK VIDEO HD PT Panel"
	select FB_MSM_MIPI_NOVATEK_VIDEO_HD_PT
	default n

config MDNIE_LITE_TUNING
	bool "MDNIe lite panel tuning"
	default n

config MDNIE_ENHENCED_LOCAL_CE
	bool "MDNIe lite panel tuning for enhenced local ce"
	default n

config MDNIE_TFT_MSM8X26
	bool "MDNIe feature for 8x26 tft panels"
	default n

config FB_MSM_MIPI_SAMSUNG_OCTA_VIDEO_FULL_HD_PT_PANEL
	bool "Support SAMSUNG OCTA Video Full-HD Panel"
	default n

config FB_MSM_MIPI_MAGNA_OCTA_VIDEO_720P_PT_PANEL
	bool "Support MAGNA OCTA Video 720P Panel"
	default n

config FB_MSM_MIPI_MAGNA_OCTA_VIDEO_WXGA_PT_DUAL_PANEL
	bool "Support MAGNA OCTA Video WXGA dual Panel"
	default n

config FB_MSM_MDSS_MAGNA_OCTA_VIDEO_720P_PT_PANEL
	bool "Support Magna OCTA Video 720P (EA8061) Panel"
	default n

config FB_MSM_MDSS_MAGNA_LDI_EA8061
	bool "Support Magna OCTA Video 720P (EA8061) Panel"
	default n

config FB_MSM_MDSS_SAMSUNG_OCTA_VIDEO_720P_PT_PANEL
	bool "Support SAMSUNG OCTA Video 720P (S6E8AA4) Panel"
	default n

config FB_MSM_MDSS_MSM8X26
	bool "Support Panel for MSM8x26 chipset"
	default n

config FB_MSM_MIPI_SAMSUNG_OCTA_CMD_FULL_HD_PT_PANEL
	bool "Support SAMSUNG OCTA Command Full-HD Panel"
	default n

config FB_MSM_MIPI_SAMSUNG_OCTA_CMD_WQHD_PT_PANEL
	bool "Support SAMSUNG OCTA Command WQHD Panel"
	default n

config FB_MSM_MIPI_MAGNA_OCTA_CMD_HD_PT_PANEL
	bool "Support MAGNA OCTA Command HD Panel"
	default n

config FB_MSM_MIPI_SAMSUNG_YOUM_CMD_FULL_HD_PT_PANEL
	bool "Support SAMSUNG YOUM Command Full-HD Panel"
	default n

config FB_MSM_MIPI_S6E8AA0A_720P_PT_PANEL
	bool "Support SAMSUNG OCTA Video 720P Panel"
	default n

config FB_MSM_MIPI_S6E88A0_QHD_VIDEO_PT_PANEL
	bool "Support SAMSUNG OCTA Video qHD Panel"
	default n

config FB_MSM_MDSS_S6E8AA0A_HD_PANEL
	bool "MDSS S6E8AA0A HD Panel"
	default n
	---help---
	The MDSS S6E8AA0A LCD Panel support

config MIPI_LCD_S6E3FA0_FORCE_VIDEO_MODE
	bool "Enforce DSI VIDEO Mode on S6E3FA0 panel"
	default n

config FB_MSM_MIPI_SAMSUNG_OCTA_VIDEO_WVGA_S6E88A0_PT_PANEL
	bool "Support SAMSUNG OCTA Video WVGA Panel"
	default n

config FB_MSM_MIPI_CMD_WVGA_ILI9806B_PT_PANEL
	bool "MIPI CMD WVGA ILI9806B PANEL"
	default n

config FB_MSM_MIPI_VIDEO_WVGA_NT35502_PT_PANEL
	bool "MIPI VIDEO WVGA NT35502 PANEL"
	select WHITE_PANEL
	select MDSS_DSI_EVENT_HANDLER_PANEL
	select MDNIE_LITE_TUNING
	select CLK_TUNING
	default n

config FB_MSM_MDSS_HX8369B_TFT_VIDEO_WVGA_PT_PANEL
	bool "MIPI VIDEO WVGA HX8369B PANEL"
	default n

config FB_MSM_MDSS_HX8394C_TFT_VIDEO_720P_PANEL
	bool "MIPI VIDEO 720P HX8394C PANEL"
	default n

config BACKLIGHT_IC_KTD253
	bool "BACKLIGHT IC KTD253"
	default n

config BACKLIGHT_IC_KTD2801
	bool "BACKLIGHT IC KTD2801"
	default n

config REGULATOR_LP8720
	bool "Support Regulator LP8720"
	default n

config NEW_UX_MDNIE
	bool "Support LOS_NEW_UX_MDNIE"
	default n

config DUAL_LCD
	bool "Support DUAL LCD"
	select FB_MSM_MIPI_MAGNA_OCTA_VIDEO_WXGA_PT_DUAL_PANEL
	default n

config LCD_HMT
	bool "Support LCD HMT"
	default n

config FB_MSM_MIPI_JDI_TFT_VIDEO_FULL_HD_PT_PANEL
	bool "Support JDI TFT VIDEO FULL HD Panel"
	select FB_MSM_MIPI_DSI
	default n

config SUPPORT_DISPLAY_OCTA_TFT
	bool "support OCTA and TFT panel"
	default n

config FB_MSM_CAMERA_CSC
	default n
	bool "Support SAMSUNG CAMERA CSC"
	---help---
		Support for camera CSC tuning

config FB_MSM_EDP_SAMSUNG
	bool "Support SAMSUNG EDP TCON"
	default n

config EDP_ESD_FUNCTION
	bool "Support EDP esd function"
	default n

config EDP_TCON_MDNIE
	bool "Support EDP mdnie function"
	default n

config CABC_TUNING
	bool "CABC panel tuning"
	default n

config CABC_TUNING_HX8394C
	bool "CABC panel(HX8394C) tuning"
	default n

config FB_MSM_MIPI_TFT_VIDEO_FULL_HD_PT_PANEL
	bool "Support TFT VIDEO FULL HD Panel"
	select FB_MSM_MIPI_DSI
	default n

config ESD_ERR_FG_RECOVERY
	bool "ESD Feature"
	default n

config LCD_CRACK_RECOVERY
	bool "LCD crack recovery feature"
	default n
config FB_MSM_MDSS_SDC_WXGA_PANEL
	bool "MDSS SDC WXGA Panel"
	default n
	---help---
	The MDSS SDC LCD Panel support

config FB_MSM_MDSS_CPT_QHD_PANEL
	bool "support CPT qHD panel"
	default n

config LCD_CONNECTION_CHECK
	bool "check if LCD connected or not and detect panel vendor"
	default n

config SAMSUNG_DEBUG_DISPLAY
	bool "Add Samsung Debugging code"
	default n

config FB_MSM_MDSS_TC_DSI2LVDS_WXGA_PANEL
	bool "TOSHIBA DSI2LVDS CONVERTER"
	default n
	---help---
	The TOSHIBA DSI2LVDS CONVERTER support

config TC358764_I2C_CONTROL
	bool "TOSHIBA I2C CONTROLLER"
	default n
	---help---
	The TOSHIBA I2C CONTROLLER support
config LCD_FORCE_VIDEO_MODE
	bool "forcing video mode on cmd panle"
	default n

config FB_MSM_MIPI_SAMSUNG_TFT_VIDEO_WQXGA_PT_PANEL
	bool "Support SAMSUNG TFT Video WQXGA Panel"
	default n

config FB_MSM_MIPI_SAMSUNG_OCTA_CMD_WQXGA_S6TNMR7_PT_PANEL
	bool "Support SAMSUNG AMOLED Command WQXGA (S6TNMR7) Panel"
	default n

config FB_MSM_MIPI_SAMSUNG_OCTA_CMD_WQXGA_S6E3HA1_PT_PANEL
	bool "Support SAMSUNG AMOLED Command WQXGA (S6E3HA1) Panel"
	default n

config FB_MSM_MDSS_MAGNA_OCTA_VIDEO_720P_PANEL
	bool "Support Magna OCTA Video 720P (EA8061) Panel"
	default n

config FB_MSM_MIPI_SAMSUNG_OCTA_VIDEO_HD_PANEL
	bool "Support Magna OCTA Video 720P (EA8061) Panel"
	default n

config EDP_EXTERNAL_POWER
	bool "Support EDP external power"
	default n

config FB_MSM8x26_MDSS_CHECK_LCD_CONNECTION
	bool "Support LCD connection check"
	default n

config GET_LCD_ATTACHED
	bool "check if LCD connected or not and detect panel vendor"
	default n

config GET_LCD_PCD_DETECTED
	bool "check if PCD detected or not"
	default n

config WHITE_PANEL
	bool "Support normally White Panel"
	default n

config DSI_HOST_DEBUG
	bool "Support MSP3 DSI Command debugging"
	default n

config MDSS_DSI_EVENT_HANDLER_PANEL
	bool "Support MDSS_DSI_EVENT_HANDLER_PANEL"
	default n

config CLK_TUNING
	bool "Support CLK tuning"
	default n

config MDP_NEGATIVE_SUPPORT
	bool "Support MDP negative color"
	default n

config MDSS_UD_FLIP
	bool "Support MDSS UD flip"
	default n

config PANEL_RECOVERY
	bool "Support recovery when check rddpm err"
	default n
```

## drivers/video/msm/mhl_v2/Kconfig
```kconfig
#
# Copyright (c) 2013 Samsung Electronics Co., Ltd.
# 		http://www.samsung.com/

config VIDEO_MHL_V2
	bool "Samsung Mobile HD Link Interface"
	default n
	---help---
	Support for MHL(SII8240) version2 chipset driver. This is a new
	version of mhl which has the required functionality to support
	mhl 2.0 spec required. Say Y here if this support mhl_version2

config VIDEO_MHL_SII8246
        bool "Samsung Mobile HD Link Interface"
        default n
        ---help---
        Support for MHL(SII8246) version2 chipset driver. This is a new
        version of mhl which has the required functionality to support
        mhl 2.0 spec required. Say Y here if this support mhl_version2

config MHL_VERSION
	hex "Number of MHL Version"
	default 0x20
	---help---
	MHL Version
	For example, those device compliant
	with MHL Specification version 2.0
	shell set this MHL_VERSION to 0x20

config MUIC_SUPPORT_MULTIMEDIA_DOCK
	bool "support multimedia dock"
	default n
	---help---
	Support for multimedia dock
```

## drivers/w1/Kconfig
```kconfig
menuconfig W1
	tristate "Dallas's 1-wire support"
	depends on HAS_IOMEM
	---help---
	  Dallas' 1-wire bus is useful to connect slow 1-pin devices
	  such as iButtons and thermal sensors.

	  If you want W1 support, you should say Y here.

	  This W1 support can also be built as a module.  If so, the module
	  will be called wire.

if W1

config W1_CON
	depends on CONNECTOR
	bool "Userspace communication over connector"
	default y
	--- help ---
	  This allows to communicate with userspace using connector. For more
	  information see <file:Documentation/connector/connector.txt>.
	  There are three types of messages between w1 core and userspace:
	  1. Events. They are generated each time new master or slave device found
		either due to automatic or requested search.
	  2. Userspace commands. Includes read/write and search/alarm search commands.
	  3. Replies to userspace commands.

config W1_WORKQUEUE
	bool "Using kthread for checking w1 slave"
	default n
	help
	  This allows to start the WQ func. when w1 master is looking for slaves.

config W1_FAST_CHECK
	bool "Using fast check for checking w1 slave"
	default n
	help
	  This allows to start the WQ func. when w1 master is looking for slaves.

config W1_CF
	bool "Using cmd for find node"
	default n
	help
	  This allows to check the node.

config W1_SN
	bool "New node for checking SN"
	default n
	help
	  This allows to check the SN.

source drivers/w1/masters/Kconfig
source drivers/w1/slaves/Kconfig

endif # W1
```
