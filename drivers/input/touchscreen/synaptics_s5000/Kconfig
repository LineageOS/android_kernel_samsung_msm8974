## fs/ecryptfs/Kconfig
```kconfig
config ECRYPT_FS
	tristate "eCrypt filesystem layer support (EXPERIMENTAL)"
	depends on EXPERIMENTAL && KEYS && CRYPTO && (ENCRYPTED_KEYS || ENCRYPTED_KEYS=n)
	select CRYPTO_ECB
	select CRYPTO_CBC
	select CRYPTO_MD5
	select CRYPTO_SHA256
	help
	  Encrypted filesystem that operates on the VFS layer.  See
	  <file:Documentation/filesystems/ecryptfs.txt> to learn more about
	  eCryptfs.  Userspace components are required and can be
	  obtained from <http://ecryptfs.sf.net>.

	  To compile this file system support as a module, choose M here: the
	  module will be called ecryptfs.

config WTL_ENCRYPTION_FILTER
	bool "Enables filtering for some files not to encrypt on eCryptfs"
	default n
	depends on ECRYPT_FS
	help
	Modification of encrypted filesystem for SD card encryption

config ECRYPT_FS_VIRTUAL_FAT_XATTR
	bool "eCryptfs support on virtual FAT xattr"
	default n
	depends on ECRYPT_FS
	help
	  Modification of encrypted filesystem for virtual FAT xattr

config SDP
	bool "Enables SDP"
	default n
	depends on ECRYPT_FS
	help
	Sensitive Data Protection
	
config SDP_KEY_DUMP
	bool "SDP KEY DUMP"
	default n

config DLP
	bool "Enables DLP"
	default n
	depends on SDP
	help
	Data Loss Prevention

config FORCE_DISABLE_FIPS
	bool "Force disable FIPS config"
	default n
	help
	  Force disable FIPS config
```
