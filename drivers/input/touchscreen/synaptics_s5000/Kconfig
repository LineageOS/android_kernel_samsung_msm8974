## drivers/sensors/Kconfig
```kconfig
#
# Sensor  drivers configuration
#
menuconfig SENSORS
	bool "Sensor devices"
	help
	  Say Y here, and a list of sensors drivers will be displayed.
	  Everything that didn't fit into the other categories is here. This option
	  doesn't affect the kernel.

	  If unsure, say Y.

config SENSORS_BMI055
	tristate "BMI055 Combo Sensor Driver"
	depends on I2C
	default n
	help
	  If you say yes here you get support for Bosch-Sensortec's
	  BMI055 Acceleration & Gyroscope Sensor.

config SENSORS_BMI058
	tristate "BMI058 Combo Sensor Driver"
	depends on I2C
	default n
	help
	  If you say yes here you get support for Bosch-Sensortec's
	  BMI058 Acceleration & Gyroscope Sensor.

config SENSORS_AK8963C
	tristate "AK8963C compass support"
	default n
	depends on I2C
	help
	  If you say yes here you get support for Asahi Kasei's
	  orientation sensor AK8963.

config SENSORS_AK09911C
	tristate "AK09911C compass support"
	default n
	depends on I2C
	help
	  If you say yes here you get support for Asahi Kasei's
	  orientation sensor AK09911C.

config SENSORS_CM3323
	depends on I2C
	tristate "CM3323 driver"
	default n
	help
	  Say Y here if you use cm3323.
	  This option enables RGB sensors using
	  Capella cm3323 device driver.

	  Say N here if you do not use cm3323.

config SENSORS_CM36653
	depends on I2C
	tristate "CM36653 driver"
	default n
	help
	  Say Y here if you use cm36653.
	  This option enables RGB sensors using
	  Capella cm36653 device driver.

	  Say N here if you do not use cm36653.

config SENSORS_CM36686
	depends on I2C
	tristate "CM36686 driver"
	default n
	help
	  This option enables proximity & light sensors using CM36686 driver.

config SENSORS_CM36686_LEDA_EN_GPIO
	depends on I2C
	tristate "CM36686 leda_en controlled by GPIO"
	default n
	help
	  This option enables leda_en controlled by GPIO using CM36686 driver.

config SENSORS_GP2A030A
	depends on I2C
	tristate "GP2A030A Light Driver"
	default n
	help
	  Say Y here if you use GP2A030A.
	  This option enables optial sensors using
	  Sharp GP2A030A device driver.

	  Say N here if you do not use GP2A030A.

config SENSORS_GP2A030A_PROX
	depends on SENSORS_GP2A030A
	tristate "GP2A030A Proximity Driver"
	default n
	help
	  Say Y here if you use GP2A030A.
	  This option enables optial sensors using
	  Sharp GP2A030A device driver.

	  Say N here if you do not use GP2A030A.

config SENSORS_ADPD142
	depends on I2C
	tristate "ADI hrm sensor driver"
	default n
	help
	  This option enables hrm sensors using adpd142 driver.


config SENSORS_TMD3782S
	depends on I2C
	tristate "SENSORS_TMD3782S"
	default n
	help
	  Say Y here if you use TAOS_TMD3782S.
	  This option enables optial sensors using
	  Sharp TAOS_TMD3782S device driver.

config SENSORS_K2HH
	depends on I2C
	tristate "SENSORS_K2HH"
	default n
	help
	  Say Y here if you use SENSORS_K2HH.
	  This option enables accelerometer sensors using
	  STMicroelectronic K2HH device driver.

config SENSORS_SX9500
	depends on I2C
	tristate "SX9500 driver"
	default n
	help
	  Say Y here if you use sx9500.
	  This option enables grip sensors using
	  SemTech sx9500 device driver.

	  Say N here if you do not use sx9500.

config SENSORS_GRIP_ADJDET
	depends on I2C
	tristate "GRIP sensor adj cable detect"
	default n
	help
	  GRIP sensor adj cable detect

config SENSORS_SX9500_REGULATOR_ONOFF
	tristate "GRIP sensor regulator onoff function"
	default n
	help
	  GRIP sensor regulator onoff

config SENSORS_SX9500_INIT_TOUCH_THRESHOLD
	int "SX9500 Grip sensor threshold for init touch"
	depends on SENSORS_SX9500
	default "3000"
	help
	  This value is the standard of init touch using
	  SemTech sx9500 device driver.

config SENSORS_SX9500_NORMAL_TOUCH_THRESHOLD
	int "SX9500 Grip sensor threshold for normal touch"
	depends on SENSORS_SX9500
	default "17"
	help
	  This value is the standard of normal touch using
	  SemTech sx9500 device driver.

config SENSORS_BMA254
	tristate "BMA254 acceleration sensor support"
	depends on I2C
	default n
	help
	  If you say yes here you get support for Bosch Sensortec's
	  acceleration sensors BMA254.

config SENSORS_POWERCONTROL
	tristate "Sensors power control"
	default n
	help
	  Say Y here to control power supply for drivers.

config SENSORS_GP2A_VDDCONTROL
	tristate "Sensors GP2A VDD control"
	default n
	help
	  Say Y here to control power vdd supply for drivers.

config BMA254_SMART_ALERT
	depends on I2C
	tristate "bma254 smart alert"
	default n
	help
	  This option enables bma254 smart alert function.

config SENSORS_GP2A002
	tristate "GP2A002 proximity sensor support"
	depends on I2C
	default n
	help
	  If you say yes here you get support for sharp Sensortec's
	  proximity sensors GP2A002.

config SENSORS_POWER_EN
	tristate "Sensors power control"
	default n
	help
	  Say Y here to enable power supply for drivers.

config SENSORS_K3DH
	tristate "K3DH acceleration sensor support"
	depends on I2C
        default n
	help
	  Driver for STMicroelectronic K3DH accelerometer.

config SENSOR_K3DH_INPUTDEV
	bool "K3DH acceleration sensor input dev support"
	depends on SENSORS_K3DH
        default n
	help
	  Say Y here if you use K3DH.
	  This option enables accelerometer sensor using
	  K3DH device driver.

	  Say N here if you do not use K3DH.

config INPUT_MPU6500
	bool "Invensense MPU-6500 sensor"
	default n
	help
	  Say Y here if you want support for the MPU-6500 sensor
	  device.

	  To compile this driver as a module, choose M here: the
	  module will be called MPU6500.

config MPU6500_ADJUST_SMART_ALERT
	bool "MPU6500 sensor smart alert adjustment"
	default n
	help
	  Say Y here if you want to adjust smart alert for mpu6500 sensor

config INPUT_MPU6500_SELFTEST
	bool "Self-test of Invensense MPU-6500 sensor"
	default n
	help
	  Say Y here if you want support for self-test of the MPU-6500 sensor
	  device.

	  To compile this driver as a module, choose M here: the
	  module will be called MPU6500.

config INPUT_MPU6500_POLLING
	bool "Polling-mode of Invensense MPU-6500 sensor"
	default n
	help
	  Say Y here if you want support for polling-mode of the MPU-6500 sensor
	  device.

	  To compile this driver as a module, choose M here: the
	  module will be called MPU6500.

config SENSORS_TMD27723
	depends on I2C
	tristate "TMD27723 driver"
	default n
	help
	   This option enables proximity & light sensors using TMD27723 driver.

config INPUT_YAS_SENSORS
	bool "Sensors Support"
	default n
	help
	  Say Y to enable Sensors support.  This allows control of supported
	  Sensors.
config SENSORS_BMA255
	tristate "YAS Acceleration Sensor- BMA255"
	depends on I2C
	default n
	help
	  Say Y here if you want support for the BMA255 sensor
	  device.

	  To compile this driver as a module, choose M here: the
	  module will be called BMA255.
config SENSORS_CORE
         bool "sensors_core"
         depends on I2C
config SENSORS_HSCDTD008A
	depends on I2C
	tristate "hscd alps HSCDTD008A"
	default n
	help
	  This option enables hscd alps HSCDTD008A mag driver

config SENSORS_CM36651
	depends on I2C && GENERIC_GPIO
	tristate "Capella CM3663 ambient light and proximity sensor"
	default n
	help
	  This option enables proximity & light sensors using CM3663 driver.

config SENSORS_MAX86900
	tristate "MAXIM MAX86900 HRM Sensor"
	default n
	depends on I2C && SYSFS
	help
	  If you say yes here you get support for the MAX86900
	  HRM sensor.
	  This driver can also be built as a module.  If so, the module
	  will be called max86900.

config SENSORS_K303C
	depends on I2C
	tristate "ST K303C accel,magnetic combo"
	default n
	help
	  This option enables st k303c accel and mag driver

source "drivers/sensors/yas532/Kconfig"
```

## drivers/sensors/yas532/Kconfig
```kconfig
config SENSORS_YAS532
	bool "Yamaha YAS532 sensor"
	default n
	help
	  Say Y here if you want support for the YAS532 sensor
	  device.

	  To compile this driver as a module, choose M here: the
	  module will be called YAS532.

config INPUT_YAS_MAGNETOMETER_POSITION
	int "YAS Geomagnetic Sensor Mounting Position on Board"
	default "0"
	help
	  Chip mounting position (pin 1).
	  0: top, upper-left
	  1: top, upper-right
	  2: top, lower-right
	  3: top, lower-left
	  4: bottom, upper-left
	  5: bottom, upper-right
	  6: bottom, lower-right
	  7: bottom, lower-left
```

## drivers/staging/android/Kconfig
```kconfig
menu "Android"

config ANDROID
	bool "Android Drivers"
	default N
	---help---
	  Enable support for various drivers needed on the Android platform

if ANDROID

config ANDROID_BINDER_IPC
	bool "Android Binder IPC Driver"
	default n

config ANDROID_BINDER_IPC_32BIT
	bool "Use old 32-bit binder api"
	depends on !64BIT
	---help---
	  Enable to support an old 32-bit Android user-space. Breaks the new
	  Android user-space.

config ANDROID_BINDER_DEVICES
	string "Android Binder devices"
	depends on ANDROID_BINDER_IPC
	default "binder,hwbinder,vndbinder"
	---help---
	  Default value for the binder.devices parameter.

	  The binder.devices parameter is a comma-separated list of strings
	  that specifies the names of the binder device nodes that will be
	  created. Each binder device has its own context manager, and is
	  therefore logically separated from the other devices.

config ASHMEM
	bool "Enable the Anonymous Shared Memory Subsystem"
	default n
	depends on SHMEM || TINY_SHMEM
	help
	  The ashmem subsystem is a new shared memory allocator, similar to
	  POSIX SHM but with different behavior and sporting a simpler
	  file-based API.

	  It is, in theory, a good memory allocator for low-memory devices,
	  because it can discard shared memory units when under memory pressure.

config ANDROID_LOGGER
	tristate "Android log driver"
	default n

config LOGCAT_SIZE
	int "Adjust android log buffer sizes"
	default 512
	depends on ANDROID_LOGGER
	help
	  Set logger buffer size. Enter a number greater than zero.
	  Any value less than 256 is recommended. Reduce value to save kernel static memory size.

config ANDROID_PERSISTENT_RAM
	bool
	depends on HAVE_MEMBLOCK
	select REED_SOLOMON
	select REED_SOLOMON_ENC8
	select REED_SOLOMON_DEC8

config ANDROID_RAM_CONSOLE
	bool "Android RAM buffer console"
	depends on !S390 && !UML && HAVE_MEMBLOCK
	select ANDROID_PERSISTENT_RAM
	default n

config PERSISTENT_TRACER
	bool "Persistent function tracer"
	depends on HAVE_FUNCTION_TRACER
	select FUNCTION_TRACER
	select ANDROID_PERSISTENT_RAM
	help
	  persistent_trace traces function calls into a persistent ram
	  buffer that can be decoded and dumped after reboot through
	  /sys/kernel/debug/persistent_trace.  It can be used to
	  determine what function was last called before a reset or
	  panic.

	  If unsure, say N.

config ANDROID_TIMED_OUTPUT
	bool "Timed output class driver"
	default y

config ANDROID_TIMED_GPIO
	tristate "Android timed gpio driver"
	depends on GENERIC_GPIO && ANDROID_TIMED_OUTPUT
	default n

config ANDROID_LOW_MEMORY_KILLER
	bool "Android Low Memory Killer"
	default N
	---help---
	  Register processes to be killed when memory is low

config ANDROID_LOW_MEMORY_KILLER_AUTODETECT_OOM_ADJ_VALUES
	bool "Android Low Memory Killer: detect oom_adj values"
	depends on ANDROID_LOW_MEMORY_KILLER
	default y
	---help---
	  Detect oom_adj values written to
	  /sys/module/lowmemorykiller/parameters/adj and convert them
	  to oom_score_adj values.

config SEC_OOM_KILLER
	bool "Android OOM Killer"
	default n
	help
	  klaatu@samsung
	  This enables 'Android-Style oom-killer'
	  The way to select victim by oom-killer provided by
	  linux kernel is totally different from android policy.
	  Hence, it makes more sense that we select the oom victim
	  as android does when LMK is invoked.

config SEC_DEBUG_LMK_MEMINFO
	bool "Show Meminfo when lmk invoked"
	depends on !SAMSUNG_PRODUCT_SHIP
	default n
	help
	  Show memory information when lmk kills process

config SEC_DEBUG_LMK_COUNT_INFO
	bool "Record LMK execution count"
	default n
	help
	  Show LMK execution count information when lmk invoked

config EXCLUDE_LRU_LIVING_IN_CMA
	bool "Exclude LRU living is CMA"
	depends on CMA_PAGE_COUNTING
	default n
	help
	  Number of LRU pages living in CMA area should be excluded
          so that LMK will kill a process to release memory pressure
	  This feature based on reclamation prohibition for CMA area.

source "drivers/staging/android/switch/Kconfig"

config RUNTIME_COMPCACHE
	bool "Android rtcc v3"
	depends on ZRAM && ANDROID
	default n
	help
	  This option enables rtcc v3 for android

config KSWAPD_NOSWAP
	bool "Disable swap in kswapd"
	depends on RUNTIME_COMPCACHE
	default n
	help
	  This option controls swap action in kswapd

config SAMP_HOTNESS
	bool "Kill hidden process by hotness"
	default n
	help
	  This option change kill hidden process policy in LMK

config ANDROID_INTF_ALARM_DEV
	bool "Android alarm driver"
	depends on RTC_CLASS
	default n
	help
	  Provides non-wakeup and rtc backed wakeup alarms based on rtc or
	  elapsed realtime, and a non-wakeup alarm on the monotonic clock.
	  Also exports the alarm interface to user-space.

endif # if ANDROID

endmenu
```

## drivers/staging/iio/grip/Kconfig
```kconfig
#
# Light sensors
#
menu "Grip sensors"

config SENSORS_ASP01_IIO
	depends on I2C && GPIOLIB
	tristate "ASP01 Grip Sensor Support"
	default n
	help
	  Say Y here if you use ASP01.
	  This option enables Grip sensors using
	  AD SEMICON ASP01 device driver.

	  Say N here if you do not use ASP01.

endmenu
```

## drivers/staging/iio/imu/inv_mpu/Kconfig
```kconfig
#
# inv-mpu-iio driver for Invensense MPU devices and combos
#

config INV_MPU_IIO_MPL
	tristate "Invensense MPU devices"
	depends on I2C && SYSFS && IIO && IIO_KFIFO_BUF && IIO_TRIGGER && !INV_MPU
	default n
	help
	  This driver supports the Invensense MPU devices.
	  This includes MPU6050/MPU3050/MPU9150/ITG3500/MPU6500/MPU9250.
	  This driver can be built as a module. The module will be called
	  inv-mpu-iio.

config INV_IIO_MPU3050_ACCEL_SLAVE_BMA250
	bool  "Invensense MPU3050 slave accelerometer device for bma250"
	depends on INV_MPU_IIO
	default n
	help
	  This is slave device enable MPU3050 accelerometer slave device.
	  Right now, it is only bma250. For other acceleromter device,
	  it can be added to this menu if the proper interface is filled.
	  There are some interface function to be defined.

config INPUT_MPU6500_SELFTEST
	bool "Self-test of Invensense MPU-6500 sensor"
	default n
	help
	  Say Y here if you want support for self-test of the MPU-6500 sensor
	  device.

	  To compile this driver as a module, choose M here: the
	  module will be called MPU6500.
```
