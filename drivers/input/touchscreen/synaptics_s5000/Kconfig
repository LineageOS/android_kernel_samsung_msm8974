## drivers/input/touchscreen/synaptics_s5000/Kconfig
```kconfig
#
# SYNAPTICS TOUCH driver configuration
#
config TOUCHSCREEN_SYNAPTICS_I2C_RMI_S5000
	tristate "Synaptics i2c touchscreen"
	depends on I2C
	help
	  This enables support for Synaptics RMI over I2C based touchscreens.
	  use Synaptics S5000, S5050, S5707, S5708 IC.
```

## drivers/input/touchscreen/wacom_hl/Kconfig
```kconfig
#
# Wacom configuration
#

config INPUT_WACOM_HL
	tristate "Wacom penabled i2c touchscreen"
	depends on I2C
	help
	  Say Y here if you have an Wacom penabled i2c touchscreen
	  connected to your system.

	  If unsure, say N.

	  To compile this driver as a module, choose M here: the
	  module will be called wacom_GXXX.

config EPEN_WACOM_G5SP
	tristate "Wacom G5SP penabled i2c touchscreen"
	depends on I2C
	help
	  Say Y here if you have an Wacom G5SP penabled i2c touchscreen
	  connected to your system.

	  If unsure, say N.

	  To compile this driver as a module, choose M here: the
	  module will be called wacom_G5SP.

config EPEN_WACOM_G9PM
	tristate "Wacom G9PM penabled i2c touchscreen"
	depends on I2C
	help
	  Say Y here if you have an Wacom G9PM penabled i2c touchscreen
	  connected to your system.

	  If unsure, say N.

	  To compile this driver as a module, choose M here: the
	  module will be called wacom_G9PM.

config EPEN_WACOM_G9PL
	tristate "Wacom G9PL penabled i2c touchscreen"
	depends on I2C
	help
	  Say Y here if you have an Wacom G9PL penabled i2c touchscreen
	  connected to your system.

	  If unsure, say N.

	  To compile this driver as a module, choose M here: the
	  module will be called wacom_G9PL.

config EPEN_WACOM_G9PLL
	tristate "Wacom G9PLL penabled i2c touchscreen"
	depends on I2C
	help
	  Say Y here if you have an Wacom G9PLL penabled i2c touchscreen
	  connected to your system.

	  If unsure, say N.

	  To compile this driver as a module, choose M here: the
	  module will be called wacom_G9PLL.

config EPEN_WACOM_G10PM
	tristate "Wacom G10PM penabled i2c touchscreen"
	depends on I2C
	help
	  Say Y here if you have an Wacom G10PM penabled i2c touchscreen
	  connected to your system.

	  If unsure, say N.

	  To compile this driver as a module, choose M here: the
	  module will be called wacom_G10PM.
```

## drivers/irda/Kconfig
```kconfig
#
# IR_LED
#
menu "IRDA devices"

config IR_REMOCON_MC96FR116
	bool "Micom MC96FR116 ABOV based IR LED driver"
	depends on I2C
	default n
	help
	  Say Y here to enable the I2C based IRDA for MC96FR116C chip.

config IRDA_COMMON_LDO
	bool "Micom MC96FR116 ABOV based IR LED driver"
	depends on I2C
	default n
	help
	  Say Y here to enable the I2C based IRDA for MC96FR116C chip for Kmini

config ANDROID_FFF
	bool "IRDA new Code for android 4.4.4"
	default n
	help
	  Say Y here to enable the new code and CTS fix for android 4.4.4

endmenu
```

## drivers/media/isdbt/Kconfig
```kconfig
config ISDBT
	bool "isdbt"
	default n

choice
	depends on ISDBT
	prompt "isdbt driver"
	default ISDBT_FC8150

	config ISDBT_FC8150
		bool "ISDBT_FC8150"

	config ISDBT_FC8300
		bool "ISDBT_FC8300"
		
	config ISDBT_FC8300_SPI
		bool "ISDBT_FC8300_SPI"	
		
	config ISDBT_FC8150_SPI
		bool "ISDBT_FC8150_SPI"
	
	config ISDBT_FC8150_HKDI
		bool "ISDBT_FC8150_HKDI"
endchoice

config ISDBT_SPMI
	bool "isdbt spmi"
	default n

config ISDBT_ANT_DET
	bool "isdbt antenna detection"
	default n

config ISDBT_F_TYPE_ANTENNA
	bool "isdbt F type antenna"
	default n
```

## drivers/media/isdbtmm/Kconfig
```kconfig
#
# ISDB-TMM tuner driver
#

config ISDBTMM
	bool "ISDB-TMM tuner"
	default n
	---help---
	  Enable the ISDB-TMM tuner driver for mmbi/DTV

config TMM_ANT_DET
	depends on ISDBTMM
	bool "TMM antenna detector"

config TMM_CHG_CTRL
	depends on ISDBTMM
	bool "TMM charging input current reduce"
```

## drivers/media/mtv/Kconfig
```kconfig
#
# MTV config states
#

############################################
# Define following features for MOBILETV(MTV) in defconfig file
############################################
# ex..
# MTV function - CONFIG_MTV
# AP Vendor - CONFIG_MTV_QUALCOMM
# Chip Vendor - CONFIG_MTV_MTV222
# Interface - CONFIG_MTV_SPI 
############################################

config MTV
	bool "ISDB-T"
	default n
	help
	  This allows MTV.
	  This module is designed for SPI or TSIF.
	  Select chipset and interface

choice
	depends on MTV
	prompt "AP vendor"
	default MTV_QUALCOMM
	config MTV_QUALCOMM
		bool "Qualcomm"
	config MTV_SLSI
		bool "S.LSI"
	config MTV_MARVELL
		bool "Marvell"
endchoice

choice
	depends on MTV
	prompt "chip"
	default MTV_FC8300
	config MTV_FC8150
		bool "FCI8150"
	config MTV_FC8300
		bool "FCI8300"
	config MTV_MTV222
		bool "MTV222"
	config MTV_MTV23x
		bool "MTV23x"
endchoice

config MTV_SPI
	depends on MTV
	default n
	bool "SPI"

config MTV_EBI
	depends on MTV
	default n
	bool "EBI"
	
config MTV_TSIF
	depends on MTV
	default n
	bool "TSIF"

config MTV_I2C
	depends on MTV
	default n
	bool "I2C"

config MTV_SIMUL
	depends on MTV
	default n
	bool "Simulation"

config MTV_DEBUG
	depends on MTV
	default n
	bool "isdbt debugfs"

config MTV_ANT_DET
	depends on MTV
	default n
	bool "isdbt antenna detector"
```

## drivers/misc/dualwave/Kconfig
```kconfig
comment "Altera FPGA firmware download module"

config DUALWAVE
    bool "DUALWAVE enable"
	default y
```

## drivers/misc/modem_if/Kconfig
```kconfig
menuconfig SEC_MODEM
	bool "Samsung Mobile Modem Interface"
	default n
	---help---
	  Samsung Modem Interface Driver.

	  21u021u0

config GSM_MODEM_SPRD6500
	bool "modem chip : GSM_MODEM_SPRD6500"
	depends on SEC_MODEM
	default n

config LINK_DEVICE_SPI
	bool "modem driver link device SPI"
	depends on SEC_MODEM
	default n

config WORKQUEUE_FRONT
	bool "IPC: SPI workqueue front"
	depends on SEC_MODEM
	default n

config SEC_DUAL_MODEM_MODE
	bool "sec dual modem mode"
	depends on SEC_MODEM
	default n

config SIM_SLOT_SWITCH
	bool "SIM_SLOT_SWITCH"
	depends on SEC_MODEM
	default n

config GSM_MODEM_GG_DUOS
	bool "GSM_MODEM_GG_DUOS"
	depends on SEC_MODEM
	default n
```

## drivers/motor/Kconfig
```kconfig
menuconfig SS_VIBRATOR
	tristate "SS_VIBRATOR"
	default n
	help
	  Say Y to enable SAMSUNG_VIBRATOR support.

config MOTOR_DRV_MAX77803
	tristate "Maxim MAX77803 motor"
	default n

	depends on MFD_MAX77803

config MOTOR_DRV_MAX77804K
	tristate "Maxim MAX77804K motor"
	default n

	depends on MFD_MAX77804K

config MOTOR_DRV_MAX77828
	tristate "Maxim MAX77828 motor"
	default n
	depends on MFD_MAX77828

config MOTOR_DRV_MAX77888
	tristate "Maxim MAX77888 motor"
	default n
	depends on MFD_MAX77888

config MOTOR_DRV_ISA1400
	tristate "ISA1400 motor"
	default n
	depends on I2C
	help
	  Say Y to enalbe the ISA1400 IC.

config MOTOR_DRV_DRV2603
	tristate "DRV2603 motor"
	default n
	help
	  Say Y to enalbe the DRV2603 IC.

config MOTOR_ISA1000
	tristate "ISA1000 motor"
	default n
	depends on SS_VIBRATOR 

#
# vibrator controlled by PMIC regualtor configuration
#
menuconfig MSM_VIBRATOR
	tristate "MSM_VIBRATOR"
	default n
	help
	Say Y to enable MSM_VIBRATOR support.

menuconfig MAX77826_VIBRATOR
	tristate "MAX77826_VIBRATOR"
	default n
	help
	  Say Y to enable MAX77826_VIBRATOR support.

config CONFIG_HAPTIC_ISA1200
	tristate "ISA1200 motor"
	default n
	depends on I2C
	help
	  Say Y to enable the ISA1200 IC.
```

## drivers/qsc/Kconfig
```kconfig
config MACH_BAFFIN2_SGLTE
 	bool "MSM8226 BAFFINE2 CHN CMCC"
 	help
    Support for the Samsung MS01 device
```

## drivers/sensorhub/Kconfig
```kconfig
#
# sensor drivers configuration
#

config SENSORS_SSP_ATMEL
	tristate "Sensors ssp ATMEL"
	default n
	depends on I2C
	help
	  ssp driver for ATMEL sensor hub.
          If you say yes here you get ssp support for
	  sensor hub.
	  To compile this driver as a module, choose M here: the
	  module will be called ssp.

config SENSORS_SSP_STM
	tristate "Sensors ssp STM"
	default n
	depends on SPI
	help
	  ssp driver for STM sensor hub.
          If you say yes here you get ssp support for
	  sensor hub.
	  To compile this driver as a module, choose M here: the
	  module will be called ssp.

config SENSORS_SSP_STM_32F
	tristate "Sensors ssp STM"
	default n
	depends on SPI
	help
	  ssp driver for STM sensor hub.
          If you say yes here you get ssp support for
	  sensor hub.
	  To compile this driver as a module, choose M here: the
	  module will be called ssp.

config SENSORS_SSP_STM_HESTIA
	tristate "Sensors ssp STM"
	default n
	depends on SPI
	help
	  ssp driver for STM sensor hub.
          If you say yes here you get ssp support for
	  sensor hub.
	  To compile this driver as a module, choose M here: the
	  module will be called ssp.

source "drivers/sensorhub/atmel/Kconfig"
source "drivers/sensorhub/stm/Kconfig"
source "drivers/sensorhub/stm32f/Kconfig"
source "drivers/sensorhub/stm_hestia/Kconfig"
```

## drivers/sensorhub/stm_patek/factory/Kconfig
```kconfig
#
# sensor drivers configuration
#
config SENSORS_SSP_LSM330
	tristate "Sensors ssp lsm330"
	default n
	depends on SPI
	help
	  lsm330 file for factory test in ssp driver.
          If you say yes here you get lsm330 support for
	  factory test.
	  To compile this driver as a module, choose M here: the
	  module will be called ssp.

config SENSORS_SSP_CM36651
	tristate "Sensors ssp cm36651"
	default n
	depends on SPI
	help
	  cm36651 file for factory test in ssp driver.
          If you say yes here you get cm36651 support for
	  factory test.
	  To compile this driver as a module, choose M here: the
	  module will be called ssp.

config SENSORS_SSP_CM3320
	tristate "Sensors ssp cm3320"
	default n
	depends on SPI
	help
	  cm3320 file for factory test in ssp driver.
          If you say yes here you get cm3320 support for
	  factory test.
	  To compile this driver as a module, choose M here: the
	  module will be called ssp.

config SENSORS_SSP_MAX88920
	tristate "Sensors ssp max88920"
	default n
	depends on SPI
	help
	  max88005 file for factory test in ssp driver.
          If you say yes here you get max88005 support for
	  factory test.
	  To compile this driver as a module, choose M here: the
	  module will be called ssp.

config SENSORS_SSP_MAX88921
	tristate "Sensors ssp max88921"
	default n
	depends on SPI
	help
	  max88005 file for factory test in ssp driver.
          If you say yes here you get max88005 support for
	  factory test.
	  To compile this driver as a module, choose M here: the
	  module will be called ssp.

config SENSORS_SSP_TMG399X
	tristate "Sensors ssp tmg399x"
	default n
	depends on SPI
	help
	  max88005 file for factory test in ssp driver.
          If you say yes here you get tmg399x support for
	  factory test.
	  To compile this driver as a module, choose M here: the
	  module will be called ssp.

config SENSORS_SSP_MPU6500
	tristate "Sensors ssp mpu6500"
	default n
	depends on SPI
	help
	  mpu6500 file for factory test in ssp driver.
          If you say yes here you get mpu6500 support for
	  factory test.
	  To compile this driver as a module, choose M here: the
	  module will be called ssp.

config SENSORS_SSP_BMP182
	tristate "Sensors ssp bmp182"
	default n
	depends on SPI
	help
	  bmp182 file for factory test in ssp driver.
          If you say yes here you get bmp182 support for
	  factory test.
	  To compile this driver as a module, choose M here: the
	  module will be called ssp.

config SENSORS_SSP_AT32UC3L0128
	tristate "Sensors ssp at32uc3l0128"
	default n
	depends on SPI
	help
	  at32uc3l0128 file for factory test in ssp driver.
          If you say yes here you get at32uc3l0128 support for
	  factory test.
	  To compile this driver as a module, choose M here: the
	  module will be called ssp.

config SENSORS_SSP_ATUC128L5HAR
	tristate "Sensors ssp atuc128l5har"
	default n
	depends on SPI
	help
	  atuc128l5har file for factory test in ssp driver.
          If you say yes here you get atuc128l5har support for
	  factory test.
	  To compile this driver as a module, choose M here: the
	  module will be called ssp.

config SENSORS_SSP_SHTC1
	tristate "Sensors ssp shtc1"
	default n
	depends on SPI
	help
	  shtc1 file for factory test in ssp driver.
          If you say yes here you get shtc1 support for
	  factory test.
	  To compile this driver as a module, choose M here: the
	  module will be called ssp.

config SENSORS_SSP_MOBEAM
	tristate "Sensors ssp mobeam"
	default n
	depends on SPI
	help
	  mobeam file for ssp driver.
          If you say yes here you get mobeam support using TMG399x.
	  To compile this driver as a module, choose M here: the
	  module will be called ssp.
```
