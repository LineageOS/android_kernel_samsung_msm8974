/* Copyright (c) 2013, The Linux Foundation. All rights reserved.
 *
 * This program is free software; you can redistribute it and/or modify
 * it under the terms of the GNU General Public License version 2 and
 * only version 2 as published by the Free Software Foundation.
 *
 * This program is distributed in the hope that it will be useful,
 * but WITHOUT ANY WARRANTY; without even the implied warranty of
 * MERCHANTABILITY or FITNESS FOR A PARTICULAR PURPOSE.  See the
 * GNU General Public License for more details.
 */

/include/ "../dsi_panel_samsung_wqhd_cmd_s6e3ha0_dualdsi.dtsi"
/include/ "../dsi_panel_samsung_octa_1080p_cmd_s6e3fa2.dtsi"
/include/ "../dsi_panel_samsung_octa_1080p_cmd_s6e3fa0.dtsi"
/include/ "../dsi_panel_magna_octa_hd_cmd_ea8064g.dtsi"
/include/ "../dsi_panel_magna_octa_1080p_cmd_ea8064g.dtsi"
/include/ "../dsi_panel_magna_octa_wxga_video_EA8061V.dtsi"