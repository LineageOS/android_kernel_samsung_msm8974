/* Copyright (c) 2012, The Linux Foundation. All rights reserved.
 *
 * This program is free software; you can redistribute it and/or modify
 * it under the terms of the GNU General Public License version 2 and
 * only version 2 as published by the Free Software Foundation.
 *
 * This program is distributed in the hope that it will be useful,
 * but WITHOUT ANY WARRANTY; without even the implied warranty of
 * MERCHANTABILITY or FITNESS FOR A PARTICULAR PURPOSE.  See the
 * GNU General Public License for more details.
 */

/ {
	haptic_pdata: max77828-haptic{
		haptic,mode = <1>;
                haptic,divisor = <128>;
        };

	i2c@13 {
		cell-index = <13>;
		compatible = "i2c-gpio";
		gpios = <&msmgpio 60 0 /* sda */
			 &msmgpio 61 0 /* scl */
			 >;
		i2c-gpio,delay-us = <2>;
		#address-cells = <1>;
		#size-cells = <0>;

		max77828@49 {
			compatible = "max77828,i2c";
			reg = <0x49>;
			interrupt-parent = <&msmgpio>;
			interrupts = <102 0>;
			max77828,irq-gpio = <&msmgpio 102 0x00>;
			max77828,irq-base = <353>;
			max77828,wc-irq-gpio = <0>;
			max77828,wakeup = <1>;
			max77828,haptic =<&haptic_pdata>;
		};
	};
};
