/*
 * Copyright (c) 2012-2013, The Linux Foundation. All rights reserved.
 *
 * This program is free software; you can redistribute it and/or modify
 * it under the terms of the GNU General Public License version 2 and
 * only version 2 as published by the Free Software Foundation.
 *
 * This program is distributed in the hope that it will be useful,
 * but WITHOUT ANY WARRANTY; without even the implied warranty of
 * MERCHANTABILITY or FITNESS FOR A PARTICULAR PURPOSE.  See the
 * GNU General Public License for more details.
 */

&soc {

	aliases {
		spi5 = &spi_5;
	};
	spi_5: spi@f9927000 {
		compatible = "qcom,spi-qup-v2";
		cell-index = <5>;
		#address-cells = <1>;
		#size-cells = <0>;
		reg = <0xf9927000 0x1000>,
			<0xf9904000 0x19000>;
		reg-names = "spi_physical", "spi_bam_physical";
		interrupt-names = "spi_irq", "spi_bam_irq";
		interrupts = <0 99 0>, <0 238 0>;
		spi-max-frequency = <19200000>;

		qcom,gpio-mosi = <&msmgpio 23 0>;
		qcom,gpio-miso = <&msmgpio 24 0>;
		qcom,gpio-clk  = <&msmgpio 26 0>;
		qcom,gpio-cs0  = <&msmgpio 25 0>;

		qcom,infinite-mode = <0>;
		qcom,use-bam;
		qcom,ver-reg-exists;
		qcom,bam-consumer-pipe-index = <20>;
		qcom,bam-producer-pipe-index = <21>;
		qcom,master-id = <86>;

		vfsspi-spi@0 {
			compatible = "vfsspi,vfs61xx";
			reg = <0>;
			spi-max-frequency = <19200000>;
			vfsspi-sleepPin = <&msmgpio 57 0x00>;
			vfsspi-drdyPin = <&msmgpio 64 0x01>;
			vfsspi-ldoPin = <&msmgpio 130 0x00>;
			vfsspi-ldoPin2 = <&msmgpio 52 0x00>;
			/* vfsspi-ocpflag = <&msmgpio 144 0x00>; */
			vfsspi-ocpen = <&msmgpio 63 0x00>;
			vfsspi-ocpen-jpn = <&msmgpio 41 0x00>;
			vfsspi-mosipin = <23>;
			vfsspi-misopin = <24>;
			vfsspi-cspin = <25>;
			vfsspi-clkpin = <26>;
			vfsspi-orient = <1>;
			vfsspi-ldocontrol= <1>;
		};
	};

};
