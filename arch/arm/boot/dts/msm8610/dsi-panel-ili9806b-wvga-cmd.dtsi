/*---------------------------------------------------------------------------
 * This file is autogenerated file using gcdb parser. Please do not edit it.
 * Update input XML file to add a new entry or update variable in this file
 * VERSION = "1.0"
 *---------------------------------------------------------------------------*/
&mdss_mdp {
	/* ILI9806 panel */
	sec,mdss_dsi_ili9806b_ktd253_wvga_cmd {
		qcom,mdss-dsi-panel-name = "BOE_ILI9806B";
		qcom,cont-splash-enabled;
		qcom,mdss-dsi-panel-controller = <&mdss_dsi0>;
		qcom,mdss-dsi-panel-type = "dsi_cmd_mode";
		qcom,mdss-dsi-panel-destination = "display_1";
		qcom,mdss-dsi-panel-framerate = <60>;
		qcom,mdss-dsi-virtual-channel-id = <0>;
		qcom,mdss-dsi-stream = <0>;
		qcom,mdss-dsi-panel-width = <480>;
		qcom,mdss-dsi-panel-height = <800>;
		qcom,mdss-dsi-h-front-porch = <16>;
		qcom,mdss-dsi-h-back-porch = <4>;
		qcom,mdss-dsi-h-pulse-width = <2>;
		qcom,mdss-dsi-v-back-porch = <24>;
		qcom,mdss-dsi-v-front-porch = <62>;
		qcom,mdss-dsi-v-pulse-width = <1>;
		qcom,mdss-dsi-bpp = <24>;
		qcom,mdss-dsi-underflow-color = <0xff>;
		qcom,mdss-dsi-on-command = [
						/* SET EXTC */
						39 01 00 00 00 00 04
							FF FF 98 06
						/* interface setting */
						39 01 00 00 00 00 02
							BA 60
						/* GIP1 */
						39 01 00 00 00 00 16
							BC 01 12 61 FF 10 10 0B 13 32 
							73 FF FF 0E 0E 00 03 66 63 01 
							00 00
						/* GIP2 */
						39 01 00 00 00 00 09
							BD 01 23 45 67 01 23 45 67
						/* GIP3 */
						39 01 00 00 0A 00 0A
							BE 00 21 AB 60 22 22 22 22 22
						/* Voltage_EN */
						39 01 00 00 00 00 04
							ED 7F 0F 00
						/* Display setting */
						39 01 00 00 00 00 02
							B6 02
						/* Format setting */
						39 01 00 00 00 00 02
							3A 77
						/* Porch setting */
						39 01 00 00 00 00 03
							B5 3E 18
						/* Power setting */
						39 01 00 00 00 00 04
							C0 AB 0B 0A
						/* VGL setting */
						39 01 00 00 00 00 02
							FC 09
						/* MIPI setting */
						39 01 00 00 00 00 07
							DF 00 00 00 00 00 20
						/* DVDD setting */
						39 01 00 00 00 00 02
							F3 74
						/* Column inversion */
						39 01 00 00 00 00 04
							B4 00 00 00
						/* 480x840 */
						39 01 00 00 00 00 02
							F7 82
						/* Frequency */
						39 01 00 00 00 00 04
							B1 00 12 13
						/* Panel timing control */
						39 01 00 00 00 00 05
							F2 00 59 40 28
						/* Power control 2 */
						39 01 00 00 00 00 05
							C1 07 80 80 20
						/* 3-Gamma */
						39 01 00 00 00 00 02
							EA 03
						/* TE effect */
						39 01 00 00 00 00 02
							35 00
						/* Backward scan */
						39 01 00 00 00 00 02
							36 03
						/* Gamma 1 */
						39 01 00 00 00 00 11
							E0 00 06 0E 0B 0E 07 07 05 09 
							0C 16 10 0F 14 0C 00
						/* Gamma 2 */
						39 01 00 00 00 00 11
							E1 00 06 0D 0C 0D 06 07 05 08
							0B 15 0F 0E 13 0C 00
						/* 3-Gamma Macro adj */
						39 01 00 00 00 00 41
							E2 00 00 00 00 00 00 00 00 00
							00 00 00 00 00 00 00 00 00 00
							00 00 00 00 00 00 00 00 00 00
							00 00 00 00 00 00 00 00 00 00
							00 00 00 00 00 00 00 00 00 00
							00 00 00 00 00 00 00 00 00 00
							00 00 00 00 00
						/* 3-Gamma Macro adj */
						39 01 00 00 00 01 02
							E2 32 32 32 32 32 32 32 32 32
							32 32 32 32 32 32 32 32 32 32
							32 32 32 32 32 32 32 32 32 32
							32 32 32 32 32 32 32 32 32 32
							32 32 32 32 32 32 32 32 32 32
							32 32 32 32 32 32 32 32 32 32
							32 32 32 32 32 32 32 32 32 32
							32 32 32 32 32 32 32 32 32 32
							32 32 32 32 32 32 32 32 32 32
							32 32 32 32 32 32 32 32 32 32
							32 32 32 32 32 32 32 32 32 32
							32 32 32 32 32 32 32 32 32 32
							32 32 32 32 32 32 32 32 32 32
							32 32 32 32 32 32 32 32 32 32
							32 32 32 32 32 32 32 32 32 32
							32 32 32 32 32 32 32 32 32 32
							32 32 32 32 32 32 32 32 32 32
							32 32 32 32 32 32 32 32 32 32
							32 32 32 32 32 32 32 32 32 32
							32 32 32 32 32 32 32 32 32 32
							32 32 32 32 32 32 32 32 32 32
							32 32 32 32 32 32 32 32 32 32
							32 32 32 32 32 32 32 32 32 32
							32 32 32 32 32 32 32 32 32 32
							32 32 32 32 32 32 32 32 32 32
							32 32 32 32 32 32 32 00
						/* Display on */
						05 01 00 00 14 00 02
							29 00
						/* Sleep out */
						05 01 00 00 96 00 02
							11 00
					];
		qcom,mdss-dsi-off-command = [05 01 00 00 14 00 02 28 00
						05 01 00 00 96 00 02 10 00];
		qcom,mdss-dsi-on-command-state = "dsi_lp_mode";
		qcom,mdss-dsi-off-command-state = "dsi_lp_mode";
		qcom,mdss-dsi-h-sync-pulse = <0>;
		qcom,mdss-dsi-traffic-mode = "burst_mode";
		qcom,mdss-dsi-lane-map = "lane_map_3012";
		qcom,mdss-dsi-bllp-eof-power-mode;
		qcom,mdss-dsi-bllp-power-mode;
		qcom,mdss-dsi-lane-0-state;
		qcom,mdss-dsi-lane-1-state;
		qcom,mdss-dsi-panel-timings = [5D 12 0C  00 33 38 10 16 1E 03 04 00];
		qcom,mdss-dsi-t-clk-post = <0x22>;
		qcom,mdss-dsi-t-clk-pre = <0x3F>;
		qcom,mdss-dsi-bl-min-level = <1>;
		qcom,mdss-dsi-bl-max-level = <255>;
		qcom,mdss-dsi-mdp-trigger = "none";
		qcom,mdss-dsi-bl-pmic-control-type = "bl_ctrl_wled";
		qcom,mdss-dsi-reset-sequence = <1 5>, <0 10>, <1 120>;
	};
};
