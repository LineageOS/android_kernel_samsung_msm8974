/* Copyright (c) 2013, The Linux Foundation. All rights reserved.
 *
 * This program is free software; you can redistribute it and/or modify
 * it under the terms of the GNU General Public License version 2 and
 * only version 2 as published by the Free Software Foundation.
 *
 * This program is distributed in the hope that it will be useful,
 * but WITHOUT ANY WARRANTY; without even the implied warranty of
 * MERCHANTABILITY or FITNESS FOR A PARTICULAR PURPOSE.  See the
 * GNU General Public License for more details.
 */

/dts-v1/;

/include/ "msm8610-sec.dtsi"
/include/ "msm8610-v1-pm.dtsi"
/include/ "msm8610-sec-kanas3g-chn-ctc-r04.dtsi"
/include/ "sec-backlight-kanas3g-chn-ctc-r03.dtsi"
/include/ "msm8610-camera-sensor-kanas3g-chn-ctc-r00.dtsi"
/include/ "msm8610-regulator-kanas3g-chn-ctc.dtsi"
/include/ "dsi-panel-nt35502-wvga-video-kanas3g-ctc.dtsi"
/include/ "msm8610-rt8973-kanas3g-chn-ctc-r00.dtsi"

/ {
	model = "SAMSUNG KANAS3G CTC Project REV04 ";
	compatible = "qcom,msm8610-mtp", "qcom,msm8610", "qcom,mtp";
        qcom,msm-id = <0x9308FF01 4  0>;
        /* [31:24] chip-id, [23:16] platform-id, [15:8] national code, [7:0] operator
                revision, reserved */
};


