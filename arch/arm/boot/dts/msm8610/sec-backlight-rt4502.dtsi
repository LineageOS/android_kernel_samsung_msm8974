/* Copyright (c) 2013, The Linux Foundation. All rights reserved.
 *
 * This program is free software; you can redistribute it and/or modify
 * it under the terms of the GNU General Public License version 2 and
 * only version 2 as published by the Free Software Foundation.
 *
 * This program is distributed in the hope that it will be useful,
 * but WITHOUT ANY WARRANTY; without even the implied warranty of
 * MERCHANTABILITY or FITNESS FOR A PARTICULAR PURPOSE.  See the
 * GNU General Public License for more details.
 */

/ {
	backlight_rt4502: sec,backlight {
		compatible = "sec,leds-gpio-bkl";
		sec,led-ctrl = <&msmgpio 96 0>;
		linux,default-trigger = "bkl-trigger";
		sec,control-type="gpio_swing";
		sec,max-brightness-value = <255>;
		sec,min-brightness-value = <20>;
		sec,dimming-value = <31>;
		sec,max-brightness-in-blu-value = <32>;
		sec,brightness-table-len = <25>;
		sec,brightness-table = <
							20 31	/* Dimming */
							31 30
							42 29
							53 28
							64 27
							75 26
							86 25
							97 24
							108 23
							119 22
							130 21
							140 20	/* Default */
							149 19
							158 18
							167 17
							176 16
							185 15
							194 14
							203 13
							212 12
							221 11
							230 10
							239 9
							248 8
							255 7	/* Max */
							>;
	};
};

