/* Copyright (c) 2013, The Linux Foundation. All rights reserved.
 *
 * This program is free software; you can redistribute it and/or modify
 * it under the terms of the GNU General Public License version 2 and
 * only version 2 as published by the Free Software Foundation.
 *
 * This program is distributed in the hope that it will be useful,
 * but WITHOUT ANY WARRANTY; without even the implied warranty of
 * MERCHANTABILITY or FITNESS FOR A PARTICULAR PURPOSE.  See the
 * GNU General Public License for more details.
 */

/ {
	sec,backlight {
		compatible = "sec,leds-gpio-bkl";
		sec,led-ctrl = <&msmgpio 78 0>;
		linux,default-trigger = "bkl-trigger";
		sec,control-type="gpio_swing";
		sec,easyscale-address=<0x1A>;
		sec,max-brightness-value = <255>;
		sec,min-brightness-value = <31>;
		sec,dimming-value = <31>;
		sec,max-brightness-in-blu-value = <32>;
		sec,brightness-table-len = <26>;
		sec,brightness-table = <
							0 0x00
							20 0x20
							26 0x1F
							33 0x1E
							39 0x1D
							46 0x1C
							52 0x1B
							59 0x1A
							65 0x19
							72 0x18
							78 0x17
							84 0x16
							91 0x15
							97 0x14
							104 0x13
							110 0x12
							117 0x11
							123 0x10
							140 0x0F
							156 0x0E
							173 0x0D
							189 0x0C
							206 0x0B
							222 0x0A
							239 0x09
							255 0x08
							>;
	};
};

