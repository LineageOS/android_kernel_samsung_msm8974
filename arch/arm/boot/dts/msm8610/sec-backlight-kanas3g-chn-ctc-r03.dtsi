/* Copyright (c) 2013, The Linux Foundation. All rights reserved.
 *
 * This program is free software; you can redistribute it and/or modify
 * it under the terms of the GNU General Public License version 2 and
 * only version 2 as published by the Free Software Foundation.
 *
 * This program is distributed in the hope that it will be useful,
 * but WITHOUT ANY WARRANTY; without even the implied warranty of
 * MERCHANTABILITY or FITNESS FOR A PARTICULAR PURPOSE.  See the
 * GNU General Public License for more details.
 */

/ {
	sec,backlight {
		compatible = "sec,leds-gpio-bkl";
		sec,led-ctrl = <&msmgpio 59 0>;
		linux,default-trigger = "bkl-trigger";
		sec,control-type="gpio_swing";
		sec,max-brightness-value = <255>;
		sec,min-brightness-value = <30>;
		sec,dimming-value = <31>;
		sec,max-brightness-in-blu-value = <32>;
		sec,brightness-table-len = <30>;
		sec,brightness-table = <
								0	0
								30	31
								35	30
								40	29
								46	28
								52	27
								62	26
								72	25
								82	24
								92	23
								102 22
								112 21
								122 20
								132 19
								139 18
								146 18  //default
								153 16
								160 15
								167 14
								175 13
								183 12
								191 11
								199 10
								207 9
								215 8
								223 7
								231 6
								239 5
								247 4
								255 1
							>;
	};
};
