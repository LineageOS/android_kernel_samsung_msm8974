/* Copyright (c) 2013, The Linux Foundation. All rights reserved.
 *
 * This program is free software; you can redistribute it and/or modify
 * it under the terms of the GNU General Public License version 2 and
 * only version 2 as published by the Free Software Foundation.
 *
 * This program is distributed in the hope that it will be useful,
 * but WITHOUT ANY WARRANTY; without even the implied warranty of
 * MERCHANTABILITY or FITNESS FOR A PARTICULAR PURPOSE.  See the
 * GNU General Public License for more details.
 */

/*---------------------------------------------------------------------------
 * This file is autogenerated file using gcdb parser. Please do not edit it.
 * Update input XML file to add a new entry or update variable in this file
 * VERSION = "1.0"
 *---------------------------------------------------------------------------*/
&mdss_mdp {
	dsi_nt35502_wvga_vid: qcom,mdss_dsi_nt35502_wvga_video {
		qcom,mdss-dsi-panel-name = "INH_554CC0";
		qcom,mdss-dsi-panel-controller = <&mdss_dsi0>;
		qcom,mdss-dsi-panel-type = "dsi_video_mode";
		qcom,mdss-dsi-panel-destination = "display_1";
		qcom,mdss-dsi-panel-mode-gpio-state = "high";
		qcom,mdss-dsi-panel-framerate = <60>;
		qcom,mdss-dsi-virtual-channel-id = <0>;
		qcom,mdss-dsi-stream = <0>;
		qcom,mdss-dsi-panel-width = <480>;
		qcom,mdss-dsi-panel-height = <800>;
		qcom,mdss-dsi-h-front-porch = <110>;
		qcom,mdss-dsi-h-back-porch = <246>;
		qcom,mdss-dsi-h-pulse-width = <4>;
		qcom,mdss-dsi-h-sync-skew = <0>;
		qcom,mdss-dsi-v-back-porch = <12>;
		qcom,mdss-dsi-v-front-porch = <10>;
		qcom,mdss-dsi-v-pulse-width = <4>;
		qcom,mdss-dsi-h-left-border = <0>;
		qcom,mdss-dsi-h-right-border = <0>;
		qcom,mdss-dsi-v-top-border = <0>;
		qcom,mdss-dsi-v-bottom-border = <0>;
		qcom,mdss-dsi-bpp = <24>;
		qcom,mdss-dsi-underflow-color = <0xff>;
		qcom,mdss-dsi-border-color = <0>;
		qcom,mdss-dsi-on-command = [
						/* < Power Setting Sequence(1) > */
						39 01 00 00 00 00 06
							F0 55 AA 52 08 01

						39 01 00 00 00 00 02
							B0 08

						39 01 00 00 00 00 02
							B2 40

						39 01 00 00 00 00 02
							B3 28

						39 01 00 00 00 00 02
							B4 19

						39 01 00 00 00 00 02
							B5 54

						39 01 00 00 00 00 02
							B9 36

						39 01 00 00 00 00 02
							BA 26

						39 01 00 00 00 00 03
							BC A0 00

						39 01 00 00 00 00 03
							BD A0 00

						/* < Gamma Setting Sequence(3) > */
						39 01 00 00 00 00 11
							D1 00 61 00 75 00 7C 00 7F 00 86 00 C4 00 EF 01 35

						39 01 00 00 00 00 11
							D2 01 66 01 A7 01 D4 02 15 02 45 02 46 02 6D 02 95

						39 01 00 00 00 00 11
							D3 02 AB 02 C4 02 D4 02 E7 02 F4 03 04 03 10 03 21

						39 01 00 00 00 00 05
							D4 03 44 03 90

						39 01 00 00 00 00 11
							D5 00 61 00 75 00 7C 00 7F 00 86 00 C4 00 EF 01 35

						39 01 00 00 00 00 11
							D6 01 66 01 A7 01 D4 02 15 02 45 02 46 02 6D 02 95

						39 01 00 00 00 00 11
							D7 02 AB 02 C4 02 D4 02 E7 02 F4 03 04 03 10 03 21

						39 01 00 00 00 00 05
							D8 03 44 03 90

						39 01 00 00 00 00 11
							D9 00 61 00 75 00 7C 00 7F 00 86 00 C4 00 EF 01 35

						39 01 00 00 00 00 11
							DD 01 66 01 A7 01 D4 02 15 02 45 02 46 02 6D 02 95

						39 01 00 00 00 00 11
							DE 02 AB 02 C4 02 D4 02 E7 02 F4 03 04 03 10 03 21

						39 01 00 00 00 00 05
							DF 03 44 03 90

						39 01 00 00 00 00 11
							E0 00 1A 00 43 00 7C 00 7F 00 86 00 C4 00 EF 01 35

						39 01 00 00 00 00 11
							E1 01 66 01 A7 01 D4 02 15 02 45 02 46 02 6D 02 95

						39 01 00 00 00 00 11
							E2 02 AB 02 C4 02 D4 02 E7 02 F4 03 04 03 10 03 21

						39 01 00 00 00 00 05
							E3 03 6C 03 A4

						39 01 00 00 00 00 11
							E4 00 1A 00 43 00 7C 00 7F 00 86 00 C4 00 EF 01 35

						39 01 00 00 00 00 11
							E5 01 66 01 A7 01 D4 02 15 02 45 02 46 02 6D 02 95

						39 01 00 00 00 00 11
							E6 02 AB 02 C4 02 D4 02 E7 02 F4 03 04 03 10 03 21

						39 01 00 00 00 00 05
							E7 03 6C 03 A4

						39 01 00 00 00 00 11
							E8 00 1A 00 43 00 7C 00 7F 00 86 00 C4 00 EF 01 35

						39 01 00 00 00 00 11
							E9 01 66 01 A7 01 D4 02 15 02 45 02 46 02 6D 02 95

						39 01 00 00 00 00 11
							EA 02 AB 02 C4 02 D4 02 E7 02 F4 03 04 03 10 03 21

						39 01 00 00 00 00 05
							EB 03 6C 03 A4

						/* < Initializing Sequence(2) > */
						39 01 00 00 00 00 06
							F0 55 AA 52 08 00

						39 01 00 00 00 00 03
							B1 16 08

						39 01 00 00 00 00 03
							B4 08 50

						39 01 00 00 00 00 02
							B6 03

						39 01 00 00 00 00 03
							B7 70 70

						39 01 00 00 00 00 03
							B8 61 66

						39 01 00 00 00 00 02
							BC 02

						39 01 00 00 00 00 13
							C8 80 00 46 64 46 64 46 64 46 64 64 64 64 64 64 64 64 64

						39 01 00 00 00 00 06
							F0 55 AA 52 00 00

						39 01 00 00 00 00 05
							FF AA 55 25 01

						39 01 00 00 00 00 02
							6F 02

						39 01 00 00 00 00 02
							F4 57

						39 01 00 00 00 00 02
							6F 13

						39 01 00 00 00 00 02
							F2 16

						39 01 00 00 00 00 05
							FF AA 55 25 00

						39 01 00 00 00 00 02
							36 00

						39 01 00 00 00 00 02
							35 00

						/* < Display on Sequence> */
						39 01 00 00 78 00 02
							11 00

						39 01 00 00 0A 00 02
							29 00

			            /* Test Screen Mode */
			            /*
						39 01 00 00 00 00 06
							F0 55 AA 52 08 00

						39 01 00 00 00 00 05
							EE 87 78 02 40
			            */
					];
		qcom,mdss-dsi-off-command = [
						/* < Deep Sleep In Sequence > */
						39 01 00 00 00 00 02
							28 00

						39 01 00 00 46 00 02
							10 00

						39 01 00 00 00 00 02
							4F 01
					];
		qcom,mdss-dsi-on-command-state = "dsi_lp_mode";
		qcom,mdss-dsi-off-command-state = "dsi_lp_mode";
		qcom,mdss-dsi-h-sync-pulse = <1>;
		qcom,mdss-dsi-traffic-mode = "burst_mode";
		qcom,mdss-dsi-hfp-power-mode;
		qcom,mdss-dsi-hsa-power-mode;
		qcom,mdss-dsi-hbp-power-mode;
		qcom,mdss-dsi-bllp-eof-power-mode;
		qcom,mdss-dsi-bllp-power-mode;
		qcom,mdss-dsi-lane-0-state;
		qcom,mdss-dsi-lane-1-state;
		qcom,mdss-dsi-panel-timings = [8B 33 14 00 45 4A 19 37 23 03 04 00];
		qcom,mdss-dsi-t-clk-post = <0x04>;
		qcom,mdss-dsi-t-clk-pre = <0x1D>;
		qcom,mdss-dsi-bl-min-level = <1>;
		qcom,mdss-dsi-bl-max-level = <255>;
		qcom,mdss-dsi-dma-trigger = "trigger_sw";
		qcom,mdss-dsi-mdp-trigger = "none";
		qcom,mdss-dsi-bl-pmic-control-type = "bl_ctrl_wled";
		qcom,mdss-dsi-reset-sequence = <1 20>, <0 2>, <1 120>;
		qcom,mdss-pan-physical-width-dimension = <62>;
		qcom,mdss-pan-physical-height-dimension = <106>;
	};
};
