/* Copyright (c) 2013, The Linux Foundation. All rights reserved.
 *
 * This program is free software; you can redistribute it and/or modify
 * it under the terms of the GNU General Public License version 2 and
 * only version 2 as published by the Free Software Foundation.
 *
 * This program is distributed in the hope that it will be useful,
 * but WITHOUT ANY WARRANTY; without even the implied warranty of
 * MERCHANTABILITY or FITNESS FOR A PARTICULAR PURPOSE.  See the
 * GNU General Public License for more details.
 */

/dts-v1/;

/include/ "msm8610-sec.dtsi"
/include/ "msm8610-v1-pm.dtsi"
/include/ "msm8610-sec-kanas3g-chn-cmcc-r05.dtsi"
/include/ "msm8610-camera-sensor-kanas3g-chn-r00.dtsi"
/include/ "sec-backlight-rt4502.dtsi"

/ {
	model = "SAMSUNG kanas3g chn CMCC Project REV05 ";
	compatible = "qcom,msm8610-mtp", "qcom,msm8610", "qcom,mtp";
        qcom,msm-id = <0xA208FF01 5  0>,
                                  <0xA308FF01 5  0>,
                                  <0x9308ff01 5  0>;
        /* [31:24] chip-id, [23:16] platform-id, [15:8] national code, [7:0] operator
                revision, reserved */
};


