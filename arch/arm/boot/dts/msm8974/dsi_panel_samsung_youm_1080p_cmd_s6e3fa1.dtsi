/* Copyright (c) 2012, Samsung Electronics Corporation. All rights reserved.
 *
 * This program is free software; you can redistribute it and/or modify
 * it under the terms of the GNU General Public License version 2 and
 * only version 2 as published by the Free Software Foundation.
 *
 * This program is distributed in the hope that it will be useful,
 * but WITHOUT ANY WARRANTY; without even the implied warranty of
 * MERCHANTABILITY or FITNESS FOR A PARTICULAR PURPOSE.  See the
 * GNU General Public License for more details.
 */

&mdss_mdp {

	dsi_samsung_fhd_f: mdss_dsi_samsung_youm_1080p_cmd {
		qcom,mdss-dsi-panel-name = "samsung,mdss-amoled-dsi-panel";
		label = "samsung amoled 1080p command mode dsi S6E3FA1 panel";
		status = "disable";
		qcom,mdss-dsi-panel-controller = <&mdss_dsi0>;
		qcom,enable-gpio = <&pm8941_gpios 14 0>;
		qcom,rst-gpio = <&pm8941_gpios 19 0>;
		qcom,te-gpio = <&msmgpio 12 0>;

		mdss-pan-broadcast-mode=<0>;

		qcom,mdss-pan-res = <1080 1920>;
		qcom,mdss-pan-size = <71 126>; /* <Width> <Height> real size of panel in mm */
		qcom,mdss-pan-bpp = <24>;
		qcom,mdss-pan-dest = "display_1";
		qcom,mdss-clk-rate=<898000000>;

		qcom,mdss-vsync-enable=<1>;
		qcom,mdss-hw-vsync-mode=<1>;
		qcom,mdss-pan-insert-dcs-cmd=<1>;
		qcom,mdss-pan-wr-mem-continue=<0x3c>;
		qcom,mdss-pan-wr-mem-start=<0x2c>;
		qcom,mdss-pan-te-sel=<1>;
		qcom,mdss-pan-clk-rate=<898000000>;

		qcom,mdss-pan-porch-values = <36 10 162 3 2 13>; /* <HBP> <HPW> <HFP> <VBP> <VPW> <VFP> */
		qcom,mdss-pan-underflow-clr = <0xff>;
		qcom,mdss-pan-bl-ctrl = "bl_ctrl_dcs_cmds";
		qcom,mdss-pan-bl-levels = <1 255>;
		qcom,mdss-pan-dsi-mode = <1>;
		qcom,mdss-pan-dsi-h-pulse-mode = <0>;
		qcom,mdss-pan-dsi-h-power-stop = <0 0 0>;
		qcom,mdss-pan-dsi-bllp-power-stop = <1 1>;
		qcom,mdss-pan-dsi-traffic-mode = <2>;
		qcom,mdss-pan-dsi-dst-format = <8>;
		qcom,mdss-pan-dsi-vc = <0>;
		qcom,mdss-pan-dsi-rgb-swap = <0>;
		qcom,mdss-force-clk-lane-hs = <0>;
		samsung,mdss-early-lcd-on = <1>;
		qcom,mdss-pan-dsi-data-lanes = <1 1 1 1>;
		qcom,mdss-pan-dsi-dlane-swap = <0>;
		qcom,mdss-pan-dsi-t-clk = <0x1c 0x04>;
		qcom,mdss-pan-dsi-stream = <0>;
		qcom,mdss-pan-dsi-mdp-tr = <0x0>;
		qcom,mdss-pan-dsi-dma-tr = <0x04>;
		qcom,mdss-pan-dsi-frame-rate = <60>;
		qcom,panel-phy-regulatorSettings = [07 09 03 00  /* Regualotor settings */
						    20 00 01];
		qcom,panel-phy-timingSettings = [E0 48 25 00 66 6D
						    2A 4B 3F 03 04 A0];
		qcom,panel-phy-strengthCtrl = [ff 06];		/*!!!! */
		qcom,panel-phy-bistCtrl = [00 00 b1 ff           /*!!!! BIST Ctrl settings */
					   00 00];
		qcom,panel-phy-laneConfig = [
			00 00 00 00 00 00 00 01 97 /* lane0 config */
			00 00 00 00 05 00 00 01 97 /* lane1 config */
			00 00 00 00 0a 00 00 01 97 /* lane2 config */
			00 00 00 00 0f 00 00 01 97 /* lane3 config */
			00 c0 00 00 00 00 00 01 bb]; /* Clk ln config */

		qcom,panel-on-cmds = [
				29 01 00 00 00 00 03 F0 5A 5A /* TEST KEY Enable */
				05 01 00 00 14 00 02 11 00  /* Sleep out = Needs 20ms  */

				29 01 00 00 00 00 02 F2 00   /* Display Control(F2h) =>  0x00 : command mode, 0x02 => video mode */

				/* Brightness condition set */
				29 01 00 00 00 00 22				/* 1) Gamma 2.2 Setting (300cd, 7200K, 10MPCD) */
					CA 01 00 01 00 01 00 80
					80 80 80 80 80 80 80 80
					80 80 80 80 80 80 80 80
					80 80 80 80 80 80 80 00
					00 00
				29 01 00 00 00 00 05 B2 00 06 00 06 /* AID 0% for 300Cd */
				29 01 00 00 00 00 03 B6 88 0A		/* ELVSS Setting for 300Cd */
				23 01 00 00 00 00 02 F7 03		/* 2) Gamma, LTPS(AID) update */

				/* Vsync Enable(Tear On) : 0x00, Hsync Enable : 0x01  */
				23 01 00 00 00 00 02 35 00

				/* Common Setting (RE Setting) */
				29 01 00 00 00 00 0D C0 00 02 03 32 03 44 44 C0 13 1C 20 E8
				23 01 00 00 00 00 05 E3 FF FF FF FF
				23 01 00 00 00 00 03 FE 00 03
				23 01 00 00 00 00 02 B0 2B
				23 01 00 00 00 00 02 FE E4

				/* Level_3 key list */
				29 01 00 00 00 00 03 FC 5A 5A  /* Level3 key Enable */
				29 01 00 00 00 00 03 ED 0C 04  /* ERR_FG */
				23 01 00 00 00 00 02 FF 01	   /* TOUT2 Hsync On */
				29 01 00 00 00 00 03 FC A5 A5  /* Level3 key Disable */
			];
		qcom,on-cmds-dsi-state = "dsi_hs_mode";
		qcom,panel-off-cmds = [
				05 01 00 00 0A 00 02 28 00
				/* !! Needs 10ms(=0x0A) wait !!*/
				05 01 00 00 78 00 02 10 00
				/* !! Needs 120ms(=0x78) wait !!*/
		];
		qcom,off-cmds-dsi-state = "dsi_hs_mode";

		/*
			the last byte in read commands  represent READ LENGH,
			like below  READ LENGH = 0x21
		 */
		 	samsung,panel-test-key-enable-cmds 		= [ 29 01 00 00 00 00 03 F0 5A 5A];
		 	samsung,panel-test-key-disable-cmds 	= [ 29 01 00 00 00 00 03 F0 A5 A5];

		 	samsung,panel-vddm-read-cmds = [ 06 01 00 00 00 00 01 D7 01 16];	/* read D7 23th , 22=0x16 */
			samsung,panel-nv-mtp-read-cmds = [ 06 01 00 00 00 00 01 c8 21 00];
			samsung,panel-nv-mtp-read-hbm-cmds = [ 06 01 00 00 00 00 01 c8 07 21];	/* read C8 34~40th , 33=0x21 */
			samsung,panel-nv-mtp-read-hbm2-cmds = [ 06 01 00 00 00 00 01 c8 0F 48];	/* read C8 73~87th , 72=0x48 */
			samsung,panel-nv-mdnie-read-cmds = [ 06 01 00 00 00 00 01 A1 04 00];
			samsung,panel-nv-read-cmds = [ 06 01 00 00 00 00 01 c8 21 00];
			samsung,panel-nv-read-enable-cmds = [
								29 01 00 00 00 00 03 f0 5a 5a
								29 01 00 00 00 00 03 fc 5a 5a ];
			samsung,panel-nv-read-disable-cmds = [ 29 01 00 00 00 00 03 f0 a5 a5 ];

			/* the last byte in all read commands will represent READ LENGH */
			samsung,panel-manufacture-id-read-cmds = [
								06 01 00 00 00 00 01 da 01 00
								06 01 00 00 00 00 01 db 01 00
								06 01 00 00 00 00 01 dc 01 00];

			qcom,panel-display-on-cmds = [05 01 00 00 32 00 02 29 00];
			qcom,panel-display-off-cmds = [05 01 00 00 32 00 02 29 00];
			samsung,panel-acl-off-cmds = [23 01 00 00 72 00 02 55 00];
			samsung,panel-tear-on-cmds = [29 01 00 00 00 00 02 35 00];
			samsung,panel-tear-off-cmds = [29 01 00 00 00 00 02 34 00];

			samsung,panel-ldi-partial-disp-on = [29 01 00 00 00 00 05 30 02 83 04 FF
							     29 01 00 00 00 00 02 12 00 ];
			samsung,panel-ldi-partial-disp-off = [29 01 00 00 00 00 02 13 00];
			samsung,panel-elvss-lowtemp-cmds-list = [
								29 01 00 00 00 00 02 B0 05
								29 01 00 00 00 00 02 B8 00
								29 01 00 00 00 00 02 B6 8C];	/* Low Temperature Command  */

			samsung,panel-gamma-cmds-list = [
					29 01 00 00 00 00 22            /* Brightness Condition Set - Gamma 2.2 Setting */
						CA 01 00 01 00 01 00 80
						80 80 80 80 80 80 80 80
						80 80 80 80 80 80 80 80
						80 80 80 80 80 80 80 00
						00 00
					29 01 00 00 00 00 02 F7 03		/* Gamma, LTPS(AID) update */
				];

			samsung,panel-gamma-hbm-cmds-list = [
						29 01 00 00 00 00 22            /* Brightness Condition Set for HBM - Gamma 2.2 Setting*/
						CA 01 00 01 00 01 00 80
						80 80 80 80 80 80 80 80
						80 80 80 80 80 80 80 80
						80 80 80 80 80 80 80 00
						00 00
				];

			samsung,panel-etc-hbm-cmds = [
					29 01 00 00 00 00 05 B2 00 06 00 06 			/* AID 0% */
					29 01 00 00 00 00 03 b6 88 00 					/* ELVSS  */
					29 01 00 00 00 00 07 B5 03 99 27 35 45 0A		/* ACL control */
					29 01 00 00 00 00 02 55 02	   					/* ACL 40%(02h) */
					29 01 00 00 00 00 02 F7 03 						/* Gamma, LTPS(AID) update */
				];

			samsung,panel-etc-hbm-evt0-second-cmds = [
					29 01 00 00 00 00 05 B2 00 06 00 06 			/* AID 0% */
					29 01 00 00 00 00 07 B5 03 99 27 1F 45 0A		/* ACL control */
					29 01 00 00 00 00 12 B6 88 0A 00 00 00 00 00 03 55 54 20 00 08 88 8E 0E 00    /* HBM ELVSS Setting */
					29 01 00 00 00 00 03 BC 20 38					/* RE Condition Setting for EVT0 */
					29 01 00 00 00 00 02 55 42	   					/* RE(low) & ACL 40% */
					29 01 00 00 00 00 02 F7 03 						/* Gamma, LTPS(AID) update */
				];

			samsung,panel-etc-hbm-evt1-cmds = [
					29 01 00 00 00 00 05 B2 00 06 00 06 			/* AID 0% */
					29 01 00 00 00 00 07 B5 03 99 27 1F 45 0A		/* ACL control */
					29 01 00 00 00 00 12 B6 88 0A 00 00 00 00 00 03 55 54 20 00 08 88 8E 0E 00    /* HBM ELVSS Setting */
					29 01 00 00 00 00 0D C0 00 02 03 32 03 44 44 C0 00 1C 20 E8					/* RE Condition Setting For EVT1 */
					29 01 00 00 00 00 05 E3 FF FF FF FF
					29 01 00 00 00 00 03 FE 00 03
					29 01 00 00 00 00 02 B0 2B
					29 01 00 00 00 00 02 FE E4
					29 01 00 00 00 00 02 55 42	   					/* RE(low) & ACL 40% */
					29 01 00 00 00 00 02 F7 03 						/* Gamma, LTPS(AID) update */
				];

			/*
			 * ************************************************************************************************************************
			 * AID command list and mappings
			 * ************************************************************************************************************************
			 */
			samsung,panel-aid-cmds-list = [
				29 01 00 00 00 00 05	B2 00 06 00 06 /* 0 samsung_brightness_aor_0p3 */
				29 01 00 00 00 00 05	B2 00 06 03 06 /* 1 samsung_brightness_aor_40 */
				29 01 00 00 00 00 05	B2 00 06 00 10 /* 2 samsung_brightness_aor_0p8 */
				29 01 00 00 00 00 05	B2 00 06 00 A4 /* 3 samsung_brightness_aor_8p5 */
				29 01 00 00 00 00 05	B2 00 06 01 02 /* 4 samsung_brightness_aor_13p3 */
				29 01 00 00 00 00 05	B2 00 06 01 74 /* 5 samsung_brightness_aor_19p2 */
				29 01 00 00 00 00 05	B2 00 06 01 d3 /* 6 samsung_brightness_aor_24p1 */
				29 01 00 00 00 00 05	B2 00 06 02 32 /* 7 samsung_brightness_aor_29p1 */
				29 01 00 00 00 00 05	B2 00 06 02 91 /* 8 samsung_brightness_aor_34p0 */
				29 01 00 00 00 00 05	B2 00 06 02 dd /* 9 samsung_brightness_aor_37p9 */
				29 01 00 00 00 00 05	B2 00 06 03 29 /* 10 samsung_brightness_aor_41p8 */
				29 01 00 00 00 00 05	B2 00 06 03 75 /* 11 samsung_brightness_aor_45p5 */
				29 01 00 00 00 00 05	B2 00 06 03 B6 /* 12 samsung_brightness_aor_49p1 */
				29 01 00 00 00 00 05	B2 00 06 03 F0 /* 13 samsung_brightness_aor_52p1 */
				29 01 00 00 00 00 05	B2 00 06 04 32 /* 14 samsung_brightness_aor_55p5 */
				29 01 00 00 00 00 05	B2 00 06 04 66 /* 15 samsung_brightness_aor_58p2 */
				29 01 00 00 00 00 05	B2 00 06 04 9B /* 16 samsung_brightness_aor_61p0 */
				29 01 00 00 00 00 05	B2 00 06 04 D0 /* 17 samsung_brightness_aor_63p7 */
				29 01 00 00 00 00 05	B2 00 06 04 F4 /* 18 samsung_brightness_aor_65p6 */
				29 01 00 00 00 00 05	B2 00 06 05 17 /* 19 samsung_brightness_aor_67p4 */
				29 01 00 00 00 00 05	B2 00 06 05 4C /* 20 samsung_brightness_aor_70p1 */
				29 01 00 00 00 00 05	B2 00 06 05 6F /* 21 samsung_brightness_aor_71p9 */
				29 01 00 00 00 00 05	B2 00 06 05 93 /* 22 samsung_brightness_aor_73p8 */
				29 01 00 00 00 00 05	B2 00 06 05 B3 /* 23 samsung_brightness_aor_75p4 */
				29 01 00 00 00 00 05	B2 00 06 05 C4 /* 24 samsung_brightness_aor_76p3 */
				29 01 00 00 00 00 05	B2 00 06 05 E4 /* 25 samsung_brightness_aor_78p0 */
				29 01 00 00 00 00 05	B2 00 06 05 F5 /* 26 samsung_brightness_aor_78p9 */
				29 01 00 00 00 00 05	B2 00 06 06 16 /* 27 samsung_brightness_aor_80p6 */
				29 01 00 00 00 00 05	B2 00 06 06 26 /* 28 samsung_brightness_aor_81p4 */
				29 01 00 00 00 00 05	B2 00 06 06 37 /* 29 samsung_brightness_aor_82p3 */
				29 01 00 00 00 00 05	B2 00 06 06 48 /* 30 samsung_brightness_aor_83p1 */
				29 01 00 00 00 00 05	B2 00 06 06 6A /* 31 samsung_brightness_aor_84p9 */
				29 01 00 00 00 00 05	B2 00 06 06 7B /* 32 samsung_brightness_aor_85p8 */
				29 01 00 00 00 00 05	B2 00 06 06 8C /* 33 samsung_brightness_aor_86p7 */
				29 01 00 00 00 00 05	B2 00 06 06 9E /* 34 samsung_brightness_aor_87p6 */
				29 01 00 00 00 00 05	B2 00 06 06 AF /* 35 samsung_brightness_aor_88p5 */
				29 01 00 00 00 00 05	B2 00 06 06 C0 /* 36 samsung_brightness_aor_89p3 */
				29 01 00 00 00 00 05	B2 00 06 06 D1 /* 37 samsung_brightness_aor_90p2 */
				29 01 00 00 00 00 05	B2 00 06 06 E3 /* 38 samsung_brightness_aor_91p2 */
				29 01 00 00 00 00 05	B2 00 06 06 F4 /* 39 samsung_brightness_aor_92p0 */
				29 01 00 00 00 00 05	B2 00 06 07 04 /* 40 samsung_brightness_aor_92p9 */
				29 01 00 00 00 00 05	B2 00 06 07 16 /* 41 samsung_brightness_aor_93p8 */
				29 01 00 00 00 00 05	B2 00 06 07 27 /* 42 samsung_brightness_aor_94p7 */
				29 01 00 00 00 00 05	B2 00 06 07 37 /* 43 samsung_brightness_aor_95p5 */
				29 01 00 00 00 00 05	B2 00 06 00 06 /* 44 samsung_brightness_aor_ref */
			];
			
		/* bl_level, Index in acl command list */
		samsung,panel-aid-map-table = <
				 5   43         6   42       7    41        8   40      9   39
				10   38        11   37       12   36       13   35     14   34
				15   33        16   32       17   31       19   30     20   29
				21   28        22   27       24   26       25   25     27   24
				29   23        30   22       32   21       34   20     37   19
				39   18        41   17       44   16       47   15     50   14
				53   13        56   12       60   11       64   10     68   9
				72   8         77   7        82   6        87   5      93   4
				98   3         105  2        111  1        119  1      126  1
				134  1         143  1        152  1        162  1      172  1
				183  0         195  0        207  0        220  0      234  0
				249  0         265  0        282  0        300  0	   316	0
				333	 0		   350	0
			>;

			/*
			 * ************************************************************************************************************************
			 * ACL command list and mappings
			 * ************************************************************************************************************************
			 */
		    samsung,panel-aclcont-cmds-list = [
					29 01 00 00 00 00 07 B5 03 99 27 1F 45 0A];	 /* 0x1F : 25% */


			samsung,panel-acl-cmds-list = [
					23 01 00 00 00 00 02 55 00 /* AID 0% */
					23 01 00 00 00 00 02 55 01 /* AID 30% */
					23 01 00 00 00 00 02 55 02 /* AID 25% default */
					23 01 00 00 00 00 02 55 03]; /* AID 50% */

			/* bl_level , Index in acl command list */
			samsung,panel-acl-map-table =  <
				 	5    2          6   2        7    2    8   2       9   2
				 	10   2         11   2        12   2   13   2      14   2
				 	15   2         16   2        17   2   19   2      20   2
				 	21   2         22   2        24   2   25   2      27   2
				 	29   2         30   2        32   2   34   2      37   2
				 	39   2         41   2        44   2   47   2      50   2
				 	53   2         56   2        60   2   64   2      68   2
				 	72   2         77   2        82   2   87   2      93   2
				 	98   2         105  2        111  2   119  2      126  2
				 	134  2         143  2        152  2   162  2      172  2
				 	183  2         195  2        207  2   220  2      234  2
				 	249  2         265  2        282  2   300  2	  316  2
				 	333	 2		   350	2
				>;

			/*
			 * ************************************************************************************************************************
			 * ELVSS command list and mappings
			 * ************************************************************************************************************************
			 */
			samsung,panel-elvss-cmds-list = [
				29 01 00 00 00 00 03 b6 88 19 /*  0 DEFAULT_ELVSS(0x19) */
				29 01 00 00 00 00 03 b6 88 17 /*  1 DEFAULT_ELVSS(0x17) */
				29 01 00 00 00 00 03 b6 88 16 /*  2 DEFAULT_ELVSS(0x16) */
				29 01 00 00 00 00 03 b6 88 15 /*  3 DEFAULT_ELVSS(0x15) */
				29 01 00 00 00 00 03 b6 88 14 /*  4 DEFAULT_ELVSS(0x14) */
				29 01 00 00 00 00 03 b6 88 13 /*  5 DEFAULT_ELVSS(0x13) */
				29 01 00 00 00 00 03 b6 88 12 /*  6 DEFAULT_ELVSS(0x12) */
				29 01 00 00 00 00 03 b6 88 11 /*  7 DEFAULT_ELVSS(0x11) */
				29 01 00 00 00 00 03 b6 88 10 /*  8 DEFAULT_ELVSS(0x10) */
				29 01 00 00 00 00 03 b6 88 0F /*  9 DEFAULT_ELVSS(0x0F) */
				29 01 00 00 00 00 03 b6 88 0D /* 10 DEFAULT_ELVSS(0x0D) */
				29 01 00 00 00 00 03 b6 88 0C /* 11 DEFAULT_ELVSS(0x0C) */
				29 01 00 00 00 00 03 b6 88 0B /* 12 DEFAULT_ELVSS(0x0B) */
				29 01 00 00 00 00 03 b6 88 0A /* 13 DEFAULT_ELVSS(0x0A) */
			];
			/* bl_level, Index in elvss command list */
			samsung,panel-elvss-map-table = <
					5    0          6   0        7    0    8   0       9   0
					10   0         11   0        12   0   13   0      14   0
					15   0         16   0        17   0   19   0      20   0
					21   0         22   0        24   0   25   0      27   0
					29   0         30   0        32   0   34   0      37   0
					39   0         41   0        44   0   47   0      50   0
					53   0         56   0        60   0   64   0      68   0
					72   0         77   0        82   0   87   0      93   0
					98   0         105  0        111  1   119  2      126  2
					134  3         143  4        152  5   162  6      172  7
					183  2         195  3        207  4   220  5      234  6
					249  7         265  8        282  9   300  10	  316  11
					333	 12		   350  13
					>;

			/*
			 * ************************************************************************************************************************
			 * SMART ACL ELVSS command list and mappings
			 * ************************************************************************************************************************
			 */
			samsung,panel-smart-acl-elvss-cmds-list = [
				29 01 00 00 00 00 03 b6 88 1D /*  0 SMART_ACL_ELVSS(0x1F) */
				29 01 00 00 00 00 03 b6 88 1B /*  1 SMART_ACL_ELVSS(0x1B) */
				29 01 00 00 00 00 03 b6 88 1A /*  2 SMART_ACL_ELVSS(0x1A) */
				29 01 00 00 00 00 03 b6 88 19 /*  3 SMART_ACL_ELVSS(0x19) */
				29 01 00 00 00 00 03 b6 88 18 /*  4 SMART_ACL_ELVSS(0x18) */
				29 01 00 00 00 00 03 b6 88 17 /*  5 SMART_ACL_ELVSS(0x17) */
				29 01 00 00 00 00 03 b6 88 16 /*  6 SMART_ACL_ELVSS(0x16) */
				29 01 00 00 00 00 03 b6 88 15 /*  7 SMART_ACL_ELVSS(0x15) */
				29 01 00 00 00 00 03 b6 88 14 /*  8 SMART_ACL_ELVSS(0x14) */
				29 01 00 00 00 00 03 b6 88 12 /*  9 SMART_ACL_ELVSS(0x13) */
				29 01 00 00 00 00 03 b6 88 11 /* 10 SMART_ACL_ELVSS(0x11) */
				29 01 00 00 00 00 03 b6 88 10 /* 11 SMART_ACL_ELVSS(0x10) */
				29 01 00 00 00 00 03 b6 88 0F /* 12 SMART_ACL_ELVSS(0x0F) */
			];
			/* bl_level, Index in elvss command list */
			samsung,panel-smart-acl-elvss-map-table = <
					5    0          6   0        7    0    8   0       9   0
					10   0         11   0        12   0   13   0      14   0
					15   0         16   0	     17   0   19   0      20   0
					21   0         22   0	     24   0   25   0      27   0
					29   0         30   0	     32   0   34   0      37   0
					39   0         41   0	     44   0   47   0      50   0
					53   0         56   0	     60   0   64   0      68   0
					72   0         77   0	     82   0   87   0      93   0
					98   0         105  0	     111  1   119  2      126  2
					134  3         143  4	     152  5   162  6      172  7
					183  2         195  3 	     207  4   220  5      234  6
					249  7         265  8        282  8   300  9	  316  10
					333	 11		   350	12
					>;
			/*
			 * ************************************************************************************************************************
			 * candela to index mappings
			 * ************************************************************************************************************************
			 */
			samsung,panel-candella-mapping-table = <
			/*<idx>	  <from>  <till> <candella> */
				0		0		5		5
				1		6		6		6
				2		7		7		7
				3		8		8		8
				4		9		9		9
				5		10		10		10
				6		11		11		11
				7		12		12		12
				8		13		13		13
				9		14		14		14
				10		15		15		15
				11		16		16		16
				12		17		18		17
				13		19		19		19
				14		20		20		20
				15		21		21		21
				16		22		23		22
				17		24		24		24
				18		25		26		25
				19		27		28		27
				20		29		29		29
				21		30		31		30
				22		32		32		32
				23		33		36		34
				24		37		38		37
				25		39		40		39
				26		41		43		41
				27		44		46		44
				28		47		49		47
				29		50		52		50
				30		53		55		53
				31		56		59		56
				32		60		63		60
				33		64		67		64
				34		68		71		68
				35		72		76		72
				36		77		81		77
				37		82		86		82
				38		87		92		87
				39		93		97		93
				40		98		104		98
				41		105		110		105
				42		111		118		111
				43		119		125		119
				44		126		133		126
				45		134		142		134
				46		143		149		143
				47		150		161		152
				48		162		171		162
				49		172		182		172
				50		183		194		183
				51		195		206		195
				52		207		219		207
				53		220		232		220
				54		233		248		234
				55		249		249		249
				56		250		251		265
				57		252		253		282
				58		254		255		300
				>;

			samsung,panel-candella-mapping-table-350 = <
			/*<idx>	  <from>  <till> <candella> */
				0		0		5		5
				1		6		6		6
				2		7		7		7
				3		8		8		8
				4		9		9		9
				5		10		10		10
				6		11		11		11
				7		12		12		12
				8		13		13		13
				9		14		14		14
				10		15		15		15
				11		16		16		16
				12		17		18		17
				13		19		19		19
				14		20		20		20
				15		21		21		21
				16		22		23		22
				17		24		24		24
				18		25		26		25
				19		27		28		27
				20		29		29		29
				21		30		31		30
				22		32		32		32
				23		33		36		34
				24		37		38		37
				25		39		40		39
				26		41		43		41
				27		44		46		44
				28		47		49		47
				29		50		52		50
				30		53		55		53
				31		56		59		56
				32		60		63		60
				33		64		67		64
				34		68		71		68
				35		72		76		72
				36		77		81		77
				37		82		86		82
				38		87		92		87
				39		93		97		93
				40		98		104		98
				41		105		110		105
				42		111		118		111
				43		119		125		119
				44		126		133		126
				45		134		142		134
				46		143		149		143
				47		150		161		152
				48		162		171		162
				49		172		181		172
				50		182		193		183
				51		194		205		195
				52		206		218		207
				53		219		229		220
				54		230		237		234
				55		238		241		249
				56		242		244		265
				57		245		247		282
				58		248		249		300
				59		250		251		316
				60		252		253		333
				61		254		255		350
				>;

			/* Lux table mapping for Smart dimming*/
			samsung,panel-smart-dimming-lux-table = <
				5    6	 7  8   9
				10  11  12 13  14
				15  16  17 19  20
				21  22	24 25  27
				29  30	32 34  37
				39  41	44 47  50
				53  56	60 64  68
				72  77  82 87  93
				98  105	111 119 126
				134 143	152 162 172
				183 195	207 220 234
				249 265	282 300
				>;
	};
};
