/* Copyright (c) 2013, The Linux Foundation. All rights reserved.
 *
 * This program is free software; you can redistribute it and/or modify
 * it under the terms of the GNU General Public License version 2 and
 * only version 2 as published by the Free Software Foundation.
 *
 * This program is distributed in the hope that it will be useful,
 * but WITHOUT ANY WARRANTY; without even the implied warranty of
 * MERCHANTABILITY or FITNESS FOR A PARTICULAR PURPOSE.  See the
 * GNU General Public License for more details.
 */

/dts-v1/;

/include/ "msm8974-v2.2-sec.dtsi"
/include/ "msm8974-sec-mondrian-r12.dtsi"

/ {
	model = "Samsung MONDRIAN rev1.2";
	/* qcom,msm-id = <126 1 0>; */
	qcom,msm-id = <0x7E01FF01 12 0>;
	/* [31:24] chip-id, [23:16] platform-id, [15:8] national code, [7:0] operator
		revision, reserved */
};
