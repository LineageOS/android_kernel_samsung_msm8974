/* Copyright (c) 2012, Samsung Electronics Corporation. All rights reserved.
 *
 * This program is free software; you can redistribute it and/or modify
 * it under the terms of the GNU General Public License version 2 and
 * only version 2 as published by the Free Software Foundation.
 *
 * This program is distributed in the hope that it will be useful,
 * but WITHOUT ANY WARRANTY; without even the implied warranty of
 * MERCHANTABILITY or FITNESS FOR A PARTICULAR PURPOSE.  See the
 * GNU General Public License for more details.
 */

&mdss_mdp {
	dsi_dual_2560p_vid_right: qcom,mdss_dsi_samsung_dual_2560p_video_right {
		qcom,mdss-dsi-panel-name = "samsung tft 2560p video mode R63319 right panel";
		qcom,mdss-dsi-panel-controller = <&mdss_dsi0>;
		qcom,enable-gpio = <&pm8941_gpios 14 0>;
		qcom,rst-gpio = <&pm8941_gpios 9 0>;

		qcom,cont-splash-enabled = <1>;
		qcom,mdss-pan-res = <800 2560>;
		qcom,mdss-pan-physical-dimension = <113 181>; /* <Width> <Height> in mm */
		qcom,mdss-pan-bpp = <24>;
		qcom,mdss-pan-dest = "display_1";
		qcom,mdss-pan-broadcast-mode = <1>;
		qcom,mdss-pan-porch-values = <64 20 150 8 4 12>;  /* <HBP> <HPW> <HFP> <VBP> <VPW> <VFP> */
		qcom,mdss-pan-underflow-clr = <0xff>;
		qcom,mdss-pan-bl-ctrl = "UNKNOWN_CTRL";

		qcom,mdss-pan-dsi-mode = <0>; /* VIDEO = 0, CMD = 1*/
		qcom,mdss-pan-dsi-h-pulse-mode = <0>;
		qcom,mdss-pan-dsi-h-power-stop = <0 0 0>; /* <HBP> <HSA> <HFP> */
		qcom,mdss-pan-dsi-bllp-power-stop = <1 1>;	 /* <BLLP> <EOF_BLLP> */
		qcom,mdss-pan-dsi-traffic-mode = <2>; /* DSI_BURST_MODE */
		qcom,mdss-pan-dsi-dst-format = <3>; /*DSI_VIDEO_DST_FORMAT_RGB888 */
		qcom,mdss-pan-dsi-vc = <0>;
		qcom,mdss-pan-dsi-rgb-swap = <0>;  /* DSI_RGB_SWAP_RGB*/
		qcom,mdss-pan-dsi-data-lanes = <1 1 1 1>;
		qcom,mdss-pan-dsi-dlane-swap = <0>;
		qcom,mdss-pan-dsi-t-clk = <0x1c 0x04>; /* <t_clk_pre> <t_clk_post> */
		qcom,mdss-pan-dsi-stream = <0>; /* dma_p */
		qcom,mdss-pan-dsi-mdp-tr = <0x04>; /* DSI_CMD_TRIGGER_S W*/
		qcom,mdss-pan-dsi-dma-tr = <0x04>; /* DSI_CMD_TRIGGER_SW */
		qcom,mdss-pan-dsi-frame-rate = <60>;
		qcom,mdss-pan-clk-rate = <964000000>;
		qcom,mdss-force-clk-lane-hs = <0>;

		qcom,panel-phy-regulatorSettings = [03 0a 04 00  /* Regualotor settings */
						20 00 01];
		qcom,panel-phy-timingSettings = [F9 50 42 00 6D 80
						38 50 46 03 04 A0];
		qcom,panel-phy-strengthCtrl = [ff 06];
		qcom,panel-phy-bistCtrl = [00 00 b1 ff           /* BIST Ctrl settings */
						00 00];
		qcom,panel-phy-laneConfig = [
						00 c2 45 00 00 00 00 01 75 /* lane0 config */
						00 c2 45 00 00 00 00 01 75 /* lane1 config */
						00 c2 45 00 00 00 00 01 75 /* lane2 config */
						00 c2 45 00 00 00 00 01 75 /* lane3 config */
						00 02 45 00 00 00 00 01 97]; /* Clk ln config */

		qcom,panel-on-cmds = [
					05 01 00 00 0A 00 02 01 00
					15 01 00 00 00 00 02 36 00
					15 01 00 00 00 00 02 3A 70
					15 01 00 00 00 00 02 35 01
					15 01 00 00 00 00 02 53 2C

					23 01 00 00 00 00 02 B0 00
					05 01 00 00 00 00 02 00 00
					05 01 00 00 00 00 02 00 00
					23 01 00 00 00 00 02 D6 01

					/* Gamma Function */
					29 01 00 00 00 00 1F C7 01
						0E 15 1D 2A 38 41 51 35
						3D 47 56 61 6A 76 01 0E
						15 1D 2A 36 3F 4D 31 39
						45 54 5F 68 76

					/* Digital Gamma Function (1) */
					29 01 00 00 00 00 14 C8 01
						00 00 00 00 E8 00 00 00
						00 00 DC 00 00 00 00 01
						FC 00

					/* CE tuning */
					29 01 00 00 00 00 21 CA 01
						80 C8 B9 FF FF FF A0 09
						20 10 8C 0A 4A 37 A0 00
						FF 0C 0C 0C 0C 3F 3F EF
						00 10 10 3F 3F 3F 3F

					05 01 00 00 78 00 02 11 00
					05 01 00 00 00 00 02 29 00
					15 01 00 00 00 00 02 51 15];

		qcom,on-cmds-dsi-state = "dsi_hs_mode";

		qcom,panel-off-cmds = [
			05 01 00 00 00 00 02 00 00
			05 01 00 00 00 00 02 00 00];

		qcom,off-cmds-dsi-state = "dsi_hs_mode";

		samsung,panel-ce-on-cmds = [05 01 00 00 00 00 02 00 00];
		samsung,panel-ce-off-cmds =[05 01 00 00 00 00 02 00 00];
		samsung,panel-cabc-on-cmds = [05 01 00 00 00 00 02 00 00];
		samsung,panel-cabc-off-cmds = [05 01 00 00 00 00 02 00 00];
		samsung,panel-cabc-tune-cmds = [05 01 00 00 00 00 02 00 00];

	};

	dsi_dual_2560p_vid_left: qcom,mdss_dsi_samsung_dual_2560p_video_left {
		qcom,mdss-dsi-panel-name = "samsung tft 2560p video mode R63319 left panel";
		qcom,mdss-dsi-panel-controller = <&mdss_dsi1>;
		qcom,enable-gpio = <&pm8941_gpios 14 0>;
		qcom,rst-gpio = <&pm8941_gpios 9 0>;

		qcom,cont-splash-enabled = <1>;
		qcom,mdss-pan-res = <800 2560>;
		qcom,mdss-pan-physical-dimension = <113 181>; /* <Width> <Height> in mm */
		qcom,mdss-pan-bpp = <24>;
		qcom,mdss-pan-dest = "display_2";
		qcom,mdss-pan-broadcast-mode = <1>;
		qcom,mdss-pan-porch-values = <64 20 150 8 4 12>;  /* <HBP> <HPW> <HFP> <VBP> <VPW> <VFP> */
		qcom,mdss-pan-underflow-clr = <0xff>;

		qcom,mdss-pan-bl-ctrl = "bl_ctrl_dcs";
		qcom,mdss-pan-bl-levels = <1 255>;
		qcom,pwm-period = <630>; /* us */
		qcom,pwm-lpg-channel = < 7 >;
		qcom,pwm-pmic-gpio = <&pm8941_gpios 36 0>;

		qcom,mdss-pan-dsi-mode = <0>; /* VIDEO = 0, CMD = 1*/
		qcom,mdss-pan-dsi-h-pulse-mode = <0>;
		qcom,mdss-pan-dsi-h-power-stop = <0 0 0>; /* <HBP> <HSA> <HFP> */
		qcom,mdss-pan-dsi-bllp-power-stop = <1 1>;	 /* <BLLP> <EOF_BLLP> */
		qcom,mdss-pan-dsi-traffic-mode = <2>; /* DSI_BURST_MODE */
		qcom,mdss-pan-dsi-dst-format = <3>; /*DSI_VIDEO_DST_FORMAT_RGB888 */
		qcom,mdss-pan-dsi-vc = <0>;
		qcom,mdss-pan-dsi-rgb-swap = <0>;  /* DSI_RGB_SWAP_RGB*/
		qcom,mdss-pan-dsi-data-lanes = <1 1 1 1>;
		qcom,mdss-pan-dsi-dlane-swap = <0>;
		qcom,mdss-force-clk-lane-hs = <0>;
		qcom,mdss-pan-dsi-t-clk = <0x1c 0x04>; /* <t_clk_pre> <t_clk_post> */
		qcom,mdss-pan-dsi-stream = <0>; /* dma_p */
		qcom,mdss-pan-dsi-mdp-tr = <0x04>; /* DSI_CMD_TRIGGER_S W*/
		qcom,mdss-pan-dsi-dma-tr = <0x04>; /* DSI_CMD_TRIGGER_SW */
		qcom,mdss-pan-dsi-frame-rate = <60>;
		qcom,mdss-pan-clk-rate = <964000000>;

		qcom,panel-phy-regulatorSettings = [03 0a 04 00  /* Regualotor settings */
						20 00 01];
		qcom,panel-phy-timingSettings = [F9 50 42 00 6D 80
						38 50 46 03 04 A0];
		qcom,panel-phy-strengthCtrl = [ff 06];
		qcom,panel-phy-bistCtrl = [00 00 b1 ff           /* BIST Ctrl settings */
						00 00];
		qcom,panel-phy-laneConfig = [
						00 c2 45 00 00 00 00 01 75 /* lane0 config */
						00 c2 45 00 00 00 00 01 75 /* lane1 config */
						00 c2 45 00 00 00 00 01 75 /* lane2 config */
						00 c2 45 00 00 00 00 01 75 /* lane3 config */
						00 02 45 00 00 00 00 01 97]; /* Clk ln config */

		qcom,panel-on-cmds = [
					05 01 00 00 0A 00 02 01 00
					15 01 00 00 00 00 02 36 00
					15 01 00 00 00 00 02 3A 70
					15 01 00 00 00 00 02 35 01
					15 01 00 00 00 00 02 53 2C

					23 01 00 00 00 00 02 B0 00
					05 01 00 00 00 00 02 00 00
					05 01 00 00 00 00 02 00 00
					23 01 00 00 00 00 02 D6 01

					/* Gamma Function */
					29 01 00 00 00 00 1F C7 01
						0E 15 1D 2A 38 41 51 35
						3D 47 56 61 6A 76 01 0E
						15 1D 2A 36 3F 4D 31 39
						45 54 5F 68 76

					/* Digital Gamma Function (1) */
					29 01 00 00 00 00 14 C8 01
						00 00 00 00 E8 00 00 00
						00 00 DC 00 00 00 00 01
						FC 00

					/* CE tuning */
					29 01 00 00 00 00 21 CA 01
						80 C8 B9 FF FF FF A0 09
						20 10 8C 0A 4A 37 A0 00
						FF 0C 0C 0C 0C 3F 3F EF
						00 10 10 3F 3F 3F 3F

					05 01 00 00 78 00 02 11 00
					05 01 00 00 00 00 02 29 00
					15 01 00 00 00 00 02 51 15
					];

		qcom,on-cmds-dsi-state = "dsi_hs_mode";

		qcom,panel-off-cmds = [
					05 01 00 00 14 00 02 28 00
					05 01 00 00 32 00 02 10 00
					];
		qcom,off-cmds-dsi-state = "dsi_hs_mode";

		/* CE tuning value for debug */
		samsung,panel-ce-on-cmds = [29 01 00 00 00 00 21
									CA 01 80 F0 F0 F0 F0
									F0 F0 14 3F 10 80 0A
									4A 37 A0 00 FF 0C 0C
									0C 0C 3F 3F 00 00 10
									10 3F 3F 3F 3F];
		samsung,panel-ce-off-cmds =[29 01 00 00 00 00 21
									CA 00 80 80 80 80 80
									80 80 08 20 80 80 0A
									4A 37 A0 55 F8 0C 0C
									20 10 3F 3F 00 00 10
									10 3F 3F 3F 3F];
		/* CABC tuning value for debug */
		samsung,panel-cabc-on-cmds = [15 01 00 00 00 00 02 55 01];
		samsung,panel-cabc-off-cmds = [15 01 00 00 00 00 02 55 00];
		samsung,panel-cabc-tune-cmds = [29 01 00 00 00 00 07 B8 05 79 4F 20 0E 6E
									 29 01 00 00 00 00 07 B9 05 50 81 10 0E 20
									 29 01 00 00 00 00 07 BA 07 79 4F 20 0E 6E
									 29 01 00 00 00 00 16 CE 75 40 48 56 67 78
									 	88 98 A7 B5 C3 D1 DE E9 F2 FA FF FF FF
									 	FF FF
									 29 01 00 00 00 00 04 BB 01 1E 14
									 29 01 00 00 00 00 04 BC 01 50 32
									 29 01 00 00 00 00 04 BD 00 B4 A0];


	};
};
