/* Copyright (c) 2012, The Linux Foundation. All rights reserved.
 *
 * This program is free software; you can redistribute it and/or modify
 * it under the terms of the GNU General Public License version 2 and
 * only version 2 as published by the Free Software Foundation.
 *
 * This program is distributed in the hope that it will be useful,
 * but WITHOUT ANY WARRANTY; without even the implied warranty of
 * MERCHANTABILITY or FITNESS FOR A PARTICULAR PURPOSE.  See the
 * GNU General Public License for more details.
 */

&soc {

	haptic_pdata: max77803_haptic_driver {
		haptic,max_timeout = <10000>;
		haptic,duty = <44000>;
		haptic,period = <44642>;
		haptic,pwm_id = <1>;
	};

	i2c@13 {
		cell-index = <13>;
		compatible = "i2c-gpio";
		gpios = <&msmgpio 33 0 /* sda */
			 &msmgpio 32 0 /* scl */
			 >;
		i2c-gpio,delay-us = <2>;
		#address-cells = <1>;
		#size-cells = <0>;

		max77803@66 {
			compatible = "max77803,i2c";
			reg = <0x66>;
			interrupt-parent = <&msmgpio>;
			interrupts = <102 0>;
			max77803,irq-gpio = <&msmgpio 102 0x00>;
			max77803,irq-base = <353>;
			max77803,wc-irq-gpio = <0>;
			max77803,wakeup = <1>;
			max77803,haptic = <&haptic_pdata>;
		};
	};
};
