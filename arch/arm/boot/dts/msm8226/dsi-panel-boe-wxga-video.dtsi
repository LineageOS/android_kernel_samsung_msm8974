/* Copyright (c) 2013, The Linux Foundation. All rights reserved.
 *
 * This program is free software; you can redistribute it and/or modify
 * it under the terms of the GNU General Public License version 2 and
 * only version 2 as published by the Free Software Foundation.
 *
 * This program is distributed in the hope that it will be useful,
 * but WITHOUT ANY WARRANTY; without even the implied warranty of
 * MERCHANTABILITY or FITNESS FOR A PARTICULAR PURPOSE.  See the
 * GNU General Public License for more details.
 */

&mdss_mdp {
	dsi_boe_wxga_vid: qcom,mdss_dsi_boe_wxga_video {
		qcom,mdss-dsi-panel-name = "BOE WXGA video mode dsi SEC_S6D7AA0 panel";
		qcom,mdss-dsi-panel-controller = <&mdss_dsi0>;
		qcom,mdss-dsi-panel-type = "dsi_video_mode";
		qcom,oled-esd-gpio = <&msmgpio 74 0>;
		qcom,mdss-dsi-panel-destination = "display_1";
		qcom,mdss-dsi-panel-framerate = <60>;
		qcom,mdss-dsi-panel-clock-rate = <500000000>;
		qcom,mdss-dsi-virtual-channel-id = <0>;
		qcom,mdss-dsi-stream = <0>;
		qcom,mdss-dsi-panel-width = <800>;
		qcom,mdss-dsi-panel-height = <1280>;
		qcom,mdss-pan-size = <77 124>; /* <Width> <Height> real size of panel in mm */
		qcom,mdss-dsi-h-back-porch = <140>;
		qcom,mdss-dsi-h-front-porch = <16>;
		qcom,mdss-dsi-h-pulse-width = <4>;
		qcom,mdss-dsi-h-sync-skew = <0>;
		qcom,mdss-dsi-v-back-porch = <4>;
		qcom,mdss-dsi-v-front-porch = <8>;
		qcom,mdss-dsi-v-pulse-width = <4>;
		qcom,mdss-dsi-h-left-border = <0>;
		qcom,mdss-dsi-h-right-border = <0>;
		qcom,mdss-dsi-v-top-border = <0>;
		qcom,mdss-dsi-v-bottom-border = <0>;
		qcom,mdss-dsi-bpp = <24>;
		qcom,mdss-dsi-color-order = <0>;
		qcom,mdss-dsi-underflow-color = <0xff>;
		qcom,mdss-dsi-border-color = <0>;
		qcom,mdss-dsi-mdp-trigger = <0x0>;
		qcom,mdss-dsi-dma-trigger = <0x04>;
		qcom,mdss-dsi-bl-min-level = <1>;
		qcom,mdss-dsi-bl-max-level = <255>;
		qcom,mdss-dsi-bl-pmic-control-type = "bl_ctrl_dcs";
		qcom,mdss-pan-dsi-t-clk-pre = <0x1b>;
		qcom,mdss-pan-dsi-t-clk-post = <0x04>;
		qcom,mdss-dsi-panel-timings = [8C 1E 14 00 44 4a 18 22 18 03 04 00];
		qcom,mdss-dsi-lane-0-state;
		qcom,mdss-dsi-lane-1-state;
		qcom,mdss-dsi-lane-2-state;
		qcom,mdss-dsi-lane-3-state;
		qcom,mdss-dsi-bllp-eof-power-mode;
		qcom,mdss-dsi-bllp-power-mode;
		qcom,mdss-dsi-traffic-mode = <0>;
		qcom,mdss-force-clk-lane-hs = <1>;
		qcom,mdss-dsi-lane-map = <0>;
		qcom,mdss-dsi-h-sync-pulse = <0>;
		

		qcom,mdss-dsi-on-command = [39 01 00 00 01 00 03 F0 5A 5A
					39 01 00 00 01 00 03 F1 5A 5A
					39 01 00 00 01 00 03 FC A5 A5
					39 01 00 00 01 00 02 B1 10
					39 01 00 00 01 00 05 B2 14 22 2F 04
					39 01 00 00 01 00 03 D0 00 10
					39 01 00 00 01 00 06 F2 02 08 08 90 10
					39 01 00 00 01 00 02 B0 04
					39 01 00 00 01 00 02 FD 09
					39 01 00 00 01 00 0B F3 01 C0 E0 62 D0 81 35 30 24 00
					39 01 00 00 01 00 2E F4 00 02 03 26 03 02 09 00 07 16 16 03 00 08 08 03 00 00 12 1C 1D 1E 01 09 01 04 02 61 74 75 72 83 80 80 00 00 01 01 28 04 03 28 01 D1 32
					39 01 00 00 01 00 1B F5 9F 28 28 5F AB 98 4F 0F 33 43 04 59 54 52 05 40 60 40 60 40 27 26 52 25 6D 18
					39 01 00 00 01 00 09 EE 00 00 00 00 00 00 00 00
					39 01 00 00 01 00 09 EF 12 12 43 43 90 84 24 81 
					39 01 00 00 01 00 07 F6 63 25 A6 00 00 14
					39 01 00 00 01 00 12 FA 00 34 01 09 10 07 0D 12 14 1C 23 2B 34 35 2E 2B 30
					39 01 00 00 01 00 12 FB 00 34 01 09 10 07 0D 12 14 1C 23 2B 34 35 2E 2B 30
					39 01 00 00 01 00 21 F7 0A 0A 08 08 0B 0B 09 09 04 05 01 01 01 01 01 01 0A 0A 08 08 0B 0B 09 09 04 05 01 01 01 01 01 01
					05 01 00 00 0A 00 02 11 00 /* Sleep out */
					39 01 00 00 78 00 04 C3 40 00 28
					39 01 00 00 01 00 02 35 00
					05 01 00 00 0A 00 02 29 00
	/* Display On */
					];
		samsung,panel-manufacture-id-read-cmds = [06 01 00 00 00 00 01 da 01
							06 01 00 00 00 00 01 db 01
							06 01 00 00 00 00 01 dc 01];

		qcom,mdss-dsi-on-command-state = "dsi_lp_mode";
		qcom,mdss-dsi-off-command = [05 01 00 00 32 00 02 28 00
					05 01 00 00 78 00 02 10 00];
		qcom,mdss-dsi-off-command-state = "dsi_hs_mode";
	};
};
