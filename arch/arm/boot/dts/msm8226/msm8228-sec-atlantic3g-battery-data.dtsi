/* Copyright (c) 2013, The Linux Foundation. All rights reserved.
 *
 * This program is free software; you can redistribute it and/or modify
 * it under the terms of the GNU General Public License version 2 and
 * only version 2 as published by the Free Software Foundation.
 *
 * This program is distributed in the hope that it will be useful,
 * but WITHOUT ANY WARRANTY; without even the implied warranty of
 * MERCHANTABILITY or FITNESS FOR A PARTICULAR PURPOSE.  See the
 * GNU General Public License for more details.
 */

&soc {
        battery {
                status = "okay";
                compatible = "samsung,sec-battery";
                battery,vendor = "SDI SDI";
                battery,charger_name = "qpnp-chg";
                battery,fuelgauge_name = "bms";
                battery,technology = <2>; /* POWER_SUPPLY_TECHNOLOGY_LION */

                battery,chip_vendor = "QCOM";
                battery,temp_adc_type = <1>; /* SEC_BATTERY_ADC_TYPE_AP */

                battery,polling_time = <10 30 30 30 3600>;

                battery,adc_check_count = <5>;

                battery,cable_check_type = <4>; /* SEC_BATTERY_CABLE_CHECK_PSY */
                battery,cable_source_type = <3>; /* SEC_BATTERY_CABLE_SOURCE_EXTERNAL */
                battery,event_waiting_time = <600>;
                battery,polling_type = <1>; /* SEC_BATTERY_MONITOR_ALARM */
                battery,monitor_initial_count = <3>;

                battery,battery_check_type = <5>; /* SEC_BATTERY_CHECK_CHARGER */
                battery,check_count = <0>;
                battery,check_adc_max = <1440>;
                battery,check_adc_min = <0>;

                battery,ovp_uvlo_check_type = <3>; /* SEC_BATTERY_OVP_UVLO_CHGPOLLING */

                battery,thermal_source = <2>; /* SEC_BATTERY_THERMAL_SOURCE_ADC */
                battery,temp_check_type = <2>; /* SEC_BATTERY_TEMP_CHECK_TEMP */
                battery,temp_check_count = <1>;
                battery,full_check_type = <2>; /* SEC_BATTERY_FULLCHARGED_FG_CURRENT */
                battery,full_check_type_2nd = <3>; /* SEC_BATTERY_FULLCHARGED_TIME */
                battery,full_check_count = <1>;
                battery,chg_gpio_full_check = <0>;
                battery,chg_polarity_full_check = <1>;

                /* SEC_BATTERY_FULL_CONDITION_SOC |
                   SEC_BATTERY_FULL_CONDITION_NOTIMEFULL |
                   SEC_BATTERY_FULL_CONDITION_VCELL */
                battery,full_condition_type = <13>;
                battery,full_condition_soc = <97>;
                battery,full_condition_vcell = <4300>;

                battery,recharge_check_count = <1>;
                battery,recharge_condition_type = <4>; /* SEC_BATTERY_RECHARGE_CONDITION_VCELL */
                battery,recharge_condition_soc = <98>;
                battery,recharge_condition_vcell = <4350>;

                battery,charging_total_time = <21600>;
                battery,recharging_total_time = <5400>;
                battery,charging_reset_time = <0>;

                charger{
                        status = "disable";
                        /* Charger */
                        battery,charger_name = "qpnp-chg";
                        battery,ovp_uvlo_check_type = <3>; /* SEC_BATTERY_OVP_UVLO_CHGPOLLING */
                        battery,full_check_type = <2>; /* SEC_BATTERY_FULLCHARGED_FG_CURRENT */

                        battery,input_current_limit = <500 500 500 1000 500 1000 1000 500 500 1000 650 1000 1000 500 500 300 1000 1000 300 1000 1000 500 500>;
                        battery,fast_charging_current = <500 0 500 1000 500 1000 1000 500 0 1000 750 1000 1000 (-1) 500 300 1000 1000 300 1000 1000 0 0>;
                        battery,full_check_current_1st = <180 0 180 180 180 180 180 180 0 180 180 180 180 0 180 180 180 180 180 180 180 0 0>;
                        battery,full_check_current_2nd = <2400 0 2400 2400 2400 2400 2400 2400 0 2400 2400 2400 2400 0 2400 2400 2400 2400 2400 2400 2400 0 0>;
                };
        };
};
