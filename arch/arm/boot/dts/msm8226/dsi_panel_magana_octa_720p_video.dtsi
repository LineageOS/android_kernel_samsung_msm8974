/* Copyright (c) 2013, The Linux Foundation. All rights reserved.
 *
 * This program is free software; you can redistribute it and/or modify
 * it under the terms of the GNU General Public License version 2 and
 * only version 2 as published by the Free Software Foundation.
 *
 * This program is distributed in the hope that it will be useful,
 * but WITHOUT ANY WARRANTY; without even the implied warranty of
 * MERCHANTABILITY or FITNESS FOR A PARTICULAR PURPOSE.  See the
 * GNU General Public License for more details.
 */

&soc {
	qcom,mdss_dsi_samsung_octa_720p_video {
		compatible = "qcom,mdss-magna-dsi-panel";
		label = "samsung amoled 720p video mode dsi AMS555HBxx-0 panel";
		status = "disable";
		qcom,dsi-ctrl-phandle = <&mdss_dsi0>;
		qcom,rst-gpio = <&msmgpio 25 0>;
		qcom,oled-id-gpio = <&msmgpio 74 0>;
		qcom,mdss-pan-res = <720 1280>;
		qcom,mdss-pan-bpp = <24>;
		qcom,mdss-pan-dest = "display_1";
		qcom,mdss-pan-porch-values = <96 4 52 1 2 13>;/* <HBP> <HPW> <HFP> <VBP> <VPW> <VFP> */
		qcom,mdss-pan-underflow-clr = <0xff>;
		qcom,mdss-pan-bl-ctrl = "bl_ctrl_dcs_cmds";
		qcom,mdss-pan-bl-levels = <1 255>;
		qcom,mdss-pan-dsi-mode = <0>;
		qcom,mdss-pan-dsi-h-pulse-mode = <0>;
		qcom,mdss-pan-dsi-h-power-stop = <0 0 0>;
		qcom,mdss-pan-dsi-bllp-power-stop = <1 1>;
		qcom,mdss-pan-dsi-traffic-mode = <2>;
		qcom,mdss-pan-dsi-dst-format = <3>;
		qcom,mdss-pan-dsi-vc = <0>;
		qcom,mdss-pan-dsi-rgb-swap = <0>;
		qcom,mdss-force-clk-lane-hs = <1>;
		qcom,mdss-pan-dsi-data-lanes = <1 1 1 1>; /* 4 lanes */
		qcom,mdss-pan-dsi-dlane-swap = <0>;
		qcom,mdss-pan-dsi-t-clk = <0x1b 0x04>;
		qcom,mdss-pan-dsi-stream = <0>;
		qcom,mdss-pan-dsi-mdp-tr = <0x0>;
		qcom,mdss-pan-dsi-dma-tr = <0x04>;
		qcom,mdss-pan-frame-rate = <60>;
		qcom,panel-phy-regulatorSettings = [03 01 01 00  /* Regualotor settings */
						    20 00 01];
		qcom,panel-phy-timingSettings = [61 20 18 00 2D 2B
						    1C 22 27 03 04 00];
		qcom,panel-phy-strengthCtrl = [77 06];
		qcom,panel-phy-bistCtrl = [00 00 b1 ff           /* BIST Ctrl settings */
					   00 00];
		qcom,panel-phy-laneConfig = [00 c2 45 00 00 00 00 01 75 /* lane0 config */
					     00 c2 45 00 00 00 00 01 75 /* lane1 config */
					     00 c2 45 00 00 00 00 01 75 /* lane2 config */
					     00 c2 45 00 00 00 00 01 75 /* lane3 config */
					     00 02 45 00 00 00 00 01 97]; /* Clk ln config */
		qcom,panel-on-cmds = [39 01 00 00 00 00 03 f0 5a 5a /* Tesk key ON */
					39 01 00 00 00 00 03 fc 5a 5a /* Tesk key ON */
					39 01 00 00 00 00 20		/* Panel Condition Set LTPS1 */
						c4 4e bd 00 00 58 a7 0b
						34 00 00 00 00 00 0b 92
						0b 92 08 08 07 30 50 30
						00 00 00 00 00 02 04 04
					39 01 00 00 00 00 02 36 02		/* Display Condition Set */
					39 01 00 00 00 00 03 f7 5a 5a	/* Gammna key ON */
					39 01 00 00 00 00 21                   /*check 22 also Brightness Cond Set 1 */
                        ca 01 00 01 00 01 00 80
						80 80 80 80 80 80 80 80
						80 80 80 80 80 80 80 80
						80 80 80 80 80 80 80 31
						02 
					39 01 00 00 00 00 03 f7 a5 a5	/* Gammna key OFF */
					39 01 00 00 00 00 03 b3 00 0a	/* check mismatch wit opmanual AID Setting */
					39 01 00 00 00 00 08		/* ELVSS Setting (300cd)*/
						b2 0B b4 a0 00 00 00 00
					39 01 00 00 00 00 02 55 00		/* ACL2 Off */
					39 01 00 00 00 00 04		/* ACL2 Slew Control*/
						b4 33 0A 00
					05 01 00 00 72 00 02 11 00  /* Sleep out */
					05 01 00 00 32 00 02 29 00		/* Display On */
					];
		samsung,panel-manufacture-id-read-cmds = [ 06 01 00 00 00 00 01 da 01
							   06 01 00 00 00 00 01 db 01
							   06 01 00 00 00 00 01 dc 01];

		qcom,on-cmds-dsi-state = "dsi_lp_mode";
		qcom,panel-off-cmds = [05 01 00 00 32 00 02 28 00
					05 01 00 00 78 00 02 10 00];
		qcom,off-cmds-dsi-state = "dsi_hs_mode";
	};
};
