/* Copyright (c) 2013, The Linux Foundation. All rights reserved.
 *
 * This program is free software; you can redistribute it and/or modify
 * it under the terms of the GNU General Public License version 2 and
 * only version 2 as published by the Free Software Foundation.
 *
 * This program is distributed in the hope that it will be useful,
 * but WITHOUT ANY WARRANTY; without even the implied warranty of
 * MERCHANTABILITY or FITNESS FOR A PARTICULAR PURPOSE.  See the
 * GNU General Public License for more details.
 */

/* qcom,msm-id =<DT_INFO SS_BOARD_HARDWARE_REV QC_SOC_REVISION>
 * All these three fields are unsigned 32 bit integers
 * DT_INFO = [31:24] chip-id, [23:16] platform-id, [15:8] national code, [7:0] operator revision[ reserved]
 * SS_BOARD_HARDWARE_REV = Samsung specific hardware Revision
 * QC_SOC_REVISION = Qcomm SOC Version of MTP Board
 * Please refer to .../lk/platform/msm_shared/dev_tree.c also
 */
 
/dts-v1/;
/include/ "msm8226-v2.dtsi"
/include/ "msm8226-sec-s3ve3geur-r04.dtsi"

/ {
	model = "[S3VE-3G-EUR-OPEN] Rev-04-MTP-v2";
	compatible = "qcom,msm8226-mtp", "qcom,msm8226", "qcom,mtp";
	qcom,msm-id = <0x9e00ff01 4 0x20000>,
			<0x9e08ff01 4 0x20000>,
			<0xdd08ff01 4 0x20000>;
};

&soc {

	earjack {

		/*Override GPIO properties*/
		qcom,earjack-detect-gpio = <&msmgpio 69 0>;
		qcom,earjack-sendend-gpio = <&msmgpio 35 0>;
		/*Override det and btn zone ADC Values*/
		det-zones-list = <&det_zones 900 10000 10 0>,
                             <&det_zones 901 10000 10 1>,
                             <&det_zones 2200 10000 10 1>,
                             <&det_zones 9999 10000 10 1>;
		but-zones-list = <&but_zones 0 0 320>,
                             <&but_zones 1 321 440>,
                             <&but_zones 2 441 9999>;
		mpp-channel-scaling = <8 1 3>;
	};
};
