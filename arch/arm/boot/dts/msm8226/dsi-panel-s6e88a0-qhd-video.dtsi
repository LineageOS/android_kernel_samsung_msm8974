/* Copyright (c) 2013, The Linux Foundation. All rights reserved. * * This program is free software; you can redistribute it and/or modify * it under the terms of the GNU General Public License version 2 and * only version 2 as published by the Free Software Foundation. * * This program is distributed in the hope that it will be useful, * but WITHOUT ANY WARRANTY; without even the implied warranty of * MERCHANTABILITY or FITNESS FOR A PARTICULAR PURPOSE.  See the * GNU General Public License for more details. */&mdss_mdp {	dsi_s6e88a0_qhd_panel: qcom,mdss_dsi_s6e88a0_qhd_video {		qcom,mdss-dsi-panel-name = "samsung,mdss-amoled-dsi-panel";		label = "samsung amoled qhd video mode dsi S6E88A0 panel";		status = "disable";		qcom,mdss-dsi-panel-controller = <&mdss_dsi0>;		qcom,enable-gpio = <&msmgpio 63 0>;		qcom,rst-gpio = <&msmgpio 25 0>;		qcom,esd-irq-gpio = <&msmgpio 16 0>;		qcom,cont-splash-enabled = <1>;		qcom,mdss-ad-off = <0>;		qcom,mdss-dsi-panel-type = "dsi_video_mode";		qcom,mdss-pan-res = <540 960>;		qcom,mdss-pan-size = <64 114>; /* <Width> <Height> real size of panel in mm */		qcom,mdss-pan-bpp = <24>;		qcom,mdss-pan-dest = "display_1";		qcom,mdss-clk-rate=<461000000>;		qcom,mdss-pan-porch-values = <20 3 93 4 1 10>; /* <HBP> <HPW> <HFP> <VBP> <VPW> <VFP> */		qcom,mdss-pan-underflow-clr = <0xff>;		qcom,mdss-pan-bl-ctrl = "bl_ctrl_dcs_cmds";		qcom,mdss-pan-bl-levels = <1 255>;		qcom,mdss-pan-dsi-mode = <0>;		qcom,mdss-pan-dsi-h-pulse-mode = <0>;		qcom,mdss-pan-dsi-h-power-stop = <0 0 0>;		qcom,mdss-pan-dsi-bllp-power-stop = <1 1>;		qcom,mdss-pan-dsi-traffic-mode = <2>;		qcom,mdss-pan-dsi-dst-format = <3>;		qcom,mdss-pan-dsi-vc = <0>;		qcom,mdss-pan-dsi-rgb-swap = <0>;		qcom,mdss-force-clk-lane-hs = <1>;		samsung,mdss-early-lcd-on = <1>;		qcom,mdss-pan-dsi-data-lanes = <1 1 0 0>;		qcom,mdss-pan-dsi-dlane-swap = <0>;		qcom,mdss-pan-dsi-t-clk = <0x2c 0x20>;		qcom,mdss-pan-dsi-stream = <0>;		qcom,mdss-pan-dsi-mdp-tr = <0x0>;		qcom,mdss-pan-dsi-dma-tr = <0x04>;		qcom,mdss-pan-dsi-frame-rate = <60>;		qcom,panel-phy-regulatorSettings = [07 09 03 00  /* Regualotor settings */						    20 00 01];		qcom,panel-phy-timingSettings = [58 17 17 01 2f 2e /* 461Mbps timing */						    1c 1c 12 03 04 00];		qcom,panel-phy-strengthCtrl = [ff 06];		/*!!!! */		qcom,panel-phy-bistCtrl = [00 00 b1 ff           /*!!!! BIST Ctrl settings */					   00 00];		qcom,panel-phy-laneConfig = [		00 00 00 00 00 00 00 01 97 /* lane0 config */		00 00 00 00 05 00 00 01 97 /* lane1 config */		00 00 00 00 0a 00 00 01 97 /* lane2 config */		00 00 00 00 0f 00 00 01 97 /* lane3 config */		00 c0 00 00 00 00 00 01 bb]; /* Clk ln config */		qcom,panel-on-cmds = [			39 01 00 00 00 00 03 f0 5a 5a /* Tesk key ON */			39 01 00 00 00 00 03 fc 5a 5a			05 01 00 00 78 00 02 11 00 /* Sleep out  wait 120ms */			/* Brightness condition set */			39 01 00 00 00 00 22 /* Brightness gamma */				ca 01 00 01 00 01 00 80				80 80 80 80 80 80 80 80				80 80 80 80 80 80 80 80				80 80 80 80 80 80 80 00				00 00			39 01 00 00 00 00 06 b2 40 08 20 00 08 /* AID set */			39 01 00 00 00 00 02 f7 03 /* Gamma AID update */			/* ELVSS Condition set */			39 01 00 00 00 00 03 b6 28 0b /* ELVSS */			/* ETC */			39 01 00 00 00 00 02 55 00 /* ACL set */			/* LR Flip */			39 01 00 00 00 00 02 cb 1f /* ACL set */			39 01 00 00 00 00 02 f7 03			/* Panel condition set */				39 01 00 00 00 00 03 fc a5 a5 /* Tesk key OFF */			05 01 00 00 00 00 02 29 00 /* Display on */					];		qcom,on-cmds-dsi-state = "dsi_lp_mode";		qcom,panel-off-cmds = [					05 01 00 00 32 00 02 28 00					05 01 00 00 78 00 02 10 00];		qcom,off-cmds-dsi-state = "dsi_hs_mode";		qcom,panel-touchsensing-on-cmds = [29 01 00 00 00 00 03 ff 07 01];		qcom,panel-touchsensing-off-cmds = [29 01 00 00 12 00 03 ff 1f 01];				/*			the last byte in read commands  represent READ LENGH,			like below  READ LENGH = 0x21		 */			samsung,panel-nv-mtp-read-cmds = [ 06 01 00 00 00 00 01 c8 21 00];			samsung,panel-nv-mtp-read-hbm-cmds = [ 06 01 00 00 00 00 01 c8 06 21];	/* read C8 34~39th , 33=0x21*/			samsung,panel-nv-mtp-read-hbm2-cmds = [ 06 01 00 00 00 00 01 c8 0F 48];	/* read C8 73~87th , 72=0x48*/			samsung,panel-nv-mdnie-read-cmds = [ 06 01 00 00 00 00 01 A1 04 00];			samsung,panel-nv-read-cmds = [ 06 01 00 00 00 00 01 c8 21 00];			samsung,panel-nv-read-enable-cmds = [								29 01 00 00 00 00 03 f0 5a 5a								29 01 00 00 00 00 03 fc 5a 5a ];			samsung,panel-nv-read-disable-cmds = [ 29 01 00 00 00 00 03 f0 a5 a5 ];			/* the last byte in all read commands will represent READ LENGH */			samsung,panel-manufacture-id-read-cmds = [								06 01 00 00 00 00 01 da 01 00								06 01 00 00 00 00 01 db 01 00								06 01 00 00 00 00 01 dc 01 00];			qcom,panel-display-on-cmds = [05 01 00 00 32 00 02 29 00];			qcom,panel-display-off-cmds = [05 01 00 00 32 00 02 28 00];										qcom,panel-display-unblank-cmds = [05 01 00 00 32 00 02 13 00];			/*Normal mode command*/			qcom,panel-display-blank-cmds = [05 01 00 00 45 00 02 22 00];		 /* All pixel off - for making display black*/			samsung,panel-acl-off-cmds = [29 01 00 00 72 00 02 55 00];			samsung,panel-gamma-cmds-list = [29 01 00 00 00 00 22            /* Brightness Condition Set - Gamma 2.2 Setting*/						ca 01 00 01 00 01 00 80						80 80 80 80 80 80 80 80						80 80 80 80 80 80 80 80						80 80 80 80 80 80 80 00						00 00					29 01 00 00 00 00 03 F7 03 00  /* Gamma, LTPS(AID) update */				];			samsung,panel-gamma-hbm-cmds-list = [29 01 00 00 00 00 22            /* Brightness Condition Set - Gamma 2.2 Setting*/						ca 01 00 01 00 01 00 80						80 80 80 80 80 80 80 80						80 80 80 80 80 80 80 80						80 80 80 80 80 80 80 00						00 00					29 01 00 00 00 00 03 F7 03 00  /* Gamma, LTPS(AID) update */				];			samsung,panel-etc-hbm-cmds = [					29 01 00 00 00 00 08 B2 01 00 00 00 00 00 06	/* samsung_brightness_aor_condition */					29 01 00 00 00 00 03 b6 2c 01 		/* ELVSS  */					29 01 00 00 00 00 04	B5 01 99 35		/* acl cont */					29 01 00 00 00 00 05	E3 FF FF FF FF		/* als cont */					29 01 00 00 00 00 02 55 41	   	/* power saving Set */					29 01 00 00 00 00 03	BC 20 38		/* psre cont *//*					29 01 00 00 00 00 3B	BC 	20 38 64 64 00 03 E8 00 00 B2	C2 C2 AC AE C1 B5 00 78 B1 6C	00 00 00 00 00 B8 B8 A8 90 90	A8 A0 00 88 90 90 08 00 00 00	00 55 55 55 5A 3A 28 28 2A 48	24 2A 05 05 05 05 05 04*/				];			/*			 * ************************************************************************************************************************			 * AID command list and mappings			 * ************************************************************************************************************************			 */			samsung,panel-aid-cmds-list = [				29 01 00 00 00 00 05 B2 00 06 00 0C /* 0 samsung_brightness_aor_0p8 */				29 01 00 00 00 00 05 B2 00 06 03 06 /* 1 samsung_brightness_aor_40p0 */				29 01 00 00 00 00 05 B2 00 06 00 10 /* 2 samsung_brightness_aor_0p8 */				29 01 00 00 00 00 05 B2 00 06 00 5F /* 3 samsung_brightness_aor_4p9 */				29 01 00 00 00 00 05 B2 00 06 00 E7 /* 4 samsung_brightness_aor_11p9 */				29 01 00 00 00 00 05 B2 00 06 01 3E /* 5 samsung_brightness_aor_16p4 */				29 01 00 00 00 00 05 B2 00 06 01 A3 /* 6 samsung_brightness_aor_21p7 */				29 01 00 00 00 00 05 B2 00 06 02 07 /* 7 samsung_brightness_aor_26p8 */				29 01 00 00 00 00 05 B2 00 06 02 6A /* 8 samsung_brightness_aor_32p0 */				29 01 00 00 00 00 05 B2 00 06 02 B9 /* 9 samsung_brightness_aor_36p0 */				29 01 00 00 00 00 05 B2 00 06 03 07 /* 10 samsung_brightness_aor_40p1 */				29 01 00 00 00 00 05 B2 00 06 03 55 /* 11 samsung_brightness_aor_44p1 */				29 01 00 00 00 00 05 B2 00 06 03 A1 /* 12 samsung_brightness_aor_48p0 */				29 01 00 00 00 00 05 B2 00 06 03 DB /* 13 samsung_brightness_aor_51p0 */				29 01 00 00 00 00 05 B2 00 06 04 15 /* 14 samsung_brightness_aor_54p0 */				29 01 00 00 00 00 05 B2 00 06 04 4C /* 15 samsung_brightness_aor_56p9 */				29 01 00 00 00 00 05 B2 00 06 04 83 /* 16 samsung_brightness_aor_59p7 */				29 01 00 00 00 00 05 B2 00 06 04 BA /* 17 samsung_brightness_aor_62p6 */				29 01 00 00 00 00 05 B2 00 06 04 DF /* 18 samsung_brightness_aor_64p5 */				29 01 00 00 00 00 05 B2 00 06 05 03 /* 19 samsung_brightness_aor_66p3 */				29 01 00 00 00 00 05 B2 00 06 05 3A /* 20 samsung_brightness_aor_69p2 */				29 01 00 00 00 00 05 B2 00 06 05 5E /* 21 samsung_brightness_aor_71p0 */				29 01 00 00 00 00 05 B2 00 06 05 83 /* 22 samsung_brightness_aor_73p0 */				29 01 00 00 00 00 05 B2 00 06 05 94 /* 23 samsung_brightness_aor_73p8 */				29 01 00 00 00 00 05 B2 00 06 05 B7 /* 24 samsung_brightness_aor_75p6 */				29 01 00 00 00 00 05 B2 00 06 05 DA /* 25 samsung_brightness_aor_77p5 */				29 01 00 00 00 00 05 B2 00 06 05 EC /* 26 samsung_brightness_aor_78p4 */				29 01 00 00 00 00 05 B2 00 06 06 0F /* 27 samsung_brightness_aor_80p2 */				29 01 00 00 00 00 05 B2 00 06 06 20 /* 28 samsung_brightness_aor_81p1 */				29 01 00 00 00 00 05 B2 00 06 06 32 /* 29 samsung_brightness_aor_82p0 */				29 01 00 00 00 00 05 B2 00 06 06 43 /* 30 samsung_brightness_aor_82p9 */				29 01 00 00 00 00 05 B2 00 06 06 65 /* 31 samsung_brightness_aor_84p6 */				29 01 00 00 00 00 05 B2 00 06 06 76 /* 32 samsung_brightness_aor_85p5 */				29 01 00 00 00 00 05 B2 00 06 06 87 /* 33 samsung_brightness_aor_86p4 */				29 01 00 00 00 00 05 B2 00 06 06 98 /* 34 samsung_brightness_aor_87p3 */				29 01 00 00 00 00 05 B2 00 06 06 A9 /* 35 samsung_brightness_aor_88p2 */				29 01 00 00 00 00 05 B2 00 06 06 BA /* 36 samsung_brightness_aor_89p0 */				29 01 00 00 00 00 05 B2 00 06 06 CB /* 37 samsung_brightness_aor_89p9 */				29 01 00 00 00 00 05 B2 00 06 06 DD /* 38 samsung_brightness_aor_90p8 */				29 01 00 00 00 00 05 B2 00 06 06 EE /* 39 samsung_brightness_aor_91p7 */				29 01 00 00 00 00 05 B2 00 06 06 FE /* 40 samsung_brightness_aor_92p6 */				29 01 00 00 00 00 05 B2 00 06 07 0F /* 41 samsung_brightness_aor_93p4 */				29 01 00 00 00 00 05 B2 00 06 07 1F /* 42 samsung_brightness_aor_94p3 */				29 01 00 00 00 00 05 B2 00 06 07 23 /* 43 samsung_brightness_aor_94p5 */				29 01 00 00 00 00 05 B2 00 06 00 06 /* 44 samsung_brightness_aor_ref */			];			samsung,panel-aid-cmds-list-350 = [				29 01 00 00 00 00 05 B2 00 06 00 06 /* 0 samsung_brightness_aor_0p4 */				29 01 00 00 00 00 05 B2 00 06 03 06 /* 1 samsung_brightness_aor_40p0 */				29 01 00 00 00 00 05 B2 00 06 00 08 /* 2 samsung_brightness_aor_0p4 */				29 01 00 00 00 00 05 B2 00 06 00 77 /* 3 samsung_brightness_aor_6p2 */				29 01 00 00 00 00 05 B2 00 06 00 E5 /* 4 samsung_brightness_aor_11p8 */				29 01 00 00 00 00 05 B2 00 06 01 50 /* 5 samsung_brightness_aor_17p4 */				29 01 00 00 00 00 05 B2 00 06 01 B3 /* 6 samsung_brightness_aor_22p5 */				29 01 00 00 00 00 05 B2 00 06 02 15 /* 7 samsung_brightness_aor_27p6 */				29 01 00 00 00 00 05 B2 00 06 02 76 /* 8 samsung_brightness_aor_32p6 */				29 01 00 00 00 00 05 B2 00 06 02 B2 /* 9 samsung_brightness_aor_35p7 */				29 01 00 00 00 00 05 B2 00 06 03 01 /* 10 samsung_brightness_aor_39p8 */				29 01 00 00 00 00 05 B2 00 06 03 65 /* 11 samsung_brightness_aor_44p9 */				29 01 00 00 00 00 05 B2 00 06 03 AE /* 12 samsung_brightness_aor_48p7 */				29 01 00 00 00 00 05 B2 00 06 03 E5 /* 13 samsung_brightness_aor_51p6 */				29 01 00 00 00 00 05 B2 00 06 04 1C /* 14 samsung_brightness_aor_54p4 */				29 01 00 00 00 00 05 B2 00 06 04 54 /* 15 samsung_brightness_aor_57p3 */				29 01 00 00 00 00 05 B2 00 06 04 8C /* 16 samsung_brightness_aor_60p2 */				29 01 00 00 00 00 05 B2 00 06 04 C5 /* 17 samsung_brightness_aor_63p1 */				29 01 00 00 00 00 05 B2 00 06 04 E9 /* 18 samsung_brightness_aor_65p0 */				29 01 00 00 00 00 05 B2 00 06 05 0C /* 19 samsung_brightness_aor_66p8 */				29 01 00 00 00 00 05 B2 00 06 05 41 /* 20 samsung_brightness_aor_69p5 */				29 01 00 00 00 00 05 B2 00 06 05 64 /* 21 samsung_brightness_aor_71p4 */				29 01 00 00 00 00 05 B2 00 06 05 88 /* 22 samsung_brightness_aor_73p2 */				29 01 00 00 00 00 05 B2 00 06 05 99 /* 23 samsung_brightness_aor_74p1 */				29 01 00 00 00 00 05 B2 00 06 05 BC /* 24 samsung_brightness_aor_75p9 */				29 01 00 00 00 00 05 B2 00 06 05 E0 /* 25 samsung_brightness_aor_77p8 */				29 01 00 00 00 00 05 B2 00 06 05 F1 /* 26 samsung_brightness_aor_78p6 */				29 01 00 00 00 00 05 B2 00 06 06 14 /* 27 samsung_brightness_aor_80p5 */				29 01 00 00 00 00 05 B2 00 06 06 26 /* 28 samsung_brightness_aor_81p4 */				29 01 00 00 00 00 05 B2 00 06 06 38 /* 29 samsung_brightness_aor_82p3 */				29 01 00 00 00 00 05 B2 00 06 06 48 /* 30 samsung_brightness_aor_83p1 */				29 01 00 00 00 00 05 B2 00 06 06 69 /* 31 samsung_brightness_aor_84p9 */				29 01 00 00 00 00 05 B2 00 06 06 7A /* 32 samsung_brightness_aor_85p7 */				29 01 00 00 00 00 05 B2 00 06 06 8B /* 33 samsung_brightness_aor_86p6 */				29 01 00 00 00 00 05 B2 00 06 06 9B /* 34 samsung_brightness_aor_87p4 */				29 01 00 00 00 00 05 B2 00 06 06 AC /* 35 samsung_brightness_aor_88p3 */				29 01 00 00 00 00 05 B2 00 06 06 BC /* 36 samsung_brightness_aor_89p1 */				29 01 00 00 00 00 05 B2 00 06 06 CD /* 37 samsung_brightness_aor_90p0 */				29 01 00 00 00 00 05 B2 00 06 06 DE /* 38 samsung_brightness_aor_90p9 */				29 01 00 00 00 00 05 B2 00 06 06 EF /* 39 samsung_brightness_aor_91p8 */				29 01 00 00 00 00 05 B2 00 06 07 00 /* 40 samsung_brightness_aor_92p7 */				29 01 00 00 00 00 05 B2 00 06 07 11 /* 41 samsung_brightness_aor_93p5 */				29 01 00 00 00 00 05 B2 00 06 07 22 /* 42 samsung_brightness_aor_94p4 */				29 01 00 00 00 00 05 B2 00 06 07 31 /* 43 samsung_brightness_aor_95p2 */				29 01 00 00 00 00 05 B2 00 06 00 08 /* 44 samsung_brightness_aor_ref */			];			/* bl_level, Index in acl command list */			samsung,panel-aid-map-table = <					10   38        11   37       12   36       13   35     14   34					15   33        16   32       17   31       19   30     20   29					21   28        22   27       24   26       25   25     27   24					29   23        30   22       32   21       34   20     37   19					39   18        41   17       44   16       47   15     50   14					53   13        56   12       60   11       64   10     68   9					72   8         77   7        82   6        87   5      93   4					98   3         105  2        111  1        119  1      126  1					134  1         143  1        152  1        162  1      172  1					183  0         195  0        207  0        220  0      234  0					249  0         265  0        282  0        300  0				>;			/* 			 * ************************************************************************************************************************			 * ACL command list and mappings			 * ************************************************************************************************************************			 */			 /* B5h 			   * 1st - 0x01 : PSRE , 0x03 : no PSRE			   * 2nd(OPR) - 0x99 : 60% 			   * 3rd(ACL) - 0x23 : 27.6% , 0x27 : 30%, 0x35 : 40% 			   */			samsung,panel-aclcont-cmds-list = [					29 01 00 00 00 00 04	B5 03 99 35	 /* 0x27 : 30% */			 ];			samsung,panel-acl-cmds-list = [					29 01 00 00 00 00 02 55 00 /* 0 */					29 01 00 00 00 00 02 55 01 /* 1 */					29 01 00 00 00 00 02 55 02 /* 2 */					29 01 00 00 00 00 02 55 03]; /* 3 */			/* bl_level , Index in acl command list */			samsung,panel-acl-map-table =  <					10   1         11   1        12   1         13   1      14   1					15   1         16   1        17   1         19   1      20   1					21   1         22   1        24   1         25   1      27   1					29   1         30   1        32   1         34   1      37   1					39   1         41   1        44   1         47   1      50   1					53   1         56   1        60   1         64   1      68   1					72   1         77   1        82   1         87   1      93   1					98   1         105  1        111  1         119  1      126  1					134  1         143  1        152   1        162  1     172   1					183  1         195  1        207   1        220  1     234   1					249  1         265  1        282   1        300  1				>;			/*			 * ************************************************************************************************************************			 * ELVSS command list and mappings			 * ************************************************************************************************************************			 */			samsung,panel-elvss-cmds-list = [					29 01 00 00 00 00 11 b6 2C 19 00 00 00 00 00 00 00 00 00 00 00 00 00 00	/* 0 default case = DEFAULT_ELVSS_EVT1(0xA) + 0xF*/					29 01 00 00 00 00 11 b6 2C 15 00 00 00 00 00 00 00 00 00 00 00 00 00 00	/* 1 DEFAULT_ELVSS_EVT1(0xA) + 0xB*/					29 01 00 00 00 00 11 b6 2C 14 00 00 00 00 00 00 00 00 00 00 00 00 00 00	/* 2 DEFAULT_ELVSS_EVT1(0xA) + 0xA*/					29 01 00 00 00 00 11 b6 2C 13 00 00 00 00 00 00 00 00 00 00 00 00 00 00	/* 3 DEFAULT_ELVSS_EVT1(0xA) + 0x9*/					29 01 00 00 00 00 11 b6 2C 12 00 00 00 00 00 00 00 00 00 00 00 00 00 00	/* 4 DEFAULT_ELVSS_EVT1(0xA) + 0x8*/					29 01 00 00 00 00 11 b6 2C 11 00 00 00 00 00 00 00 00 00 00 00 00 00 00	/* 5 DEFAULT_ELVSS_EVT1(0xA) + 0x7*/					29 01 00 00 00 00 11 b6 2C 10 00 00 00 00 00 00 00 00 00 00 00 00 00 00	/* 6 DEFAULT_ELVSS_EVT1(0xA) + 0x6*/					29 01 00 00 00 00 11 b6 2C 0F 00 00 00 00 00 00 00 00 00 00 00 00 00 00	/* 7 DEFAULT_ELVSS_EVT1(0xA) + 0x5*/					29 01 00 00 00 00 11 b6 2C 0E 00 00 00 00 00 00 00 00 00 00 00 00 00 00	/* 8 DEFAULT_ELVSS_EVT1(0xA) + 0x4*/					29 01 00 00 00 00 11 b6 2C 0D 00 00 00 00 00 00 00 00 00 00 00 00 00 00	/* 9 DEFAULT_ELVSS_EVT1(0xA) + 0x3*/					29 01 00 00 00 00 11 b6 2C 0B 00 00 00 00 00 00 00 00 00 00 00 00 00 00	/* 10 DEFAULT_ELVSS_EVT1(0xA) + 0x1*/					29 01 00 00 00 00 11 b6 2C 0A 00 00 00 00 00 00 00 00 00 00 00 00 00 00	/* 11 DEFAULT_ELVSS_EVT1(0xA) + 0x0*/				];			samsung,panel-elvss-lowtemp-cmds-list = [					29 01 00 00 00 00 11 b6 2C 15 00 00 00 00 00 00 00 00 00 00 00 00 00 00	/* 0 default case = DEFAULT_ELVSS_EVT1(0xA) + 0xF - 0x4*/					29 01 00 00 00 00 11 b6 2C 11 00 00 00 00 00 00 00 00 00 00 00 00 00 00	/* 1 DEFAULT_ELVSS_EVT1(0xA) + 0xB - 0x4*/					29 01 00 00 00 00 11 b6 2C 10 00 00 00 00 00 00 00 00 00 00 00 00 00 00	/* 2 DEFAULT_ELVSS_EVT1(0xA) + 0xA - 0x4*/					29 01 00 00 00 00 11 b6 2C 0F 00 00 00 00 00 00 00 00 00 00 00 00 00 00	/* 3 DEFAULT_ELVSS_EVT1(0xA) + 0x9 - 0x4*/					29 01 00 00 00 00 11 b6 2C 0E 00 00 00 00 00 00 00 00 00 00 00 00 00 00	/* 4 DEFAULT_ELVSS_EVT1(0xA) + 0x8 - 0x4*/					29 01 00 00 00 00 11 b6 2C 0D 00 00 00 00 00 00 00 00 00 00 00 00 00 00	/* 5 DEFAULT_ELVSS_EVT1(0xA) + 0x7 - 0x4*/					29 01 00 00 00 00 11 b6 2C 0C 00 00 00 00 00 00 00 00 00 00 00 00 00 00	/* 6 DEFAULT_ELVSS_EVT1(0xA) + 0x6 - 0x4*/					29 01 00 00 00 00 11 b6 2C 0B 00 00 00 00 00 00 00 00 00 00 00 00 00 00	/* 7 DEFAULT_ELVSS_EVT1(0xA) + 0x5 - 0x4*/					29 01 00 00 00 00 11 b6 2C 0A 00 00 00 00 00 00 00 00 00 00 00 00 00 00	/* 8 DEFAULT_ELVSS_EVT1(0xA) + 0x4 - 0x4*/					29 01 00 00 00 00 11 b6 2C 09 00 00 00 00 00 00 00 00 00 00 00 00 00 00	/* 9 DEFAULT_ELVSS_EVT1(0xA) + 0x3 - 0x4*/					29 01 00 00 00 00 11 b6 2C 07 00 00 00 00 00 00 00 00 00 00 00 00 00 00	/* 10 DEFAULT_ELVSS_EVT1(0xA) + 0x1 - 0x4*/					29 01 00 00 00 00 11 b6 2C 06 00 00 00 00 00 00 00 00 00 00 00 00 00 00	/* 11 DEFAULT_ELVSS_EVT1(0xA) + 0x0 - 0x4*/				];			samsung,panel-elvss-cmds-tempcompen-list = [29 01 00 00 00 00 08 B8 38 07 30 00 28 19 02];			/* bl_level, Index in elvss command list */			samsung,panel-elvss-map-table = <					10   0	       11   0        12   0         13   0      14   0					15   0         16   0        17   0         19   0      20   0					21   0         22   0        24   0         25   0      27   0					29   0         30   0        32   0         34   0      37   0					39   0         41   0        44   0         47   0      50   0					53   0         56   0        60   0         64   0      68   0					72   0         77   0        82   0         87   0      93   0					98   0         105  0        111  1         119  2      126  3					134  4         143  5        152  6         162  7      172  7					183  3         195  4        207  5         220  6      234  7					249  8         265  9        282  10        300  11					>;			/*			 * ************************************************************************************************************************			 * candela to index mappings			 * ************************************************************************************************************************			 */			samsung,panel-candella-mapping-table = <				/*<idx>		<from>		<till>		<candella> */				0		0		10		10				1		11		11		11				2		12		12		12				3		13		13		13				4		14		14		14				5		15		15		15				6		16		16		16				7		17		18		17				8		19		19		19				9		20		20		20				10		21		21		21				11		22		23		22				12		24		24		24				13		25		26		25				14		27		28		27				15		29		29		29				16		30		31		30				17		32		32		32				18		33		36		34				19		37		38		37				20		39		40		39				21		41		43		41				22		44		46		44				23		47		49		47				24		50		52		50				25		53		55		53				26		56		59		56				27		60		63		60				28		64		67		64				29		68		71		68				30		72		76		72				31		77		81		77				32		82		86		82				33		87		92		87				34		93		97		93				35		98		104		98				36		105		110		105				37		111		118		111				38		119		125		119				39		126		133		126				40		134		142		134				41		143		149		143				42		150		161		152				43		162		171		162				44		172		182		172				45		183		194		183				46		195		206		195				47		207		219		207				48		220		232		220				49		233		248		234				50		249		249		249				51		250		251		265				52		252		253		282				53		254		255		300				>;			samsung,panel-candella-mapping-table-350 = <				/*<idx>		<from>		<till>		<candella> */				0		0		2		2				1		3		3		3				2		4		4		4				3		5		5		5				4		6		6		6				5		7		7		7				6		8		8		8				7		9		9		9				8		10		10		10				9		11		11		11				10		12		12		12				11		13		13		13				12		14		14		14				13		15		15		15				14		16		16		16				15		17		18		17				16		19		19		19				17		20		20		20				18		21		21		21				19		22		23		22				20		24		24		24				21		25		26		25				22		27		28		27				23		29		29		29				24		30		31		30				25		32		32		32				26		33		36		34				27		37		38		37				28		39		40		39				29		41		43		41				30		44		46		44				31		47		49		47				32		50		52		50				33		53		55		53				34		56		59		56				35		60		63		60				36		64		67		64				37		68		71		68				38		72		76		72				39		77		81		77				40		82		86		82				41		87		92		87				42		93		97		93				43		98		104		98				44		105		110	 	105				45		111		118		111				46		119	 	125		119				47		126	 	133		126				48		134	 	142		134				49		143	 	149		143				50		150	 	161		152				51		162	 	171		162				52		172	 	181		172				53		182	 	193		183				54		194	 	205		195				55		206	 	218		207				56		219	 	229		220				57		230	 	237		234				58		238	 	241		249				59		242	 	244		265				60		245	 	247		282				61		248	 	249		300				62		250	 	251		316				63		252	 	253		333				64		254	 	255 	350				>;			/* Lux table mapping for Smart dimming*/			samsung,panel-smart-dimming-lux-table = <				10  11  12  13  14				15  16  17  19  20				21  22  24  25  27				29  30  32  34  37				39  41  44  47  50				53  56  60  64  68				72  77  82  87  93				98  105 111 119 126				134 143 152 162 172				183 195 207 220 234				249 265 282 300>;	};};