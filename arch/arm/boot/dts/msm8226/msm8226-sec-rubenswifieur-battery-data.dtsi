/* Copyright (c) 2013, The Linux Foundation. All rights reserved.
 *
 * This program is free software; you can redistribute it and/or modify
 * it under the terms of the GNU General Public License version 2 and
 * only version 2 as published by the Free Software Foundation.
 *
 * This program is distributed in the hope that it will be useful,
 * but WITHOUT ANY WARRANTY; without even the implied warranty of
 * MERCHANTABILITY or FITNESS FOR A PARTICULAR PURPOSE.  See the
 * GNU General Public License for more details.
 */
 
&soc {
		battery {
				status = "okay";
				compatible = "samsung,sec-battery";
				battery,vendor = "SDI SDI";
				battery,charger_name = "sec-charger";
				battery,fuelgauge_name = "sec-fuelgauge";
				battery,technology = <2>; /* POWER_SUPPLY_TECHNOLOGY_LION */
				battery,ta_irq_attr = <0x3>;

				battery,chip_vendor = "QCOM";
				battery,temp_adc_type = <1>; /* SEC_BATTERY_ADC_TYPE_AP */

				battery,polling_time = <10 30 30 30 3600>;

				battery,adc_check_count = <5>;

				battery,cable_check_type = <5>; /* SEC_BATTERY_CABLE_CHECK_PSY */
				battery,cable_source_type = <3>; /* SEC_BATTERY_CABLE_SOURCE_EXTERNAL */
				battery,event_check;
				battery,event_waiting_time = <600>;
				battery,polling_type = <1>; /* SEC_BATTERY_MONITOR_ALARM */
				battery,monitor_initial_count = <3>;
				battery,use_wireless_to_pogo = <1>;
				battery,battery_check_type = <1>; /* SEC_BATTERY_CHECK_ADC */
				battery,check_count = <0>;
				battery,check_adc_max = <500000>;
				battery,check_adc_min = <0>;

				battery,ovp_uvlo_check_type = <3>; /* SEC_BATTERY_OVP_UVLO_CHGPOLLING */

				battery,thermal_source = <2>; /* SEC_BATTERY_THERMAL_SOURCE_ADC */

				battery,temp_table_adc = <27281 27669 28178 28724 29342 30101 30912 31807 32823 33858 34950 36049 37054
					38025 38219 38448 38626 38795 38989 39229 39540 39687 39822 40523 41123 41619>;
				battery,temp_table_data = <700 650 600 550 500 450 400 350 300 250 200 150 100
					50 40 30 20 10 0 (-10) (-30) (-40) (-50) (-100) (-150) (-200)>;
				battery,temp_check_type = <2>; /* SEC_BATTERY_TEMP_CHECK_TEMP */
				battery,temp_check_count = <1>;
				battery,temp_high_threshold_event = <600>;
				battery,temp_high_recovery_event = <450>;
				battery,temp_low_threshold_event = <(-50)>;
				battery,temp_low_recovery_event = <0>;
				battery,temp_high_threshold_normal = <600>;
				battery,temp_high_recovery_normal = <450>;
				battery,temp_low_threshold_normal = <(-50)>;
				battery,temp_low_recovery_normal = <0>;
				battery,temp_high_threshold_lpm = <600>;
				battery,temp_high_recovery_lpm = <450>;
				battery,temp_low_threshold_lpm = <(-50)>;
				battery,temp_low_recovery_lpm = <0>;
				battery,full_check_type = <7>; /* SEC_BATTERY_FULLCHARGED_CHGPSY */
				battery,full_check_type_2nd = <3>; /* SEC_BATTERY_FULLCHARGED_TIME */
				battery,full_check_count = <1>;
				battery,chg_gpio_full_check = <0>;
				battery,chg_polarity_full_check = <1>;

				/* SEC_BATTERY_FULL_CONDITION_SOC |
				   SEC_BATTERY_FULL_CONDITION_NOTIMEFULL |
				   SEC_BATTERY_FULL_CONDITION_VCELL */
				battery,full_condition_type = <13>;
				battery,full_condition_soc = <95>;
				battery,full_condition_vcell = <4250>;

				battery,recharge_check_count = <1>;
				battery,recharge_condition_type = <4>; /* SEC_BATTERY_RECHARGE_CONDITION_VCELL */
				battery,recharge_condition_soc = <98>;
				battery,recharge_condition_vcell = <4300>;

				battery,charging_total_time = <21600>;
				battery,recharging_total_time = <5400>;
				battery,charging_reset_time = <0>;

				charger{
						status = "disable";
						/* Charger */
						battery,charger_name = "sec-charger";
						battery,chg_gpio_en = <0>;
						battery,chg_polarity_en = <0>;
						battery,chg_gpio_status = <0>;
						battery,chg_polarity_status = <0>;
						battery,chg_float_voltage = <4350>;
						battery,ovp_uvlo_check_type = <3>; /* SEC_BATTERY_OVP_UVLO_CHGPOLLING */
						battery,full_check_type = <7>; /*  SEC_BATTERY_FULLCHARGED_CHGPSY */

						battery,input_current_limit = <1800 460 460 1800 460 900 1000 460 460 1000 1000 1800 1800 460 1300 400 700 1300 300 1000 1800 460 460>;
						battery,fast_charging_current = <2100 0 460 2100 460 1200 1000 460 0 1200 1000 2100 2100 (-1) 500 300 700 1300 300 1000 2100 0 0>;
						battery,full_check_current_1st = <223 0 223 223 223 223 223 223 0 223 223 223 223 0 223 223 223 223 223 223 223 0 0>;
						battery,full_check_current_2nd = <2400 0 2400 2400 2400 2400 2400 2400 0 2400 2400 2400 2400 0 2400 2400 2400 2400 2400 2400 2400 0 0>;
				};
		};
};		