/* Copyright (c) 2013, The Linux Foundation. All rights reserved.
 *
 * This program is free software; you can redistribute it and/or modify
 * it under the terms of the GNU General Public License version 2 and
 * only version 2 as published by the Free Software Foundation.
 *
 * This program is distributed in the hope that it will be useful,
 * but WITHOUT ANY WARRANTY; without even the implied warranty of
 * MERCHANTABILITY or FITNESS FOR A PARTICULAR PURPOSE.  See the
 * GNU General Public License for more details.
 */

/* qcom,msm-id =<Chip_id Board_version Other_Specific_info>
 * All these three fields are unsigned 32 bit integers
 * For OtherSpecificInfo = 0xABCDEFGH [32 bits in total]
 *  G[4BITS]:MODEL_VARIANT i.e. 0 for MS01,1 for MILLET_3G, 2 for CT01, 3 for S3VE
 *  H[4BITS]:Hardware Revision
 * Please refer to .../lk/platform/msm_shared/dev_tree.c also
 */ 

/dts-v1/;
/include/ "msm8226-s3ve-sec-r00.dtsi"
/include/ "msm8226-s3ve-r00.dtsi"

/ {
	model = "[SM-G7102]CT01-Rev-03-MTP-v2";
	compatible = "qcom,msm8226-mtp", "qcom,msm8226", "qcom,mtp";
	qcom,msm-id = <145 8 0x20031>,
		      <158 8 0x20031>,
		      <159 8 0x20031>,
		      <198 8 0x20031>,
		      <205 8 0x20031>;
};
