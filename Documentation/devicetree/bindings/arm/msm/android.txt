## arch/arm/configs/msm8974pro_sec_klte_dv_defconfig
```kconfig
# K PROJECT config
CONFIG_ARCH_MSM8974PRO=y
CONFIG_SEC_K_PROJECT=y
CONFIG_MACH_KLTE_SPR=y
CONFIG_MSM_ADSPRPC=y

CONFIG_DEFERRED_INITCALLS=y

#
# Wifi features
#
#
# Remove Qualcomm Wifi features
#
# CONFIG_WCNSS_CORE is not set
# CONFIG_WCNSS_CORE_PRONTO is not set
# CONFIG_WCNSS_MEM_PRE_ALLOC is not set

#
# Add Broadcomm Wifi features
#
CONFIG_NET_CORE=y
CONFIG_WIRELESS=y
CONFIG_WIRELESS_EXT_SYSFS=y
CONFIG_WEXT_CORE=y
CONFIG_WEXT_PROC=y
CONFIG_CFG80211=y
CONFIG_CFG80211_DEFAULT_PS=y
CONFIG_CFG80211_ALLOW_RECONNECT=y
CONFIG_WLAN=y
CONFIG_WIFI_CONTROL_FUNC=y
CONFIG_BCM4354=y
CONFIG_BCMDHD_FW_PATH="/system/etc/wifi/bcmdhd_sta.bin"
CONFIG_BCMDHD_NVRAM_PATH="/system/etc/wifi/nvram_net.txt"
CONFIG_BROADCOM_WIFI_RESERVED_MEM=y
CONFIG_WLAN_REGION_CODE=100
CONFIG_MMC_MSM_SDC2_SUPPORT=y
CONFIG_CFG80211_REG_NOT_UPDATED=y
CONFIG_WIFI_MULTICAST_LOG=y

# CONFIG_MSM_PIL_PRONTO is not set
#
# LCD
#
CONFIG_LCD_CLASS_DEVICE=y
CONFIG_BACKLIGHT_LCD_SUPPORT=y
CONFIG_BACKLIGHT_CLASS_DEVICE=y
CONFIG_MDNIE_LITE_TUNING=y
CONFIG_FB_MSM_MIPI_SAMSUNG_OCTA_CMD_WQHD_PT_PANEL=y
CONFIG_FB_MSM_MDSS_DBG_SEQ_TICK=y
CONFIG_FB_MSM_MDSS_DSI_DBG=y
#
# Camera
#
CONFIG_S5K2P2XX=y
CONFIG_COMPANION=y
CONFIG_S5K8B1YX=y
#
# Input
#
CONFIG_TOUCHSCREEN_SYNAPTICS_I2C_RMI_G=y
CONFIG_KEYBOARD_CYPRESS_TOUCHKEY=y
#
# Specific keyboard combination reject in kernel level.
# Only processing Framework level.
#
CONFIG_USE_VM_KEYBOARD_REJECT=y
#
# Earjack
#
CONFIG_SAMSUNG_JACK=y
CONFIG_INPUT_GPIO=y
# Audience
CONFIG_SND_SOC_ES705=y
CONFIG_SND_SOC_ES705_SLIM=y
CONFIG_FW_LOADER=y
CONFIG_FIRMWARE_IN_KERNEL=y
CONFIG_EXTRA_FIRMWARE_DIR="firmware"
#
# BT Call Forwarding
#
CONFIG_BT_CALL_FORWARDING=y
#
# DHA Solution
#
CONFIG_SEC_DHA_SOL_MAL=y
#
# usb
#
CONFIG_USB_DUN_SUPPORT=y
# CONFIG_USB_EHCI_HCD is not set
# CONFIG_USB_EHCI_EHSET is not set
# CONFIG_USB_EHCI_MSM is not set
# CONFIG_USB_EHCI_MSM_HSIC is not set
CONFIG_USB_DWC3=y
CONFIG_MHL_VERSION=0x21

CONFIG_USB_STORAGE_DETECT=y
CONFIG_USB_HOST_NOTIFY=y
CONFIG_MHL_VERSION=0x21

# Advanced Linux Sound Architecture
CONFIG_SND_RAWMIDI=y

#
# Enable SEC_PM Feature
#
CONFIG_SEC_PM=y
CONFIG_SEC_PM_DEBUG=y
CONFIG_REGULATOR_MAX77804K=y
#
# ID Chip
#
CONFIG_W1=y
CONFIG_W1_MASTER_GPIO_MSM=y
CONFIG_W1_SLAVE_DS28EL15=y
CONFIG_W1_WORKQUEUE=y
CONFIG_W1_FAST_CHECK=y
CONFIG_W1_SN=y
#
# Finger print sensor
#
CONFIG_SENSORS_FINGERPRINT=y
CONFIG_SENSORS_FINGERPRINT_SYSFS=y
CONFIG_SENSORS_VFS61XX=y
CONFIG_SENSORS_VFS61XX_KO=y
# CONFIG_SENSORS_ADSP is not set
#
# Sensor hub
#
CONFIG_SENSORS_SSP=y
CONFIG_SENSORS_SYSFS=y
CONFIG_SENSORS_SSP_FACTORY=y
CONFIG_SENSORS_SSP_MPU6500=y
CONFIG_SENSORS_SSP_AK09911=y
CONFIG_SENSORS_SSP_BMP182=y
CONFIG_SENSORS_SSP_ATUC128L5HAR=y
CONFIG_SENSORS_SSP_SENSORHUB=y
CONFIG_SENSORS_SSP_STM=y
# CONFIG_SENSORS_SSP_SHTC1 is not set
CONFIG_SENSORS_SSP_MOBEAM=y
CONFIG_SENSORS_SSP_TMG399X=y
CONFIG_SENSORS_MAX86900=y
CONFIG_IIO_BUFFER=y
CONFIG_IIO=y
CONFIG_IIO_KFIFO_BUF=y
CONFIG_IIO_TRIGGER=y
CONFIG_IIO_ST_HWMON=y
#
# NFC
#
CONFIG_BCM2079X_NFC_I2C=y
#
# Battery & Charger
#
CONFIG_BATTERY_SWELLING=y
CONFIG_BATTERY_SAMSUNG=y
CONFIG_SAMSUNG_LPM_MODE=y
# CONFIG_SMB350_CHARGER is not set
# CONFIG_BATTERY_BQ28400 is not set
# CONFIG_BATTERY_MSM is not set
# CONFIG_FUELGAUGE_DUMMY is not set
#
# MAX77804K Charger
#
# CONFIG_QPNP_CHARGER is not set
# CONFIG_QPNP_BMS is not set
CONFIG_FUELGAUGE_MAX17048=y
CONFIG_CHARGER_MAX77804K=y
CONFIG_BATTERY_SWELLING=y
#
# Misc module
#
# CONFIG_KS8851 is not set
CONFIG_SEC_FPGA_ICE40XX=y
CONFIG_IR_REMOCON_FPGA=y
CONFIG_SENSORS_HALL=y
CONFIG_SENSORS_HALL_IRQ_CTRL=y
CONFIG_REGULATOR_MAX77826=y
CONFIG_MFD_MAX77804K=y
CONFIG_MAX77804K_MUIC=y
CONFIG_MUIC_MAX77804K_SUPPORT_MHL_CABLE_DETECTION=y
CONFIG_LEDS_AN30259A=y
CONFIG_MOTOR_DRV_MAX77804K=y
CONFIG_SS_VIBRATOR=y
CONFIG_GPIO_PCAL6416A=y
CONFIG_LEDS_MAX77804K=y
#
# etc
#
CONFIG_HID=y
# CONFIG_HID_OVR is not set
#
# BT
#
CONFIG_BT_BCM4354=y

#
# extcon
#
CONFIG_EXTCON=y
CONFIG_EXTCON_MAX77804K=y

#
# RCU
#
CONFIG_RCU_FAST_NO_HZ=y

#EPDG
CONFIG_NET_CORE=y
CONFIG_NET_SCH_PRIO=y
CONFIG_NET_SCHED=y   #depends on CONFIG_NET  which is enabled by default.. coz not seeing in the config file
CONFIG_NET_CLS_BASIC=y # required if basic is being used as a filter. depends on CONFIG_NET_CLS so enabling it by default
CONFIG_NET_CLS=y
CONFIG_NET_CLS_ACT=y # for enabling the action target.
CONFIG_NET_ACT_MIRRED=y  # for enabling the mirred target for redirecting the packet between the devices.
CONFIG_NET_EMATCH=y   #basic uses extended matches so this has to be present
CONFIG_NET_SCH_INGRESS=y # classifier for ingress packet

#optimize mmc block delay on resume
CONFIG_MMC_BLOCK_DEFERRED_RESUME=y

# SAMP : HOTNESS
CONFIG_SAMP_HOTNESS=y

# DUALWAVE
CONFIG_DUALWAVE=y
```

## arch/arm/configs/msm8974pro_sec_klte_kor_defconfig
```kconfig
# K PROJECT config
CONFIG_ARCH_MSM8974PRO=y
CONFIG_SEC_K_PROJECT=y
CONFIG_MACH_KLTE_KTT=y
CONFIG_MACH_KLTE_KOR=y
CONFIG_MSM_ADSPRPC=y
CONFIG_MSM_L2_ERP_PORT_PANIC=y

CONFIG_DEFERRED_INITCALLS=y

#
# Wifi features
#

#
# Remove Qualcomm Wifi features
#
# CONFIG_WCNSS_CORE is not set
# CONFIG_WCNSS_CORE_PRONTO is not set
# CONFIG_WCNSS_MEM_PRE_ALLOC is not set

#
# Add Broadcomm Wifi features
#
CONFIG_NET_CORE=y
CONFIG_WIRELESS=y
CONFIG_WIRELESS_EXT_SYSFS=y
CONFIG_WEXT_CORE=y
CONFIG_WEXT_PROC=y
CONFIG_CFG80211=y
CONFIG_CFG80211_DEFAULT_PS=y
CONFIG_CFG80211_ALLOW_RECONNECT=y
CONFIG_WLAN=y
CONFIG_WIFI_CONTROL_FUNC=y
CONFIG_BCM4354=y
CONFIG_BCMDHD_FW_PATH="/system/etc/wifi/bcmdhd_sta.bin"
CONFIG_BCMDHD_NVRAM_PATH="/system/etc/wifi/nvram_net.txt"
CONFIG_BROADCOM_WIFI_RESERVED_MEM=y
CONFIG_WLAN_REGION_CODE=200
CONFIG_MMC_MSM_SDC2_SUPPORT=y
CONFIG_CFG80211_REG_NOT_UPDATED=y
CONFIG_WIFI_MULTICAST_LOG=y

#
#SKT IWLAN
#
CONFIG_XFRM=y
CONFIG_XFRM_USER=y
CONFIG_NET_KEY=y
CONFIG_INET_ESP=y
CONFIG_INET_IPCOMP=y
CONFIG_INET_XFRM_MODE_TRANSPORT=y
CONFIG_INET_XFRM_MODE_TUNNEL=y
CONFIG_IP_ADVANCED_ROUTER=y
CONFIG_IP_MULTIPLE_TABLES=y
CONFIG_CRYPTO=y
CONFIG_CRYPTO_HMAC=y
CONFIG_CRYPTO_XCBC=y
CONFIG_CRYPTO_NULL=y
CONFIG_CRYPTO_MD5=y
CONFIG_CRYPTO_SHA1=y
CONFIG_CRYPTO_DES=y
CONFIG_CRYPTO_AES=y
CONFIG_CRYPTO_DEFLATE=y

#SKT IWLAN FOR TBASE
CONFIG_NETFILTER=y
CONFIG_IP_NF_IPTABLES=y
CONFIG_NETFILTER_ADVANCED=y

# CONFIG_MSM_PIL_PRONTO is not set

#
# LCD
#
CONFIG_LCD_CLASS_DEVICE=y
CONFIG_BACKLIGHT_LCD_SUPPORT=y
CONFIG_BACKLIGHT_CLASS_DEVICE=y
CONFIG_MDNIE_LITE_TUNING=y
CONFIG_FB_MSM_MIPI_SAMSUNG_OCTA_CMD_WQHD_PT_PANEL=y
CONFIG_FB_MSM_MDSS_DBG_SEQ_TICK=y
CONFIG_FB_MSM_MDSS_DSI_DBG=y
#
# Camera
#
CONFIG_S5K2P2XX=y
CONFIG_COMPANION=y
CONFIG_S5K8B1YX=y
#
# Input
#
CONFIG_TOUCHSCREEN_SYNAPTICS_I2C_RMI_G=y
CONFIG_KEYBOARD_CYPRESS_TOUCHKEY=y
#
# Specific keyboard combination reject in kernel level.
# Only processing Framework level.
#
CONFIG_USE_VM_KEYBOARD_REJECT=y
#
# Earjack
#
CONFIG_SAMSUNG_JACK=y
CONFIG_INPUT_GPIO=y
# Audience
CONFIG_SND_SOC_ES705=y
CONFIG_SND_SOC_ES705_SLIM=y
CONFIG_FW_LOADER=y
CONFIG_FIRMWARE_IN_KERNEL=y
CONFIG_EXTRA_FIRMWARE_DIR="firmware"
CONFIG_SND_SOC_ES704_TEMP=y

#
# BT Call Forwarding
#
CONFIG_BT_CALL_FORWARDING=y

#
# DHA Solution
#
CONFIG_SEC_DHA_SOL_MAL=y

# Ringtone Gain
CONFIG_SEC_DEVIDE_RINGTONE_GAIN=y

#
# usb
#
CONFIG_USB_DUN_SUPPORT=y
# CONFIG_USB_EHCI_HCD is not set
# CONFIG_USB_EHCI_EHSET is not set
# CONFIG_USB_EHCI_MSM is not set
# CONFIG_USB_EHCI_MSM_HSIC is not set
CONFIG_USB_DWC3=y
CONFIG_USB_STORAGE_DETECT=y
CONFIG_USB_HOST_NOTIFY=y
CONFIG_MHL_VERSION=0x21
CONFIG_USB_LOCK_SUPPORT_FOR_MDM=y

# Advanced Linux Sound Architecture
CONFIG_SND_RAWMIDI=y

#
# Enable SEC_PM Feature
#
CONFIG_SEC_PM=y
CONFIG_SEC_PM_DEBUG=y
CONFIG_REGULATOR_MAX77804K=y
#
# ID Chip
#
CONFIG_W1=y
CONFIG_W1_MASTER_GPIO_MSM=y
CONFIG_W1_SLAVE_DS28EL15=y
CONFIG_W1_WORKQUEUE=y
CONFIG_W1_FAST_CHECK=y
CONFIG_W1_SN=y
#
# Finger print sensor
#
CONFIG_SENSORS_FINGERPRINT=y
CONFIG_SENSORS_FINGERPRINT_SYSFS=y
CONFIG_SENSORS_VFS61XX=y
CONFIG_SENSORS_VFS61XX_KO=y
# CONFIG_SENSORS_ADSP is not set
#
# Sensor hub
#
CONFIG_SENSORS_SSP=y
CONFIG_SENSORS_SYSFS=y
CONFIG_SENSORS_SSP_FACTORY=y
CONFIG_SENSORS_SSP_MPU6500=y
CONFIG_SENSORS_SSP_AK09911=y
CONFIG_SENSORS_SSP_BMP182=y
CONFIG_SENSORS_SSP_ATUC128L5HAR=y
CONFIG_SENSORS_SSP_SENSORHUB=y
CONFIG_SENSORS_SSP_STM=y
CONFIG_SENSORS_SSP_SHTC1=y
CONFIG_SENSORS_SSP_MOBEAM=y
CONFIG_SENSORS_SSP_TMG399X=y
CONFIG_SENSORS_MAX86900=y
CONFIG_IIO_BUFFER=y
CONFIG_IIO=y
CONFIG_IIO_KFIFO_BUF=y
CONFIG_IIO_TRIGGER=y
CONFIG_IIO_ST_HWMON=y
#
# NFC
#
CONFIG_NFC_PN547=y
CONFIG_NFC_PN547_PMC8974_CLK_REQ=y
#
# Battery & Charger
#
CONFIG_BATTERY_SWELLING=y
CONFIG_BATTERY_SAMSUNG=y
CONFIG_SAMSUNG_LPM_MODE=y
# CONFIG_SMB350_CHARGER is not set
# CONFIG_BATTERY_BQ28400 is not set
# CONFIG_BATTERY_MSM is not set
# CONFIG_FUELGAUGE_DUMMY is not set
#
# MAX77804K Charger
#
# CONFIG_QPNP_CHARGER is not set
# CONFIG_QPNP_BMS is not set
CONFIG_FUELGAUGE_MAX17048=y
CONFIG_CHARGER_MAX77804K=y
CONFIG_BATTERY_SWELLING=y
#
# Misc module
#
# CONFIG_KS8851 is not set
CONFIG_SEC_FPGA_ICE40XX=y
CONFIG_IR_REMOCON_FPGA=y
CONFIG_SENSORS_HALL=y
CONFIG_SENSORS_HALL_IRQ_CTRL=y
CONFIG_REGULATOR_MAX77826=y
CONFIG_MFD_MAX77804K=y
CONFIG_MAX77804K_MUIC=y
CONFIG_MUIC_MAX77804K_SUPPORT_MHL_CABLE_DETECTION=y
CONFIG_LEDS_AN30259A=y
CONFIG_MOTOR_DRV_MAX77804K=y
CONFIG_SS_VIBRATOR=y
CONFIG_GPIO_PCAL6416A=y
CONFIG_LEDS_MAX77804K=y
#
# etc
#
CONFIG_HID=y
# CONFIG_HID_OVR is not set
#
# BT
#
CONFIG_BT_BCM4354=y

#
# extcon
#
CONFIG_EXTCON=y
CONFIG_EXTCON_MAX77804K=y

#
# RCU
#
CONFIG_RCU_FAST_NO_HZ=y

#EPDG
CONFIG_NET_CORE=y
CONFIG_NET_SCH_PRIO=y
CONFIG_NET_SCHED=y   #depends on CONFIG_NET  which is enabled by default.. coz not seeing in the config file
CONFIG_NET_CLS_BASIC=y # required if basic is being used as a filter. depends on CONFIG_NET_CLS so enabling it by default
CONFIG_NET_CLS=y
CONFIG_NET_CLS_ACT=y # for enabling the action target.
CONFIG_NET_ACT_MIRRED=y  # for enabling the mirred target for redirecting the packet between the devices.
CONFIG_NET_EMATCH=y   #basic uses extended matches so this has to be present
CONFIG_NET_SCH_INGRESS=y # classifier for ingress packet

#optimize mmc block delay on resume
CONFIG_MMC_BLOCK_DEFERRED_RESUME=y

# SAMP : HOTNESS
CONFIG_SAMP_HOTNESS=y

# DUALWAVE
CONFIG_DUALWAVE=y
```

## arch/arm/configs/selinux_defconfig
```kconfig
CONFIG_EXT2_FS_XATTR=y
CONFIG_EXT2_FS_SECURITY=y
CONFIG_EXT4_FS_XATTR=y
CONFIG_EXT4_FS_SECURITY=y
CONFIG_AUDIT=y
CONFIG_AUDITSYSCALL=y
CONFIG_SECURITY=y
CONFIG_LSM_MMAP_MIN_ADDR=4096
CONFIG_SECURITY_NETWORK=y
CONFIG_SECURITY_SELINUX=y
CONFIG_SECURITY_SELINUX_DEVELOP=y
CONFIG_SECURITY_SELINUX_AVC_STATS=y
CONFIG_SECURITY_SELINUX_CHECKREQPROT_VALUE=y
CONFIG_NETWORK_SECMARK=y
CONFIG_NF_CONNTRACK_SECMARK=y
CONFIG_NETFILTER_XT_TARGET_CONNSECMARK=y
CONFIG_NETFILTER_ADVANCED=y
CONFIG_IP_NF_SECURITY=y
CONFIG_DEFAULT_SECURITY=y
CONFIG_DEFAULT_SECURITY="selinux"
CONFIG_FAT_VIRTUAL_XATTR=y
CONFIG_FAT_VIRTUAL_XATTR_SELINUX_LABEL="u:object_r:sdcard_external:s0"
CONFIG_EXFAT_VIRTUAL_XATTR=y
CONFIG_ECRYPT_FS_VIRTUAL_FAT_XATTR=y
CONFIG_SDCARD_FS_XATTR=y
CONFIG_SEC_SELINUX=y
```

## arch/arm/configs/tima_defconfig
```kconfig
# Note of using this defconfig:
# Before adding anything here, make sure it has an entry in
# arch/arm/mach-msm/Kconfig with appropriate dependency spec and 
# help text.
# https://www.kernel.org/doc/Documentation/kbuild/kconfig-language.txt
#
# Contact: Jitesh Shah <j1.shah@sta.samsung.com> for more info
#
# LKMAUTH defines
# CONFIG_TIMA_LKMAUTH is not set
#CONFIG_TIMA_LKMAUTH_CODE_PROT=n

# Other TIMA bits. Log and Uevent. Note that apart from LKM
# these might also be dependent on PKM, Attestation and Keystore.
# So its best to always keep them turned on even though LKM is 
# disabled.
CONFIG_TIMA=y
CONFIG_TIMA_UEVENT=y
CONFIG_TIMA_LOG=y
#CONFIG_TIMA_TEST_INFRA=m

# RKP defines
CONFIG_TIMA_RKP=y
#CONFIG_TIMA_RKP_L1_TABLES=n
#CONFIG_TIMA_RKP_L2_TABLES=n
#CONFIG_TIMA_RKP_L2_GROUP=n
#CONFIG_TIMA_RKP_DMA_MVA_TO_SETWAY=n
#CONFIG_TIMA_RKP_DEBUG=n
```

## drivers/adsp_factory/Kconfig
```kconfig
#
# factory sensor drivers configuration
#
config ADSP_SENSORS_CORE
         bool "sensors_core"
         depends on I2C
config ADSP_FACTORY
	tristate "MSM ADSP factory driver"
	default n
	help
	  Provides access to ADSP user space.

config MPU6500_FACTORY
	tristate "factory test for adsp - mpu6500"
	default n
	depends on I2C
	help
	  mpu6500 file for factory test in adsp.

config MPU6515_FACTORY
	tristate "factory test for adsp - mpu6515"
	default n
	depends on I2C
	help
	  mpu6515 file for factory test in adsp.

config HSCDTD008A_FACTORY
	tristate "factory test for adsp - hscdtd008a"
	default n
	depends on I2C
	help
	  hscdtd008a file for factory test in adsp.

config GP2AP30_FACTORY
	tristate "factory test for adsp - gp2ap30"
	default n
	depends on I2C
	help
	  gp2ap30 file for factory test in adsp.

config BMA250_FACTORY
	tristate "factory test for adsp - bma250"
	default n
	depends on I2C
	help
	  bma250 file for factory test in adsp.

config YAS532_FACTORY
	tristate "factory test for adsp - yas532"
	default n
	depends on I2C
	help
	  yas532 file for factory test in adsp.
```

## drivers/barcode_emul/Kconfig
```kconfig
#
# SEC_FPGA
#
menu "SEC_FPGA and IRDA FPGA"

config SEC_FPGA
	tristate "this feature allows Barcode emulator"
	default n
	help
	  This is a driver for barcode emulator driver based on Lattice chip.
	  Lattice FPGA can support Barcode emulator.
	  To compile this driver as a module, choose M here.
	  If unsure, say N.

config IR_REMOCON_FPGA
	tristate "this feature allows IR LED"
	depends on SEC_FPGA
	default n
	help
	  This is a driver for IR LED driver based on Lattice chip.
	  Lattice FPGA can support IR LED.
	  To compile this driver as a module, choose M here.
	  If unsure, say N.
endmenu
```
