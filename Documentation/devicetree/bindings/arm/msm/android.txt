## drivers/battery/Kconfig
```kconfig
config BATTERY_SAMSUNG
	tristate "samsung battery driver"
	help
	 Say Y to include support for samsung battery driver
	 This battery driver integrated all battery-related functions
	 To see battery-related functions,
	 refer to sec_charging_common.h

config BATTERY_SAMSUNG_DATA_FILE
	depends on BATTERY_SAMSUNG
	string "samsung battery data file"
	default ""
	help
	 Path to the battery data file.

config BATTERY_SAMSUNG_DATA
	bool
	default BATTERY_SAMSUNG_DATA_FILE != ""

config CHARGING_VZWCONCEPT
	tristate "VZW concept about the charging"
	default n
	depends on BATTERY_SAMSUNG
	help
	 Say Y to include support for the VZW concepts.

config BATTERY_SWELLING
	bool "prevent battery swelling"
	help
	  Say Y to include support for prevent battery swelling

# Fuel Gauge

config FUELGAUGE_DUMMY
	tristate "dummy fuel gauge driver"
	default n
	depends on BATTERY_SAMSUNG
	help
	 Say Y to include support
	 for dummy fuel gauge driver.
	 This driver source code implemented
	 skeleton source code for fuel gauge functions.

config FUELGAUGE_MAX17042
	tristate "MAX17042 fuel gauge driver"
	default n
	depends on BATTERY_SAMSUNG
	help
	 Say Y to include support
	 for MAXIM MAX17042 fuel gauge driver.
	 This fuel-gauge can be used in voltage-tracking mode
	 or coulomb-counting mode.

config FUELGAUGE_MAX17042_VOLTAGE_TRACKING
	tristate "use MAX17042 fuel gauge only as voltage tracking"
	default n
	depends on FUELGAUGE_MAX17042
	help
	 Say Y to use MAX17042 fuel gauge
	 only as voltage tracking.
	 This mode is for target that consumes low current
	 like smart-phone.

config FUELGAUGE_MAX17042_COULOMB_COUNTING
	tristate "use MAX17042 fuel gauge as coulomb counting (including voltage tracking)"
	default n
	depends on FUELGAUGE_MAX17042
	help
	 Say Y to use MAX17042 fuel gauge
	 as coulomb counting (including voltage tracking).
	 This mode is for target that consumes high current
	 like tablet.

config FUELGAUGE_MAX17048
	tristate "MAX17048 fuel gauge driver"
	default n
	depends on BATTERY_SAMSUNG
	help
	 Say Y to include support
	 for MAXIM MAX17048 fuel gauge driver.
	 This fuel-gauge can be used
	 only in voltage-tracking mode.

config FUELGAUGE_MAX17050
	tristate "MAX17050 fuel gauge driver"
	default n
	depends on BATTERY_SAMSUNG
	help
	 Say Y to include support
	 for MAXIM MAX17047 or MAX17050 fuel gauge driver.
	 This fuel-gauge can be used in voltage-tracking mode
	 or coulomb-counting mode.

config FUELGAUGE_MAX17050_VOLTAGE_TRACKING
	tristate "use MAX17050 fuel gauge only as voltage tracking"
	default n
	depends on FUELGAUGE_MAX17050
	help
	 Say Y to use MAX17050 fuel gauge
	 only as voltage tracking.
	 This mode is for target that consumes low current
	 like smart-phone.

config FUELGAUGE_MAX17050_COULOMB_COUNTING
	tristate "use MAX17050 fuel gauge as coulomb counting (including voltage tracking)"
	default n
	depends on FUELGAUGE_MAX17050
	help
	 Say Y to use MAX17050 fuel gauge
	 as coulomb counting (including voltage tracking).
	 This mode is for target that consumes high current
	 like tablet.

config FUELGAUGE_MAX77823
	tristate "MAX77823 fuel gauge driver"
	default n
	depends on BATTERY_SAMSUNG
	help
	 Say Y to include support
	 for MAXIM MAX17047 or MAX17050 fuel gauge driver.
	 This fuel-gauge can be used in voltage-tracking mode
	 or coulomb-counting mode.

config FUELGAUGE_MAX77823_VOLTAGE_TRACKING
	tristate "use MAX77823 fuel gauge only as voltage tracking"
	default n
	depends on FUELGAUGE_MAX77823
	help
	 Say Y to use MAX17050 fuel gauge
	 only as voltage tracking.
	 This mode is for target that consumes low current
	 like smart-phone.

config FUELGAUGE_MAX77823_COULOMB_COUNTING
	tristate "use MAX77823 fuel gauge as coulomb counting (including voltage tracking)"
	default n
	depends on FUELGAUGE_MAX77823
	help
	 Say Y to use MAX77823 fuel gauge
	 as coulomb counting (including voltage tracking).
	 This mode is for target that consumes high current
	 like tablet.

# Charger

config CHARGER_DUMMY
	tristate "dummy charger driver"
	default n
	depends on BATTERY_SAMSUNG
	help
	 Say Y to include support
	 for dummy charger driver.
	 This driver source code implemented
	 skeleton source code for charger functions.

config CHARGER_MAX8903
	tristate "MAX8903 charger driver"
	default n
	depends on BATTERY_SAMSUNG
	help
	 Say Y to include support
	 for MAXIM MAX8903 charger driver.
	 This driver source code implemented
	 all functions for MAX8903 charger.

config CHARGER_SMB328
	tristate "SMB328 charger driver"
	default n
	depends on BATTERY_SAMSUNG
	help
	 Say Y to include support
	 for Summit SMB328 charger driver.
	 This driver source code implemented
	 all functions for SMB328 charger.

config CHARGER_SMB347
	tristate "SMB347 charger driver"
	default n
	depends on BATTERY_SAMSUNG
	help
	 Say Y to include support
	 for Summit SMB347 charger driver.
	 This driver source code implemented
	 all functions for SMB347 charger.

config CHARGER_SMB358
	tristate "SMB358 charger driver"
	default n
	depends on BATTERY_SAMSUNG
	help
	 Say Y to include support
	 for Summit SMB358 charger driver.
	 This driver source code implemented
	 all functions for SMB358 charger.

config CHARGER_SMB1357
	tristate "SMB1357 charger driver"
	default n
	depends on BATTERY_SAMSUNG
	help
	 Say Y to include support
	 for Summit SMB1357 charger driver.
	 This driver source code implemented
	 all functions for SMB1357 charger.

config CHARGER_BQ24157
	tristate "BQ24157 charger driver"
	default n
	depends on BATTERY_SAMSUNG
	help
	 Say Y to include support
	 for TI BQ24157 charger driver.
	 This driver source code implemented
	 all functions for BQ24157 charger.

config CHARGER_BQ24190
	tristate "BQ24190 charger driver"
	default n
	depends on BATTERY_SAMSUNG
	help
	 Say Y to include support
	 for TI BQ24190 charger driver.
	 This driver source code implemented
	 all functions for BQ24190 charger.

config CHARGER_BQ24191
	tristate "BQ24191 charger driver"
	default n
	depends on BATTERY_SAMSUNG
	help
	 Say Y to include support
	 for TI BQ24191 charger driver.
	 This driver source code implemented
	 all functions for BQ24191 charger.

config CHARGER_BQ24260
	tristate "BQ24260 charger driver"
	default n
	depends on BATTERY_SAMSUNG
	help
	 Say Y to include support
	 for TI BQ24260 charger driver.
	 This driver source code implemented
	 all functions for BQ24260 charger.

config CHARGER_MAX77693
	tristate "MAX77693 battery charger support"
	depends on MFD_MAX77693 && I2C
	help
	  Say Y here to enable support for the MAX77693 charger
	  MAX77693 incluse muic, pmic, haptic, led,
	  flash driver.
	  You have to define MFD_MAX77693

config CHARGER_MAX77823
	tristate "MAX77823 battery charger support"
	depends on BATTERY_SAMSUNG
	help
	 Say Y here to enable support for the MAX77823 charger

config CHARGER_MAX77803
	tristate "MAX77803 battery charger support"
	depends on MFD_MAX77803 && I2C
	help
	  Say Y here to enable support for the MAX77803 charger
	  MAX77803 incluse muic, pmic, haptic, led,
	  flash driver.
	  You have to define MFD_MAX77803

config CHARGER_MAX77804K
	tristate "MAX77804K battery charger support"
	depends on MFD_MAX77804K && I2C
	help
	  Say Y here to enable support for the MAX77804K charger
	  MAX77804K incluse muic, pmic, haptic, led,
	  flash driver.
	  You have to define MFD_MAX77804K

config CHARGER_MAX77888
        tristate "MAX77888 battery charger support"
        depends on MFD_MAX77888 && I2C
        help
          Say Y here to enable support for the MAX77888 charger
          MAX77888 incluse muic, pmic, haptic, led,
          flash driver.
          You have to define MFD_MAX77888

config CHARGER_SM5414
	tristate "SM5414 charger driver"
	default n
	help
	 Say Y to include support
	 for SM5414 charger driver.
	 This driver source code implemented
	 all functions for SMB5414 charger.

config AFC_CHARGER_MODE
	bool "afc charging support in sec battery driver"
	default n
	depends on CHARGER_MAX77843
	help
	  Say Y to include support for sec afc charging support

config SAMSUNG_LPM_MODE
	bool "Off charging mode support in sec battery driver"
	default n
	help
	  Say Y to include support for sec off charging support
	  This value defined at bootloader.
	  Before enable this feature,
	  implemet power off charging in the bootloader.

config SAMSUNG_BATTERY_ENG_TEST
	bool "enable ENG mode for battery test"
	default n
	help
	  Say Y to include support for battery test
	  enable this feature only ENG mode
	  this featuren must disabled user binary
	  stability test etc..

config SAMSUNG_BATTERY_FACTORY
	bool "enable for factory test"
	default n
	help
	  Say Y to include support for factory test
	  enable this feature only factory mode
	  this featuren must disabled user binary
	  stability test etc..

config SAMSUNG_BATTERY_DISALLOW_DEEP_SLEEP
	bool "Disallow deep sleep during charging"
	default n
	depends on BATTERY_SAMSUNG && ARCH_MSM8974
	help
	  Say Y to include support
	  Disallow deep sleep during charging for stablity.

config DISABLE_SAVE_CAPACITY_MAX
	bool "Disable to save capacity max in efs"
	default n
	depends on BATTERY_SAMSUNG
	help
	  Say Y to include support to disable it
	  capacity_max is saved in /efs/Battery/batt_capacity_max
	  capacity_max is restored after boot up
	  You can find the code in healthd

config EN_OOPS
	bool "enable oops filter"
	default n
	help
	  Say Y to enable oops filter

# OTG

config CONTROL_OTG_POPUP
	bool "OTG Popup control for waterproof models"
	default n
	help
	  Say Y here to enable support for OTG Popup control
```

## drivers/extcon/Kconfig
```kconfig
menuconfig EXTCON
	tristate "External Connector Class (extcon) support"
	help
	  Say Y here to enable external connector class (extcon) support.
	  This allows monitoring external connectors by userspace
	  via sysfs and uevent and supports external connectors with
	  multiple states; i.e., an extcon that may have multiple
	  cables attached. For example, an external connector of a device
	  may be used to connect an HDMI cable and a AC adaptor, and to
	  host USB ports. Many of 30-pin connectors including PDMI are
	  also good examples.

if EXTCON

comment "Extcon Device Drivers"

config EXTCON_GPIO
	tristate "GPIO extcon support"
	depends on GENERIC_GPIO
	help
	  Say Y here to enable GPIO based extcon support. Note that GPIO
	  extcon supports single state per extcon instance.

config EXTCON_ADC_JACK
	tristate "ADC Jack extcon support"
	depends on IIO
	help
	  Say Y here to enable extcon device driver based on ADC values.

config EXTCON_MAX77693
	tristate "MAX77693 EXTCON Support"
	depends on MFD_MAX77693
	select IRQ_DOMAIN
	select REGMAP_I2C
	help
	  If you say yes here you get support for the MUIC device of
	  Maxim MAX77693 PMIC. The MAX77693 MUIC is a USB port accessory
	  detector and switch.

config EXTCON_FSA9485
	tristate "FSA9485 EXTCON Support"
	depends on I2C
	help
	  If you say yes here you get support for the MUIC device of
	  Fairchild FSA9485. The FSA9485 MUIC is a USB port accessory
	  detector and switch.

config EXTCON_TSU6721
	tristate "TSU6721 EXTCON Support"
	depends on I2C
	help
	  If you say yes here you get support for the MUIC device of
	  Texas Instrument TSU6721. The TSU6721 MUIC is a USB port accessory
	  detector and switch.

config EXTCON_MAX77803
	tristate "MAX77803 EXTCON Support"
	depends on MFD_MAX77803
	help
	  If you say yes here you get support for the MUIC device of
	  Maxim MAX77803 PMIC.
	  The MAX77803 MUIC is a USB port accessory detector and switch.

config EXTCON_MAX77804K
	tristate "MAX77804K EXTCON Support"
	depends on MFD_MAX77804K
	help
	  If you say yes here you get support for the MUIC device of
	  Maxim MAX77804K PMIC.
	  The MAX77804K MUIC is a USB port accessory detector and switch.

config ADC_ONESHOT
	bool "MAX77804K ADC ONESHOT MODE Support"
	depends on EXTCON_MAX77804K
	depends on !SEC_FACTORY
	default n
	help
		Say Y here to enable ADC Oneshot mode when detecting ID value

config MUIC_SUPPORT_AUDIO_DOCK
	bool "MUIC_SUPPORT_AUDIO_DOCK"
	default n
	help
	  If you say yes here you will get support for the audio dock.

config MUIC_SUPPORT_DESK_DOCK
	bool "MUIC_SUPPORT_DESK_DOCK"
	default n
	help
	  If you say yes here you will get support for the desk dock.

config MUIC_SUPPORT_SMART_DOCK
	bool "MUIC_SUPPORT_SMART_DOCK"
	default n
	help
	  If you say yes here you will get support for the smart dock.

config MUIC_SUPPORT_MMD_CTL
	bool "MUIC_SUPPORT_MMD_CTL"
	default n
	help
	  If you say yes here you will get support for the smart dock enable func by keystring.

config MUIC_SUPPORT_INCOMPATIBLE_CHARGER
	bool "MUIC_SUPPORT_INCOMPATIBLE_CHARGER"
	default n
	help
	  If you say yes here you will get support for the incompatible charger.

config MUIC_MAX77804K_SUPPORT_LANHUB
	bool "MUIC_MAX77804K_SUPPORT_LANHUB"
	depends on !SEC_FACTORY
	default n
	help
	  If you say yes here, you will get support for the LANHUB cable.

config MUIC_SUPPORT_RUSTPROOF
	bool "MUIC Disable UART"
	depends on !SEC_FACTORY
	default n
	help
	 This option will disable the UART to prevent the rusting of the
	 IF Connector in the case of Kmini Devices.

config USBID_STANDARD
	bool "USBID_STANDARD"
	default n
	help
	  If you say yes here you will get support for usbid standard.

config EXTCON_ARIZONA
	tristate "Wolfson Arizona EXTCON support"
	depends on MFD_ARIZONA && INPUT
	help
	  Say Y here to enable support for external accessory detection
	  with Wolfson Arizona devices. These are audio CODECs with
	  advanced audio accessory detection support.

endif # MULTISTATE_SWITCH
```

## drivers/felica/Kconfig
```kconfig
config FELICA
	bool "FeliCa Driver"
	default n

config NFC_FELICA
	bool "NFC FeliCa Driver"
	default n
```

## drivers/fingerprint/Kconfig
```kconfig
#
# Sensor  drivers configuration
#
menuconfig SENSORS_FINGERPRINT
	bool "Finger Print Sensor devices"
	help
	  Say Y here, and a list of sensors drivers will be displayed.
	  Everything that didn't fit into the other categories is here. This option
	  doesn't affect the kernel.

	  If unsure, say Y.

if SENSORS_FINGERPRINT
config SENSORS_FINGERPRINT_SYSFS
	tristate "fingerprint sensor sysfs support"
	default n
	help
	  If you say yes here you get support for
	  fingerprint sensor FINGERPRINT_SYSFS
config SENSORS_VFS61XX
	tristate "VFS61XX fingerprint sensor support"
	default n
	help
	  If you say yes here you get support for Validity's
	  fingerprint sensor VFS61XX.
config SENSORS_VFS61XX_KO
	tristate "VFS61XX fingerprint sensor support"
	default n
	help
	  If you say yes here you get support for Validity's
	  fingerprint sensor VFS61XX_KO.
config SENSORS_FPRINT_SECURE
	tristate "VFS61XX fingerprint sensor support"
	default n
	help
	  If you say yes here you get support for Validity's
	  fingerprint sensor enable secure zone.
endif
```

## drivers/gpu/gpu_sysfs/Kconfig
```kconfig
config GPU_UNIFIED_SYSFS
	tristate "Unified Sysfs for GPU"
	depends on ARM
	help
	  Chose this option to enable the Unified Sysfs for GPU.
```

## drivers/input/keyboard/cypress_touchkey_ks01/Kconfig
```kconfig
#
# Cypress touchkey configuration
#

config KEYBOARD_CYPRESS_TOUCHKEY_KS01
	tristate "Cypress touchkey support"
	default n
	help
	  Say Y here to enable the
	  cypress touchkey.
	  To compile this driver as a
	  module, choose M here.

config GLOVE_TOUCH
	tristate "Glove touch"
	help
	  Say Y here if you want glove touch.
```

## drivers/input/keyboard/cypress_touchkey_s3/Kconfig
```kconfig
#
# Cypress touchkey configuration
#

config KEYBOARD_CYPRESS_TOUCHKEY_S3
        tristate "Cypress touchkey support"
        default n
        help
          Say Y here to enable the
	  cypress touchkey.
          To compile this driver as a
	  module, choose M here.
```
