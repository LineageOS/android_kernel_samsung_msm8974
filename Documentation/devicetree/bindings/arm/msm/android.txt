## drivers/input/touchscreen/cyttsp5/Kconfig
```kconfig
#
# Cypress cyttsp5 touchscreen driver configuration
#

config TOUCHSCREEN_CYTTSP5
        tristate "Cypress TrueTouch Gen5 Touchscreen Driver"
	depends on I2C
	default n
        select TOUCHSCREEN_CYPRESS_CYTTSP5_MT_B
	help
          Core driver for Cypress TrueTouch(tm) Standard Product
          Geneartion5 touchscreen controllers.

          Say Y here if you have a Cypress Gen5 touchscreen.
          If unsure, say N.
          To compile this driver as a module, choose M here.

config TOUCHSCREEN_CYTTSP5_DEVICETREE_SUPPORT
	bool "Enable Device Tree support"
	depends on TOUCHSCREEN_CYTTSP5
	default n	
	help
	  Say Y here to enable support for device tree.

	  If unsure, say N. 
```

## drivers/input/touchscreen/melfas_mms136/Kconfig
```kconfig
#
# Melfas mms136 configuration
#

config TOUCHSCREEN_MMS136
	tristate "Melfas i2c touchscreen"
	depends on I2C
	help
		This enable support for Melfas over I2C based touchscreen.
```

## drivers/input/touchscreen/mxt1188s/Kconfig
```kconfig
#
# ATMEL MXT1188S TOUCH driver configuration
#
config TOUCHSCREEN_ATMEL_MXT1188S
	tristate "Atmel MXT1188S Touchscreen Interface"
	depends on I2C
	default n
	help
	  Say Y here if tou want support for atmel_MXT1188S touchscreen controllers.
	  To compile this driver as a module, choose M here: the
	  module will be called mxt1188s
```

## drivers/input/touchscreen/stm_fts/Kconfig
```kconfig
# ST Microelectronics driver configuration
#

config TOUCHSCREEN_FTS
	tristate "STMicroelectronics touchscreen driver"
	depends on I2C
```

## drivers/input/touchscreen/stm_s/Kconfig
```kconfig
# ST Microelectronics driver configuration
#

config TOUCHSCREEN_FTS_S
	tristate "STMicroelectronics touchscreen driver"
	depends on I2C
```

## drivers/input/touchscreen/synaptics/Kconfig
```kconfig
#
# SYNAPTICS TOUCH driver configuration
#
config TOUCHSCREEN_SYNAPTICS_I2C_RMI
	tristate "Synaptics i2c touchscreen"
	depends on I2C
	help
	  This enables support for Synaptics RMI over I2C based touchscreens.
	  use Synaptics S5000, S5050, S5700, S5707, S5708 IC.

config TOUCHSCREEN_SYNAPTICS_I2C_RMI_G
	tristate "Synaptics i2c touchscreen"
	depends on I2C
	help
	  This enables support for Synaptics RMI over I2C based touchscreens.
	  use Synaptics IC supporting GuestThread.
```

## drivers/input/touchscreen/synaptics_jsglte/Kconfig
```kconfig
#
# SYNAPTICS TOUCH driver configuration
#
config TOUCHSCREEN_SYNAPTICS_I2C_RMI_JSGLTE
	tristate "Synaptics i2c touchscreen"
	depends on I2C
	help
	  This enables support for Synaptics RMI over I2C based touchscreens.
```
